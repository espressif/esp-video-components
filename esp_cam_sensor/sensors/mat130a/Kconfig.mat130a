## esp_cam_sensor/sensors/mat130a/Kconfig.mat130a
```kconfig
menuconfig CAMERA_MAT130A
    bool "MAT130A"
    default n
    depends on SOC_LCDCAM_CAM_SUPPORTED
    help
        Enable support for the MAT130A CMOS image sensor.
        The module Flash must contain the vendor DVP firmware matching the
        24 MHz MCLK, 78 MHz PCLK, 1280x720@25fps, YUV422 UYVY profile.

if CAMERA_MAT130A
    menu "Auto detect MAT130A"
        config CAMERA_MAT130A_AUTO_DETECT_DVP_INTERFACE_SENSOR
            bool "Detect for DVP interface sensor"
            default y
            help
                When enabled, the MAT130A sensor will be automatically detected
                and initialized on the DVP interface at startup without requiring
                manual detection call(mat130a_detect) in your application.
    endmenu

    menu "Choose supported formats for DVP interface"
        config CAMERA_MAT130A_DVP_YUV422_1280X720_25FPS
            bool "DVP 8-bit, 24M input, 1280x720 25fps, YUV422 (UYVY)"
            default y
            help
                YUV422(UYVY) color format at 1280x720 resolution (HD) with 25fps framerate.
                Requires 8-bit DVP interface with 24MHz input clock.
                Profile supplied for the MAT130A module: about 78 MHz PCLK,
                mirror/flip disabled.
    endmenu

    choice CAMERA_MAT130A_DVP_DEFAULT_FMT
        prompt "Select default output format for DVP interface"
        default CAMERA_MAT130A_DVP_DEFAULT_FMT_YUV422_1280X720_25FPS
        help
            This option allows you to select the default video format for the MAT130A sensor
            when it is initialized on the DVP interface. The selected format will be used
            when the sensor is detected and initialized, and can be changed later when the
            sensor is in stream off state.

        config CAMERA_MAT130A_DVP_DEFAULT_FMT_YUV422_1280X720_25FPS
            bool "DVP 8-bit, 24M input, 1280x720 25fps, YUV422 (UYVY)"
            depends on CAMERA_MAT130A_DVP_YUV422_1280X720_25FPS
    endchoice # CAMERA_MAT130A_DVP_DEFAULT_FMT

    config CAMERA_MAT130A_DVP_IF_FORMAT_INDEX_DEFAULT
        int
        default 0 if CAMERA_MAT130A_DVP_DEFAULT_FMT_YUV422_1280X720_25FPS
        help
            Sets the default configuration for the DVP interface.
            Use query_support_formats() API to get more format options.
endif
```

## esp_video/examples/software_aov/deep_sleep/main/Kconfig.projbuild
```kconfig
menu "Example Configuration"
    config EXAMPLE_SLEEP_TIME_MS
        int "Deep sleep time (ms)"
        default 1000
        range 1 86400000
        help
            Timer wakeup interval after one frame is captured.
            The unit is milliseconds. The timer starts when deep sleep begins.
            The full software AOV cycle is this interval plus camera init and capture time.

    config EXAMPLE_CT_MIN
        int "Minimum color temperature (K)"
        default 3000
        range 2000 20000
        help
            Cold boot keeps streaming until the IPA color temperature is at least this value.
            The saved state is what makes the first frame after the next wakeup usable.

    config EXAMPLE_CT_MAX
        int "Maximum color temperature (K)"
        default 8000
        range EXAMPLE_CT_MIN 20000
        help
            Cold boot keeps streaming until the IPA color temperature is at most this value.

    config EXAMPLE_CT_WAIT_MS
        int "Color temperature wait timeout (ms)"
        default 30000
        range 1000 300000
        help
            Give up this boot if color temperature is still outside the range after this time.
            The device does not save IPA state and does not enter deep sleep.

    config EXAMPLE_RECV_TIMEOUT_MS
        int "Frame receive timeout (ms)"
        default 1000
        range 10 60000
        help
            DQBUF timeout. During the cold-boot color-temperature wait, each DQBUF uses
            the smaller of this value and the remaining wait deadline.
endmenu
```

## esp_video/examples/software_aov/light_sleep/main/Kconfig.projbuild
```kconfig
menu "Example Configuration"
    config EXAMPLE_SLEEP_TIME_MS
        int "Light sleep time (ms)"
        default 1000
        range 1 86400000
        help
            How long to stay in light sleep after one frame is captured.
            The unit is milliseconds. The timer starts when esp_light_sleep_start()
            is called. The full software AOV cycle is this interval plus one capture.

    config EXAMPLE_CT_MIN
        int "Minimum color temperature (K)"
        default 3000
        range 2000 20000
        help
            After init, keep streaming until the IPA color temperature is at least this value.
            Later captures reuse the registers kept across light sleep.

    config EXAMPLE_CT_MAX
        int "Maximum color temperature (K)"
        default 8000
        range EXAMPLE_CT_MIN 20000
        help
            After init, keep streaming until the IPA color temperature is at most this value.

    config EXAMPLE_CT_WAIT_MS
        int "Color temperature wait timeout (ms)"
        default 30000
        range 1000 300000
        help
            Stop this boot if color temperature is still outside the range after this time.
            The device does not capture a frame and does not enter light sleep.

    config EXAMPLE_RECV_TIMEOUT_MS
        int "Frame receive timeout (ms)"
        default 1000
        range 10 60000
        help
            DQBUF timeout. While waiting for color temperature, each DQBUF uses
            the smaller of this value and the remaining wait deadline.
endmenu
```
