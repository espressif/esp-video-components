## esp_cam_sensor/sensors/sc2336/Kconfig.sc2336
```kconfig
menuconfig CAMERA_SC2336
    bool "SC2336"
    default n
    help
        Enabling this option will add the support for SC2336.

if CAMERA_SC2336
    menuconfig CAMERA_SC2336_AUTO_DETECT
        bool "Auto detect SC2336"
        default y
        help
            When enabled, it provides the ability in application layer to automatically
            detect camera sensors one by one.

    if CAMERA_SC2336_AUTO_DETECT
        config CAMERA_SC2336_AUTO_DETECT_MIPI_INTERFACE_SENSOR
            bool "Detect for MIPI interface sensor"
            default y
            help
                When enabled, you don't need to call sc2336_detect manaually, SC2336 will
                be automatically detected and connected to the MIPI CSI interface when
                the application starts.

        config CAMERA_SC2336_AUTO_DETECT_DVP_INTERFACE_SENSOR
            bool "Detect for DVP interface sensor"
            default n
            help
                When enabled, you don't need to call sc2336_detect manaually, SC2336 will
                be automatically detected and connected to the DVP interface when the
                application starts.
    endif

    config CAMERA_SC2336_MIPI_IF_FORMAT_INDEX_DAFAULT
        int "Default format index for SC2336 MIPI Interface"
        default 8
        range 0 10
        help
            Set the configuration loaded by default for the MIPI CSI interface.
            More information can be obtained by calling the query_support_formats().

    config CAMERA_SC2336_DVP_IF_FORMAT_INDEX_DAFAULT
        int "Default format index for SC2336 DVP Interface"
        default 11
        range 11 11
        help
            Set the configuration loaded by default for the DVP interface.
            More information can be obtained by calling the query_support_formats().

    config CAMERA_SC2336_MAX_SUPPORT
        int "Support for a maximum number of connected SC2336"
        default 1
        range 1 2 if IDF_TARGET_ESP32P4
        range 1 1 if !IDF_TARGET_ESP32P4
        help
            Set the number of connected SC2336.
endif
```

## esp_cam_sensor/sensors/sp0a39/Kconfig.sp0a39
```kconfig
menuconfig CAMERA_SP0A39
    bool "SP0A39"
    default n
    help
        Enabling this option will add the support for SP0A39.

if CAMERA_SP0A39
    menu "Auto detect SP0A39"
        config CAMERA_SP0A39_AUTO_DETECT_DVP_INTERFACE_SENSOR
            bool "Detect for DVP interface sensor"
            default n
            depends on SOC_LCDCAM_CAM_SUPPORTED
            help
                When enabled, the SP0A39 sensor will be automatically detected
                and initialized on the DVP interface at startup without requiring
                manual detection call(sp0a39_detect) in your application.

        config CAMERA_SP0A39_AUTO_DETECT_SPI_INTERFACE_SENSOR
            bool "Detect for SPI interface sensor"
            default n
            help
                When enabled, the SP0A39 sensor will be automatically detected
                and initialized on the SPI interface at startup without requiring
                manual detection call(sp0a39_detect) in your application.
    endmenu

    menu "Choose supported formats for DVP interface"
        depends on SOC_LCDCAM_CAM_SUPPORTED

        config CAMERA_SP0A39_DVP_GRAY_640X480_30FPS
            bool "DVP 8-bit, 24M input, 640x480 30fps, GRAY"
            default y
            help
                Grayscale format at 640x480 resolution (VGA) with 30fps framerate.
                Requires 8-bit DVP interface and 24MHz input.

        config CAMERA_SP0A39_DVP_GRAY_200X200_30FPS
            bool "DVP 8-bit, 24M input, 200x200 30fps, GRAY"
            default n
            help
                Grayscale format at 200x200 resolution with 30fps framerate.
                Requires 8-bit DVP interface and 24MHz input.
    endmenu

    choice CAMERA_SP0A39_DVP_DEFAULT_FMT
        prompt "Select default output format for DVP interface"
        default CAMERA_SP0A39_DVP_DEFAULT_FMT_GRAY_640X480_30FPS
        depends on SOC_LCDCAM_CAM_SUPPORTED
        help
            This is an internal choice that ensures only one format can be selected as default.
            It is automatically controlled by the "Choose supported formats" options above.

        config CAMERA_SP0A39_DVP_DEFAULT_FMT_GRAY_640X480_30FPS
            bool "DVP 8-bit, 24M input, 640x480 30fps, GRAY"
            depends on CAMERA_SP0A39_DVP_GRAY_640X480_30FPS

        config CAMERA_SP0A39_DVP_DEFAULT_FMT_GRAY_200X200_30FPS
            bool "DVP 8-bit, 24M input, 200x200 30fps, GRAY"
            depends on CAMERA_SP0A39_DVP_GRAY_200X200_30FPS
    endchoice # CAMERA_SP0A39_DVP_DEFAULT_FMT

    config CAMERA_SP0A39_DVP_IF_FORMAT_INDEX_DEFAULT
        int
        depends on SOC_LCDCAM_CAM_SUPPORTED
        default 0 if CAMERA_SP0A39_DVP_DEFAULT_FMT_GRAY_640X480_30FPS
        default 1 if CAMERA_SP0A39_DVP_DEFAULT_FMT_GRAY_200X200_30FPS
        help
            Set the configuration loaded by default for the DVP interface.
            More information can be obtained by calling the query_support_formats().

    menu "Choose supported formats for SPI interface"
        config CAMERA_SP0A39_SPI_2BIT_GRAY_640X480_15FPS
            bool "SPI 2-bit, 24M input, 640x480 15fps, GRAY"
            default n
            help
                Grayscale format at 640x480 resolution (VGA) with 15fps framerate.
                Requires SPI 2-bit interface and 24MHz input.

        config CAMERA_SP0A39_SPI_1BIT_GRAY_640X480_4FPS
            bool "SPI 1-bit, 24M input, 640x480 4fps, GRAY"
            default y
            help
                Grayscale format at 640x480 resolution (VGA) with 4fps framerate.
                Requires SPI 1-bit interface and 24MHz input.

        config CAMERA_SP0A39_SPI_4BIT_YUV422_640X480_15FPS
            bool "SPI 4-bit, 24M input, 640x480 15fps, YUV422"
            default n
            help
                YUV422 color format at 640x480 resolution (VGA) with 15fps framerate.
                Requires SPI 4-bit interface and 24MHz input.
    endmenu

    choice CAMERA_SP0A39_SPI_DEFAULT_FMT
        prompt "Select default output format for SPI interface"
        default CAMERA_SP0A39_SPI_DEFAULT_FMT_1BIT_GRAY_640X480_4FPS
        help
            This is an internal choice that ensures only one format can be selected as default.
            It is automatically controlled by the "Choose supported formats" options above.

        config CAMERA_SP0A39_SPI_DEFAULT_FMT_2BIT_GRAY_640X480_15FPS
            bool "SPI 2-bit, 24M input, 640x480 15fps, GRAY"
            depends on CAMERA_SP0A39_SPI_2BIT_GRAY_640X480_15FPS

        config CAMERA_SP0A39_SPI_DEFAULT_FMT_1BIT_GRAY_640X480_4FPS
            bool "SPI 1-bit, 24M input, 640x480 4fps, GRAY"
            depends on CAMERA_SP0A39_SPI_1BIT_GRAY_640X480_4FPS

        config CAMERA_SP0A39_SPI_DEFAULT_FMT_4BIT_YUV422_640X480_15FPS
            bool "SPI 4-bit, 24M input, 640x480 15fps, YUV422"
            depends on CAMERA_SP0A39_SPI_4BIT_YUV422_640X480_15FPS
    endchoice # CAMERA_SP0A39_SPI_DEFAULT_FMT

    config CAMERA_SP0A39_SPI_IF_FORMAT_INDEX_DEFAULT
        int
        default 0 if CAMERA_SP0A39_SPI_DEFAULT_FMT_2BIT_GRAY_640X480_15FPS
        default 1 if CAMERA_SP0A39_SPI_DEFAULT_FMT_1BIT_GRAY_640X480_4FPS
        default 2 if CAMERA_SP0A39_SPI_DEFAULT_FMT_4BIT_YUV422_640X480_15FPS
        help
            Set the configuration loaded by default for the SPI interface.
            More information can be obtained by calling the query_support_formats().
endif
```

## esp_cam_sensor/sensors/sti2250/Kconfig.sti2250
```kconfig
menuconfig CAMERA_STI2250
    bool "STI2250"
    default n
    depends on SOC_MIPI_CSI_SUPPORTED
    help
        Enabling this option will add the support for STI2250.

if CAMERA_STI2250
    menuconfig CAMERA_STI2250_AUTO_DETECT
        bool "Auto detect STI2250"
        default y
        help
            When enabled, it provides the ability in application layer to automatically
            detect camera sensors one by one.

    if CAMERA_STI2250_AUTO_DETECT
        config CAMERA_STI2250_AUTO_DETECT_MIPI_INTERFACE_SENSOR
            bool "Detect for MIPI interface sensor"
            default y
            help
                When enabled, you don't need to call sti2250_detect manually, STI2250 will
                be automatically detected and connected to the MIPI interface when the
                application starts.
    endif

    menu "Choose supported formats for MIPI CSI interface"
        config CAMERA_STI2250_MIPI_RAW8_800X600_50FPS
            bool "MIPI 1-lane, 24M input, 800x600 50fps, RAW8"
            default y
            help
                RAW8 format at 800x600 resolution with 50fps framerate.
                Requires MIPI CSI-2 1-lane interface with 24MHz input clock.
    endmenu

    choice CAMERA_STI2250_MIPI_DEFAULT_FMT
        prompt "Select default output format for MIPI CSI interface"
        default CAMERA_STI2250_MIPI_DEFAULT_FMT_RAW8_800X600_50FPS
        help
            Select the default format to load when the sensor is detected.
            When the sensor is in stream off state, the format can be changed.

        config CAMERA_STI2250_MIPI_DEFAULT_FMT_RAW8_800X600_50FPS
            bool "MIPI 1-lane, 24M input, 800x600 50fps, RAW8"
            depends on CAMERA_STI2250_MIPI_RAW8_800X600_50FPS
    endchoice # CAMERA_STI2250_MIPI_DEFAULT_FMT

    config CAMERA_STI2250_MIPI_IF_FORMAT_INDEX_DEFAULT
        int
        default 0 if CAMERA_STI2250_MIPI_DEFAULT_FMT_RAW8_800X600_50FPS
        help
            Set the configuration loaded by default for the MIPI interface.
            More information can be obtained by calling the query_support_formats().

    choice CAMERA_STI2250_IPA_JSON_CONFIGURATION_FILE
        prompt "IPA Configuration File"
        default CAMERA_STI2250_DEFAULT_IPA_JSON_CONFIGURATION_FILE
        help
            Select the Image Processing Algorithm (IPA) JSON configuration file
            for the STI2250 sensor.

        config CAMERA_STI2250_DEFAULT_IPA_JSON_CONFIGURATION_FILE
            bool "Use default configuration"
            help
                Use the built-in default IPA configuration file:
                "esp_cam_sensor/sensors/STI2250/cfg/STI2250_default.json"

                This configuration provides optimized settings for monochrome
                machine vision applications and is recommended for most use cases.

        config CAMERA_STI2250_CUSTOMIZED_IPA_JSON_CONFIGURATION_FILE
            bool "Use custom configuration"
            help
                Use a custom IPA configuration file with your own optimized settings.

                This option allows you to fine-tune sensor parameters for specific
                lighting conditions, exposure requirements, or application needs.

                You must specify the custom file path in the configuration below.
    endchoice
endif
```

## esp_ipa/Kconfig
```kconfig
menu "Espressif Image Process Algorithm Configuration"

    config ESP_IPA_CONFIG_PARAM_VERSION
        int
        default 1

    config ESP_IPA_IAN_ALGORITHM
        bool "Image Analyze Algorithm"
        default y

    config ESP_IPA_ADN_ALGORITHM
        bool "Auto Denoising Algorithm"
        default y

    config ESP_IPA_AWB_ALGORITHM
        bool "Auto White Balance Algorithm"
        default y

    config ESP_IPA_ACC_ALGORITHM
        bool "Auto Color Correction Algorithm"
        default y

    config ESP_IPA_AGC_ALGORITHM
        bool "Auto Gain Control Algorithm"
        default y

    config ESP_IPA_AEN_ALGORITHM
        bool "Auto Enhancement Algorithm"
        default y

    config ESP_IPA_AF_ALGORITHM
        bool "Auto Focus Algorithm"
        default y

    config ESP_IPA_ATC_ALGORITHM
        bool "Auto Sensor AE Target Level Control Algorithm"
        default y

    config ESP_IPA_EXT_CONFIG
        bool "Extended Configuration"
        default y

    choice ESP_IPA_DETECT_METHOD
        prompt "Choose IPA detection method"
        default ESP_IPA_DETECT_METHOD_DYNAMIC_LINK
        help
            Specify how the IPA detection functions are included in the firmware.

        config ESP_IPA_DETECT_METHOD_DYNAMIC_LINK
            bool "Dynamic linking of IPA detection functions"
            help
                Automatically include all available IPA detection functions in firmware via
                the esp_ipa_detect section in flash memory.

                In this mode, the linker retains all detection functions, even if they are not
                explicitly referenced by the application code. This ensures that auto-detection
                works for all supported IPAs but will increase the overall firmware size.

        config ESP_IPA_DETECT_METHOD_STATIC_STORE
            bool "Static inclusion of IPA detection objects"
            help
                Only include the detection functions for IPAs that are actually referenced by
                the application, with data stored in a flash-based C-language array.

                With this mode, if detection functions are unused in your application, the linker
                will exclude them from the final firmware, resulting in a smaller binary size.
    endchoice
endmenu
```

## esp_ipa/test_apps/dummy/sdkconfig.defaults
```kconfig
CONFIG_IDF_TARGET="esp32p4"
CONFIG_ESPTOOLPY_FLASHMODE_QIO=y
CONFIG_ESP32P4_REV_MIN_0=y
CONFIG_ESP_TASK_WDT_EN=n
```

## esp_ipa/test_apps/registry_consumer/sdkconfig.defaults
```kconfig
CONFIG_IDF_TARGET="esp32p4"
CONFIG_ESPTOOLPY_FLASHMODE_QIO=y
CONFIG_ESP32P4_REV_MIN_0=y
CONFIG_ESP_TASK_WDT_EN=n
# IDF 6.1 P4 bootloader exceeds 24 KiB slot at default partition offset 0x8000
CONFIG_PARTITION_TABLE_OFFSET=0x10000
```
