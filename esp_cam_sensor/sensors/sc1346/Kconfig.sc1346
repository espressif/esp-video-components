## esp_video/examples/uvc/main/Kconfig.projbuild
```kconfig
menu "Example Configuration"

    if FORMAT_MJPEG_CAM1
        config EXAMPLE_JPEG_COMPRESSION_QUALITY
            int "JPEG Compression Quality"
            default 80
            range 1 100
            help
                JPEG compression quality, higher value means higher output
                image quality.
    endif

    if FORMAT_H264_CAM1
        config EXAMPLE_H264_I_PERIOD
            int "H.264 Intra Frame period"
            default 120
            range 1 120
            help
                H.264 I-Frame period.
        
        config EXAMPLE_H264_BITRATE
            int "H.264 Bitrate"
            default 1000000
            range 25000 2500000
            help
                H.264 bitrate.
        
        config EXAMPLE_H264_MIN_QP
            int "H.264 Minimum Quality"
            default 25
            range 1 51
            help
                H.264 minimum quality, the value should be less than H.264 maximum quality.

        config EXAMPLE_H264_MAX_QP
            int "H.264 Maximum Quality"
            default 26
            range 1 51
            help
                H.264 maximum quality, the value should be larger than H.264 minimum quality.
    endif
endmenu
```

## esp_video/examples/v4l2_cmd/main/Kconfig.projbuild
```kconfig
menu "Example Configuration"

    choice EXAMPLE_STORAGE_MEDIA
        prompt "Storage media type"
        default EXAMPLE_STORAGE_MEDIA_SDMMC
        help
            Select the storage media that will be exposed to the USB host as a mass storage device.

            The selected storage will appear as a removable drive on the connected computer,
            allowing direct file access through the USB Mass Storage Class (MSC) interface.

        config EXAMPLE_STORAGE_MEDIA_SPIFLASH
            bool "SPI Flash memory"
            help
                Use internal SPI flash memory as the storage medium.

                Benefits:
                - Always available on ESP32 devices
                - Fast access speeds
                - No external hardware required

                Limitations:
                - Limited storage capacity
                - Shared with firmware and other data

                Best for: Small file storage, testing, or embedded applications.

        config EXAMPLE_STORAGE_MEDIA_SDMMC
            bool "SD/MMC card"
            depends on IDF_TARGET_ESP32P4
            help
                Use external SD/MMC card as the storage medium.

                Benefits:
                - Large storage capacity (up to several TB)
                - Removable media for data transfer
                - Standard filesystem support

                Requirements:
                - SD card slot hardware
                - Proper GPIO pin configuration

                Best for: Large file storage, video recording, or data logging.
    endchoice

    config EXAMPLE_V4L2_CMD_PROMPT
        string "Command Line Prompt"
        default "video:>"
        help
            Set the command line prompt string displayed in the console.

    config EXAMPLE_V4L2_CMD_CTL
        bool "v4l2-ctl"
        default y
        select TINYUSB_MSC_ENABLED
        help
            Enable the "v4l2-ctl" command to control V4L2 video devices.

    config EXAMPLE_V4L2_CMD_BF
        bool "v4l2-bf"
        default y
        depends on ESP_VIDEO_ENABLE_ISP_VIDEO_DEVICE
        help
            Enable the "v4l2-bf" command to control the Bayer filter (BF) of the ISP hardware pipeline.

    config EXAMPLE_V4L2_CMD_CCM
        bool "v4l2-ccm"
        default y
        depends on ESP_VIDEO_ENABLE_ISP_VIDEO_DEVICE
        help
            Enable the "v4l2-ccm" command to control the color correction matrix (CCM) of the ISP hardware pipeline.

    config EXAMPLE_V4L2_CMD_GAMMA
        bool "v4l2-gamma"
        default y
        depends on ESP_VIDEO_ENABLE_ISP_VIDEO_DEVICE
        help
            Enable the "v4l2-gamma" command to control the gamma correction of the ISP hardware pipeline.
endmenu
```

## esp_video/examples/video_custom_format/main/Kconfig.projbuild
```kconfig
menu "Example Configuration"

    choice EXAMPLE_SELECT_SENSOR_FORMAT
        prompt "Choose supported format"
        default APP_CAMERA_BF3901_SPI_YUV422_120X160_10FPS
        help
            Select format for your sensor.

        config APP_CAMERA_BF3901_SPI_YUV422_120X160_10FPS
            bool "(BF3901) SPI 1-bit, 24M input, 120x160 10fps, YUV422(UYVY)"
            depends on CAMERA_BF3901
            help
                YUV422(UYVY) color format at 120x160 resolution with 10fps framerate.
                Requires 1-bit SPI interface with 24MHz input clock.

        config APP_CAMERA_BF3901_SPI_YUV422_YUYV_120X160_10FPS
            bool "(BF3901) SPI 1-bit, 24M input, 120x160 10fps, YUV422(YUYV)"
            depends on CAMERA_BF3901
            help
                YUV422(YUYV) color format at 120x160 resolution with 10fps framerate.
                Requires 1-bit SPI interface with 24MHz input clock.

        config APP_CAMERA_BF3901_SPI_RGB565_240X320_15FPS
            bool "(BF3901) SPI 1-bit, 24M input, 240x320 15fps, RGB565(LE)"
            depends on CAMERA_BF3901
            help
                RGB565(LE) color format at 240x320 resolution with 15fps framerate.
                Requires 1-bit SPI interface with 24MHz input clock.

        config APP_CAMERA_SC2336_MIPI_RAW8_800X800_30FPS
            bool "(SC2336) MIPI 2-lane, 24M input,  800x800  30fps, RAW8"
            depends on CAMERA_SC2336
            help
                RAW8 color format at 800x800 resolution with 30fps framerate.
                Requires MIPI CSI-2 2-lane interface with 24MHz input clock.
    endchoice
endmenu
```

## esp_video/src/data_reprocessing/esp32p4/Kconfig.data_reprocessing
```kconfig
menu "Video Data Preprocessing"

config ESP_VIDEO_ENABLE_SWAP_SHORT
    bool "Enable Swapping Short"
    default y
    select ESP_VIDEO_ENABLE_DATA_PREPROCESSING
    help
        Select this option, enable swapping short data,
        for example:
        
            Data address:     0x0     0x2     0x4     0x6

            Original data: 0x0100, 0x0302, 0x0504, 0x0706
            Swapped data:  0x0302, 0x0100, 0x0706, 0x0504

if ESP_VIDEO_ENABLE_SWAP_SHORT

choice ESP_VIDEO_ENABLE_SWAP_SHORT_IMPL
    prompt "Swapping Short Implement"
    default ESP_VIDEO_ENABLE_SWAP_SHORT_RISCV
    help
        RISC-V assembly instruction and processor instruction extension(PIE)
        are much faster than hardware bitscrambler, but they use the
        CPU to swap data.

        Although the hardware bitscrambler is much slower, it uses a
        peripheral to swap data, so it doesn't use the CPU.

    config ESP_VIDEO_ENABLE_SWAP_SHORT_RISCV
        bool "RISC-V Assembly Instruction"
    
    config ESP_VIDEO_ENABLE_SWAP_SHORT_PIE
        bool "Processor Instruction Extension(PIE)(Experimental)"
    
    config ESP_VIDEO_ENABLE_SWAP_SHORT_BITSCRAMBLER
        bool "Hardware Bitscrambler(Experimental)"
        select ESP_VIDEO_ENABLE_BITSCRAMBLER
        depends on SOC_BITSCRAMBLER_SUPPORTED
endchoice # ESP_VIDEO_ENABLE_SWAP_SHORT_IMPL

choice ESP_VIDEO_ENABLE_SWAP_SHORT_BITSCRAMBLER_PERIPHERAL
    prompt "Bitscrambler Peripheral"
    default ESP_VIDEO_ENABLE_SWAP_SHORT_BITSCRAMBLER_PARL_IO
    depends on ESP_VIDEO_ENABLE_SWAP_SHORT_BITSCRAMBLER
    help
        Select the peripheral not used in your project for bitscrambler.

        Please note that ADC, I2C, I3C, UHCI, and RMT are much slower than
        parallel I/O, LCD_CAM, SPI, AES, and SHA.

    config ESP_VIDEO_ENABLE_SWAP_SHORT_BITSCRAMBLER_PARL_IO
        bool "Parallel I/O"
    
    config ESP_VIDEO_ENABLE_SWAP_SHORT_BITSCRAMBLER_LCD_CAM
        bool "LCD_CAM"
    
    config ESP_VIDEO_ENABLE_SWAP_SHORT_BITSCRAMBLER_GPSPI2
        bool "GPSPI2"
    
    config ESP_VIDEO_ENABLE_SWAP_SHORT_BITSCRAMBLER_GPSPI3
        bool "GPSPI3"
    
    config ESP_VIDEO_ENABLE_SWAP_SHORT_BITSCRAMBLER_AES
        bool "AES"

    config ESP_VIDEO_ENABLE_SWAP_SHORT_BITSCRAMBLER_SHA
        bool "SHA"

    config ESP_VIDEO_ENABLE_SWAP_SHORT_BITSCRAMBLER_ADC
        bool "ADC"

    config ESP_VIDEO_ENABLE_SWAP_SHORT_BITSCRAMBLER_I2S0
        bool "I2S0"

    config ESP_VIDEO_ENABLE_SWAP_SHORT_BITSCRAMBLER_I2S1
        bool "I2S1"

    config ESP_VIDEO_ENABLE_SWAP_SHORT_BITSCRAMBLER_I2S2
        bool "I2S2"

    config ESP_VIDEO_ENABLE_SWAP_SHORT_BITSCRAMBLER_I3C_MST
        bool "I3C_MST"

    config ESP_VIDEO_ENABLE_SWAP_SHORT_BITSCRAMBLER_UHCI
        bool "UHCI"

    config ESP_VIDEO_ENABLE_SWAP_SHORT_BITSCRAMBLER_RMT
        bool "RMT"
endchoice # ESP_VIDEO_ENABLE_SWAP_SHORT_BITSCRAMBLER_PERIPHERAL

config ESP_VIDEO_ENABLE_SWAP_SHORT_PERF_LOG
    bool "Enable Swapping Short Performance Log"
    default n
    help
        Select this option to print swapping short performance log.

config ESP_VIDEO_SWAP_SHORT_PERF_LOG_INTERVAL_US
    int "Swapping Short Performance Log Interval(Microsecond)"
    default 1000000
    depends on ESP_VIDEO_ENABLE_SWAP_SHORT_PERF_LOG
    help
        The time interval for the swapping short to print performance information,
        and the unit is a microsecond.

endif # ESP_VIDEO_ENABLE_SWAP_SHORT
endmenu
```
