## esp_video/Kconfig
```kconfig
menu "Espressif Video Configuration"

    config ESP_VIDEO_ENABLE_H264_VIDEO_DEVICE
        bool
        default n

    config ESP_VIDEO_ENABLE_JPEG_VIDEO_DEVICE
        bool
        default n

    config ESP_VIDEO_ENABLE_ISP
        bool
        default n

    config ESP_VIDEO_ENABLE_BITSCRAMBLER
        bool
        default n
        depends on SOC_BITSCRAMBLER_SUPPORTED
    
    config ESP_VIDEO_ENABLE_DATA_PREPROCESSING
        bool
        default n

    config ESP_VIDEO_CHECK_PARAMETERS
        bool "Check Video Function Parameters"
        default y
        help
            Select this option, espressif video core functions will check
            input parameters.

    menuconfig ESP_VIDEO_ENABLE_MIPI_CSI_VIDEO_DEVICE
        bool "Enable MIPI-CSI based Video Device"
        depends on SOC_MIPI_CSI_SUPPORTED
        default y
        select ESP_VIDEO_ENABLE_ISP
        help
            Select this option, enable MIPI-CSI based video device.

    if ESP_VIDEO_ENABLE_MIPI_CSI_VIDEO_DEVICE

        config ESP_VIDEO_DISABLE_MIPI_CSI_DRIVER_BACKUP_BUFFER
            bool "Disable MIPI-CSI Driver Backup Buffer"
            default y
            help
                Select this option, esp-video disables MIPI-CSI driver backup buffer,
                and always reserves a block of video buffer for MIPI-CSI driver to
                receive data.

                In this mode, video buffer number must > 1.
    endif

    menuconfig ESP_VIDEO_ENABLE_DVP_VIDEO_DEVICE
        bool "Enable DVP based Video Device"
        depends on SOC_LCDCAM_CAM_SUPPORTED
        default y
        help
            Select this option, enable DVP based video device.

    menuconfig ESP_VIDEO_ENABLE_SPI_VIDEO_DEVICE
        bool "Enable SPI based Video Device"
        depends on SOC_GPSPI_SUPPORTED
        select ESP_VIDEO_ENABLE_DATA_PREPROCESSING
        default n
        help
            Select this option, enable SPI based video device.

    menuconfig ESP_VIDEO_ENABLE_HW_H264_VIDEO_DEVICE
        bool "Enable Hardware H.264 based Video Device"
        depends on IDF_TARGET_ESP32P4
        select ESP_VIDEO_ENABLE_H264_VIDEO_DEVICE
        default n
        help
            Select this option, enable hardware H.264 based video device.

    menuconfig ESP_VIDEO_ENABLE_HW_JPEG_VIDEO_DEVICE
        bool "Enable Hardware JPEG based Video Device"
        depends on IDF_TARGET_ESP32P4
        select ESP_VIDEO_ENABLE_JPEG_VIDEO_DEVICE
        default n
        help
            Select this option, enable hardware JPEG based video device.

    menuconfig ESP_VIDEO_ENABLE_ISP_VIDEO_DEVICE
        bool "Enable ISP based Video Device"
        depends on SOC_ISP_SUPPORTED
        default y
        select ESP_VIDEO_ENABLE_ISP
        help
            Select this option, enable ISP based video device. When using
            camera sensor's internal ISP, this option can be disable.

    if ESP_VIDEO_ENABLE_ISP_VIDEO_DEVICE

        config ESP_VIDEO_ENABLE_ISP_PIPELINE_CONTROLLER
            bool "Enable ISP Pipeline Controller"
            default n
            help
                Select this option, enable ISP pipeline controller by creating
                the task "isp_task". This task reads statistics from the ISP
                statistics module, passes statistics to the image process algorithm
                module, and writes calculated data to the ISP or sensor.

        if ESP_VIDEO_ENABLE_ISP_PIPELINE_CONTROLLER

            config ISP_PIPELINE_CONTROLLER_TASK_STACK_USE_PSRAM
                bool "ISP Controller Task Stack Use PSRAM"
                default n
                depends on SPIRAM
                select FREERTOS_TASK_CREATE_ALLOW_EXT_MEM
                help
                    Select this option to use PSRAM for the ISP controller task stack instead of DRAM.
                    Default is 'n' because using DRAM provides better performance and avoids potential
                    issues with PSRAM availability or access speed.
        
            config ESP_VIDEO_ISP_PIPELINE_CONTROL_CAMERA_MOTOR
                bool "ISP Pipeline Control Camera Motor"
                default y
                depends on ESP_VIDEO_ENABLE_CAMERA_MOTOR_CONTROLLER && ESP_IPA_AF_ALGORITHM
                help
                    Select this option, ISP pipeline controller will control the camera motor by IPA AF algorithm.
        endif
    endif

    config ESP_VIDEO_ENABLE_CAMERA_MOTOR_CONTROLLER
        bool "Enable Camera Motor Controller"
        default y
        depends on CAMERA_MOTOR_DEVICE_USED
        help
            Select this option, enable camera motor controller to set the focus of the camera.

    if IDF_TARGET_ESP32P4
        rsource "./src/data_reprocessing/$IDF_TARGET/Kconfig.data_reprocessing"
    endif
endmenu
```

## esp_video/examples/capture_stream/main/Kconfig.projbuild
```kconfig
menu "Example Configuration"

    choice EXAMPLE_VIDEO_BUFFER_TYPE
        prompt "Video Buffer Type"
        default EXAMPLE_VIDEO_BUFFER_TYPE_USER
        depends on EXAMPLE_ENABLE_MIPI_CSI_CAM_SENSOR
        help
            Select video buffer type:
            
            - User buffer, users should allocate and free the buffer manually
            - Driver buffer, drivers allocate and free the buffer automatically

        config EXAMPLE_VIDEO_BUFFER_TYPE_USER
            bool "User Buffer"

        config EXAMPLE_VIDEO_BUFFER_TYPE_DRIVER
            bool "Driver Buffer"
    endchoice

    config EXAMPLE_ENABLE_CAM_SENSOR_PIC_VFLIP
        bool "Enable Camera Sensor Picture Vertical Flip"
        default n
        help
            Select this option, enable camera sensor picture vertical flip.

    config EXAMPLE_ENABLE_CAM_SENSOR_PIC_HFLIP
        bool "Enable Camera Sensor Picture Horizontal Flip"
        default n
        help
            Select this option, enable camera sensor picture horizontal flip.
endmenu
```

## esp_video/examples/image_storage/sd_card/main/Kconfig.projbuild
```kconfig
menu "Example Configuration"
    menu "Video Encoding Configuration"
        choice EXAMPLE_ENCODING_FORMAT
            bool "Video encoding format"
            default EXAMPLE_FORMAT_MJPEG
            help
                Select the video encoding format for storing captured images/video.

                - MJPEG: Motion JPEG, stores each frame as a separate JPEG image
                - H.264: Advanced video compression for efficient storage and streaming

            config EXAMPLE_FORMAT_MJPEG
                bool "MJPEG (Motion JPEG)"
                help
                    Motion JPEG format stores video as a sequence of JPEG images.

                    Benefits:
                    - Simple format, easy to process
                    - Each frame is independently decodable
                    - Good compatibility with image viewers
                    - Lower CPU encoding requirements

                    Best for: Image sequences, simple video storage, or when
                    individual frame access is important.

            config EXAMPLE_FORMAT_H264
                bool "H.264 (Advanced Video Coding)"
                help
                    H.264 is a modern video compression standard providing
                    excellent compression efficiency.

                    Benefits:
                    - High compression efficiency (smaller file sizes)
                    - Industry-standard format
                    - Good streaming compatibility
                    - Configurable quality and bitrate

                    Best for: Video streaming, long recordings, or when
                    storage space efficiency is important.
        endchoice

        if EXAMPLE_FORMAT_MJPEG
            config EXAMPLE_JPEG_COMPRESSION_QUALITY
                int "JPEG compression quality (%)"
                default 80
                range 1 100
                help
                    JPEG compression quality percentage (1-100).

                    Higher values produce better image quality but larger file sizes:
                    - 90-100: Excellent quality, large files
                    - 70-90: Good quality, moderate file size (recommended)
                    - 50-70: Acceptable quality, smaller files
                    - 1-50: Poor quality, very small files

                    Recommended: 80 for a good balance of quality and file size.
        endif

        if EXAMPLE_FORMAT_H264
            config EXAMPLE_H264_I_PERIOD
                int "H.264 Intra Frame period (frames)"
                default 120
                range 1 120
                help
                    Number of frames between Intra (I) frames in the H.264 stream.

                    I-frames are complete, independently decodable frames that serve
                    as reference points for the video stream.

                    Smaller values (10-30):
                    - Better seek performance and error recovery
                    - Larger file sizes
                    - Better for streaming applications

                    Larger values (60-120):
                    - Better compression efficiency
                    - Smaller file sizes
                    - Suitable for storage applications

            config EXAMPLE_H264_BITRATE
                int "H.264 Target Bitrate (bps)"
                default 1000000
                range 25000 2500000
                help
                    Target bitrate for H.264 encoding in bits per second.

                    Higher bitrates produce better quality but larger files:
                    - 500,000 bps (500 kbps): Low quality, small files
                    - 1,000,000 bps (1 Mbps): Good quality (recommended)
                    - 2,000,000 bps (2 Mbps): High quality
                    - 5,000,000+ bps (5+ Mbps): Very high quality, large files

                    Consider your storage capacity and network bandwidth when choosing.

            config EXAMPLE_H264_MIN_QP
                int "H.264 Minimum quantization parameter (QP)"
                default 25
                range 1 51
                help
                    Minimum quantization parameter for H.264 encoding.

                    Lower QP values produce higher quality (and larger file sizes).
                    This sets the highest quality limit the encoder can achieve.

                    Typical values:
                    - 1-18: Lossless to very high quality
                    - 19-23: High quality (recommended minimum)
                    - 24-28: Good quality
                    - 29+: Lower quality

            config EXAMPLE_H264_MAX_QP
                int "H.264 Maximum quantization parameter (QP)"
                default 26
                range EXAMPLE_H264_MIN_QP 51
                help
                    Maximum quantization parameter for H.264 encoding.

                    Higher QP values produce lower quality (and smaller file sizes).
                    This sets the lowest quality limit to maintain target bitrate.

                    Must be greater than or equal to minimum QP.

                    Typical values:
                    - 23-28: High to good quality
                    - 29-35: Good to acceptable quality (recommended maximum)
                    - 36-45: Acceptable to poor quality
                    - 46-51: Poor quality
        endif
    endmenu
endmenu
```
