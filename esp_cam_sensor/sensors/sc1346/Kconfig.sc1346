## esp_video/examples/image_storage/usb_msc/main/Kconfig.projbuild
```kconfig
menu "Example Configuration"
    menu "TinyUSB Mass Storage Configuration"
        choice EXAMPLE_STORAGE_MEDIA
            prompt "Storage media type"
            default EXAMPLE_STORAGE_MEDIA_SPIFLASH
            help
                Select the storage media that will be exposed to the USB host as a mass storage device.

                The selected storage will appear as a removable drive on the connected computer,
                allowing direct file access through the USB Mass Storage Class (MSC) interface.

            config EXAMPLE_STORAGE_MEDIA_SPIFLASH
                bool "SPI Flash memory"
                help
                    Use internal SPI flash memory as the storage medium.

                    Benefits:
                    - Always available on ESP32 devices
                    - Fast access speeds
                    - No external hardware required

                    Limitations:
                    - Limited storage capacity
                    - Shared with firmware and other data

                    Best for: Small file storage, testing, or embedded applications.

            config EXAMPLE_STORAGE_MEDIA_SDMMC
                bool "SD/MMC card"
                depends on IDF_TARGET_ESP32P4
                help
                    Use external SD/MMC card as the storage medium.

                    Benefits:
                    - Large storage capacity (up to several TB)
                    - Removable media for data transfer
                    - Standard filesystem support

                    Requirements:
                    - SD card slot hardware
                    - Proper GPIO pin configuration

                    Best for: Large file storage, video recording, or data logging.
        endchoice

    endmenu

    menu "Video Storage Configuration"
        choice EXAMPLE_STORAGE_IMAGE_FORMAT
            bool "Image/video storage format"
            default EXAMPLE_FORMAT_MJPEG
            help
                Select the format for storing captured images or video data.

                Different formats offer various trade-offs between file size,
                quality, and processing requirements.

            config EXAMPLE_FORMAT_MJPEG
                bool "MJPEG (Motion JPEG)"
                help
                    Motion JPEG format stores video as a sequence of JPEG images.

                    Benefits:
                    - Simple format, easy to process
                    - Each frame is independently decodable
                    - Good compatibility with image viewers
                    - Lower CPU encoding requirements

                    Best for: Image sequences, simple video storage, or when
                    individual frame access is important.

            config EXAMPLE_FORMAT_H264
                bool "H.264 (Advanced Video Coding)"
                help
                    H.264 is a modern video compression standard providing
                    excellent compression efficiency.

                    Benefits:
                    - High compression efficiency (smaller file sizes)
                    - Industry-standard format
                    - Good streaming compatibility
                    - Configurable quality and bitrate

                    Best for: Video streaming, long recordings, or when
                    storage space efficiency is important.

            config EXAMPLE_FORMAT_NON_ENCODE
                bool "Raw/uncompressed format"
                help
                    Store images in raw, uncompressed format without encoding.

                    Benefits:
                    - No compression artifacts
                    - Maximum image quality
                    - No encoding CPU overhead
                    - Direct sensor output

                    Limitations:
                    - Very large file sizes
                    - Limited compatibility with standard viewers

                    Best for: Image analysis, post-processing, or when
                    maximum quality is required.
        endchoice

        if EXAMPLE_FORMAT_MJPEG
            config EXAMPLE_JPEG_COMPRESSION_QUALITY
                int "JPEG compression quality (%)"
                default 80
                range 1 100
                help
                    JPEG compression quality percentage (1-100).

                    Higher values produce better image quality but larger file sizes:
                    - 90-100: Excellent quality, large files
                    - 70-90: Good quality, moderate file size (recommended)
                    - 50-70: Acceptable quality, smaller files
                    - 1-50: Poor quality, very small files

                    Recommended: 80 for a good balance of quality and file size.
        endif

        if EXAMPLE_FORMAT_H264
            config EXAMPLE_H264_I_PERIOD
                int "H.264 Intra Frame period (frames)"
                default 120
                range 1 120
                help
                    Number of frames between Intra (I) frames in the H.264 stream.

                    I-frames are complete, independently decodable frames that serve
                    as reference points for the video stream.

                    Smaller values (10-30):
                    - Better seek performance and error recovery
                    - Larger file sizes
                    - Better for streaming applications

                    Larger values (60-120):
                    - Better compression efficiency
                    - Smaller file sizes
                    - Suitable for storage applications

            config EXAMPLE_H264_BITRATE
                int "H.264 Target bitrate (bps)"
                default 1000000
                range 25000 2500000
                help
                    Target bitrate for H.264 encoding in bits per second.

                    Higher bitrates produce better quality but larger files:
                    - 500,000 bps (500 kbps): Low quality, small files
                    - 1,000,000 bps (1 Mbps): Good quality (recommended)
                    - 2,000,000 bps (2 Mbps): High quality
                    - 5,000,000+ bps (5+ Mbps): Very high quality, large files

                    Consider your storage capacity when choosing.

            config EXAMPLE_H264_MIN_QP
                int "H.264 Minimum quantization parameter (QP)"
                default 25
                range 1 51
                help
                    Minimum quantization parameter for H.264 encoding.

                    Lower QP values produce higher quality (and larger file sizes).
                    This sets the highest quality limit the encoder can achieve.

                    Typical values:
                    - 1-18: Lossless to very high quality
                    - 19-23: High quality (recommended minimum)
                    - 24-28: Good quality
                    - 29+: Lower quality

            config EXAMPLE_H264_MAX_QP
                int "H.264 Maximum quantization parameter (QP)"
                default 26
                range EXAMPLE_H264_MIN_QP 51
                help
                    Maximum quantization parameter for H.264 encoding.

                    Higher QP values produce lower quality (and smaller file sizes).
                    This sets the lowest quality limit to maintain target bitrate.

                    Must be greater than or equal to minimum QP.

                    Typical values:
                    - 23-28: High to good quality
                    - 29-35: Good to acceptable quality (recommended maximum)
                    - 36-45: Acceptable to poor quality
                    - 46-51: Poor quality
        endif

        config EXAMPLE_SKIP_STARTUP_FRAME_COUNT
            int "Skip Camera Sensor Startup Frame Count"
            default 6
            help
                Number of initial frames to skip after camera sensor startup.

                Camera sensors usually require several frames after power-up or mode
                change before the image exposure/brightness stabilizes.
                Skipping these startup frames can avoid saving blurry or incorrectly
                exposed images at the beginning of capture.

                Increase this value if your captured images appear unstable or inconsistent
                at startup. The default value is 6.
    endmenu
endmenu
```

## esp_video/examples/m2m/main/Kconfig.projbuild
```kconfig
menu "Example Configuration"

    choice EXAMPLE_M2M_MODE
        prompt "M2M test mode"
        default EXAMPLE_M2M_MODE_DECODE
        help
            Select whether to run hardware encode or decode pipeline test.

        config EXAMPLE_M2M_MODE_ENCODE
            bool "Encode (capture -> codec)"
            depends on ESP_VIDEO_ENABLE_JPEG_ENC_VIDEO_DEVICE || ESP_VIDEO_ENABLE_H264_VIDEO_DEVICE

        config EXAMPLE_M2M_MODE_DECODE
            bool "Decode (JPEG capture -> decode)"
            depends on ESP_VIDEO_ENABLE_JPEG_DEC_VIDEO_DEVICE

        config EXAMPLE_M2M_MODE_PIPELINE
            bool "Pipeline (JPEG capture -> decode -> H.264 encode)"
            depends on ESP_VIDEO_ENABLE_JPEG_DEC_VIDEO_DEVICE && ESP_VIDEO_ENABLE_H264_VIDEO_DEVICE
    endchoice

    config EXAMPLE_TEST_DURATION_SEC
        int "Frame rate test duration (seconds)"
        default 5
        range 1 60
        help
            Duration in seconds for each frame rate measurement.

    if EXAMPLE_M2M_MODE_ENCODE || EXAMPLE_M2M_MODE_PIPELINE
        menu "Video Encoding Configuration"
            if EXAMPLE_M2M_MODE_ENCODE
                config EXAMPLE_JPEG_COMPRESSION_QUALITY
                    int "JPEG compression quality (%)"
                    default 80
                    range 1 100
                    depends on ESP_VIDEO_ENABLE_JPEG_ENC_VIDEO_DEVICE
                    help
                        JPEG compression quality percentage (1-100).
            endif

            if EXAMPLE_M2M_MODE_PIPELINE || ESP_VIDEO_ENABLE_H264_VIDEO_DEVICE
                config EXAMPLE_H264_I_PERIOD
                    int "H.264 Intra Frame period (frames)"
                    default 120
                    range 1 120

                config EXAMPLE_H264_BITRATE
                    int "H.264 Target Bitrate (bps)"
                    default 1000000
                    range 25000 2500000

                config EXAMPLE_H264_MIN_QP
                    int "H.264 Minimum quantization parameter (QP)"
                    default 25
                    range 1 51

                config EXAMPLE_H264_MAX_QP
                    int "H.264 Maximum quantization parameter (QP)"
                    default 26
                    range EXAMPLE_H264_MIN_QP 51
            endif
        endmenu
    endif
endmenu
```

## esp_video/examples/m2m/sdkconfig.defaults
```kconfig
CONFIG_ESP_VIDEO_ENABLE_USB_UVC_VIDEO_DEVICE=y
CONFIG_ESP_VIDEO_ENABLE_HW_JPEG_DEC_VIDEO_DEVICE=y
CONFIG_ESP_VIDEO_ENABLE_HW_JPEG_ENC_VIDEO_DEVICE=y

CONFIG_MAIN_TASK_STACK_SIZE=5120

CONFIG_USB_HOST_CONTROL_TRANSFER_MAX_SIZE=1024

CONFIG_VFS_MAX_COUNT=12
```

## esp_video/examples/simple_video_server/main/Kconfig.projbuild
```kconfig
menu "Example Configuration"
    
    config EXAMPLE_CAMERA_VIDEO_BUFFER_NUMBER
        int "Camera video buffer number"
        default 2
        help
            Number of video buffers for the camera sensor.
            
            More buffers provide better performance and reduce frame drops,
            but consume more memory. Recommended range: 2-4 buffers.
            
            - 2 buffers: Minimum for basic operation
            - 3-4 buffers: Better performance for smooth streaming
            - Higher values: May improve performance but increase memory usage

    config EXAMPLE_JPEG_COMPRESSION_QUALITY
        int "JPEG compression quality (%)"
        default 80
        range 1 100
        help
            JPEG compression quality percentage (1-100).

            Higher values produce better image quality but larger data streams:
            - 90-100: Excellent quality, high bandwidth usage
            - 70-90: Good quality, moderate bandwidth (recommended for UVC)
            - 50-70: Acceptable quality, lower bandwidth
            - 1-50: Poor quality, minimal bandwidth

            For UVC streaming, consider the USB bandwidth limitations
            and host system capabilities when choosing quality level.

            Recommended: 80 for balanced quality and performance.

    config EXAMPLE_HTTP_PART_BOUNDARY
        string "HTTP part boundary"
        default "123456789000000000000987654321"
        help
            HTTP multipart boundary string used for MJPEG streaming.
            
            This boundary separates different parts in the HTTP multipart response.
            Must be unique and not appear in the video data. The default value
            is designed to be unique and safe for most applications.
    
    config EXAMPLE_MDNS_INSTANCE
        string "mDNS instance"
        default "web-cam"
        help
            mDNS instance name for service discovery.
            
            This name will be used to identify the camera service on the network.
            Other devices can discover this camera using this instance name
            through mDNS/Bonjour protocols.
    
    config EXAMPLE_MDNS_HOST_NAME
        string "mDNS host name"
        default "esp-web"
        help
            mDNS host name for the ESP32 device.
            
            This hostname will be used for network identification and can be
            accessed as "esp-web.local" on the local network (if mDNS is supported
            by the client device).

    config EXAMPLE_ENABLE_MIPI_CSI_CROP
        bool "Enable crop for MIPI-CSI video device"
        default n
        depends on EXAMPLE_ENABLE_MIPI_CSI_CAM_SENSOR && SOC_ISP_CROP_SUPPORTED
    
    if EXAMPLE_ENABLE_MIPI_CSI_CROP
        config EXAMPLE_MIPI_CSI_CROP_TOP_LEFT_H
            int "Crop region top-left horizontal coordinate"
            default 0
            help
                Horizontal coordinate of the top-left corner for the crop.
                Must be an even number and less than bottom-right horizontal coordinate.

        config EXAMPLE_MIPI_CSI_CROP_TOP_LEFT_V
            int "Crop region top-left vertical coordinate"
            default 0
            help
                Vertical coordinate of the top-left corner for the crop.
                Must be an even number and less than bottom-right vertical coordinate.

        config EXAMPLE_MIPI_CSI_CROP_WIDTH
            int "Crop region width"
            default 640
            help
                Width of the crop region in pixels.
                Must be greater than 0 and not exceed the sensor output width.

        config EXAMPLE_MIPI_CSI_CROP_HEIGHT
            int "Crop region height"
            default 480
            help
                Height of the crop region in pixels.
                Must be greater than 0 and not exceed the sensor output height.
    endif
endmenu
```
