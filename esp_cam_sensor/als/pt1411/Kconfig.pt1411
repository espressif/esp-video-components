## esp_cam_sensor/sensors/mit245/Kconfig.mit245
```kconfig
menuconfig CAMERA_MIT245
    bool "MIT245"
    default n
    depends on SOC_MIPI_CSI_SUPPORTED
    help
        Enable support for the MIT245 CMOS image sensor.

if CAMERA_MIT245
    menu "Auto detect MIT245"
        config CAMERA_MIT245_AUTO_DETECT_MIPI_INTERFACE_SENSOR
            bool "Detect for MIPI CSI interface sensor"
            default y
            depends on SOC_MIPI_CSI_SUPPORTED
            help
                Automatically detect and initialize MIT245 on the MIPI CSI interface.
    endmenu

    menu "Choose supported formats for MIPI CSI interface"
        depends on SOC_MIPI_CSI_SUPPORTED

        config CAMERA_MIT245_MIPI_RAW8_1920X1080_30FPS
            bool "MIPI 2-lane, 24M input, 1920x1080 30fps, RAW8"
            default y
            help
                RAW8 color format at 1920x1080 resolution with 30fps framerate.
                Requires MIPI CSI-2 2-lane interface with 24MHz input clock.

        config CAMERA_MIT245_MIPI_RAW10_1920X1080_30FPS
            bool "MIPI 2-lane, 24M input, 1920x1080 30fps, RAW10"
            default n
            help
                RAW10 color format at 1920x1080 resolution with 30fps framerate.
                Requires MIPI CSI-2 2-lane interface with 24MHz input clock.
    endmenu

    choice CAMERA_MIT245_MIPI_DEFAULT_FMT
        prompt "Select default output format for MIPI CSI interface"
        default CAMERA_MIT245_MIPI_DEFAULT_FMT_RAW8_1920X1080_30FPS
        depends on SOC_MIPI_CSI_SUPPORTED

        config CAMERA_MIT245_MIPI_DEFAULT_FMT_RAW8_1920X1080_30FPS
            bool "MIPI 2-lane, 24M input, 1920x1080 30fps, RAW8"
            depends on CAMERA_MIT245_MIPI_RAW8_1920X1080_30FPS

        config CAMERA_MIT245_MIPI_DEFAULT_FMT_RAW10_1920X1080_30FPS
            bool "MIPI 2-lane, 24M input, 1920x1080 30fps, RAW10"
            depends on CAMERA_MIT245_MIPI_RAW10_1920X1080_30FPS
    endchoice

    config CAMERA_MIT245_MIPI_IF_FORMAT_INDEX_DEFAULT
        int
        depends on SOC_MIPI_CSI_SUPPORTED
        default 0 if CAMERA_MIT245_MIPI_DEFAULT_FMT_RAW8_1920X1080_30FPS
        default 1 if CAMERA_MIT245_MIPI_DEFAULT_FMT_RAW10_1920X1080_30FPS
        help
            Sets the default configuration for the MIPI CSI interface.

    config CAMERA_MIT245_ABSOLUTE_GAIN_LIMIT
        int "Maximum absolute gain limit (x1000)"
        default 20000
        range 1000 26000
        help
            Maximum combined analog and digital gain multiplied by 1000.
            MIT245 gain table currently covers up to 26x.

    choice CAMERA_MIT245_IPA_JSON_CONFIGURATION_FILE
        prompt "IPA Configuration File"
        default CAMERA_MIT245_DEFAULT_IPA_JSON_CONFIGURATION_FILE

        config CAMERA_MIT245_DEFAULT_IPA_JSON_CONFIGURATION_FILE
            bool "Use default configuration"
            help
                Use the bundled provisional MIT245 IPA configuration.

        config CAMERA_MIT245_CUSTOMIZED_IPA_JSON_CONFIGURATION_FILE
            bool "Use custom configuration"
            help
                Use a calibrated MIT245 IPA JSON file supplied by the user.
    endchoice

    config CAMERA_MIT245_CUSTOMIZED_IPA_JSON_CONFIGURATION_FILE_PATH
        string "Custom IPA configuration file path"
        depends on CAMERA_MIT245_CUSTOMIZED_IPA_JSON_CONFIGURATION_FILE
        help
            Path relative to the project root.
endif
```

## esp_cam_sensor/sensors/sc132gs/Kconfig.sc132gs
```kconfig
menuconfig CAMERA_SC132GS
    bool "SC132GS"
    default n
    depends on SOC_MIPI_CSI_SUPPORTED
    help
        Enabling this option will add the support for SC132GS.

if CAMERA_SC132GS
    menu "Auto detect SC132GS"
        config CAMERA_SC132GS_AUTO_DETECT_MIPI_INTERFACE_SENSOR
            bool "Detect for MIPI CSI interface sensor"
            default y
            depends on SOC_MIPI_CSI_SUPPORTED
            help
                When enabled, the SC132GS sensor will be automatically detected
                and initialized on the MIPI CSI interface at startup without requiring
                manual detection call(sc132gs_detect) in your application.
    endmenu

    choice CAMERA_SC132GS_SCCB_DEFAULT_ID
        prompt "Select default sccb ID"
        default CAMERA_SC132GS_SCCB_ID_33
        help
            This option allows you to select the default sccb ID for the SC132GS sensor.

        config CAMERA_SC132GS_SCCB_ID_30
            bool "0x30"

        config CAMERA_SC132GS_SCCB_ID_31
            bool "0x31"

        config CAMERA_SC132GS_SCCB_ID_32
            bool "0x32"
        
        config CAMERA_SC132GS_SCCB_ID_33
            bool "0x33"
    endchoice # CAMERA_SC132GS_SCCB_DEFAULT_ID

    menu "Choose supported formats for MIPI CSI interface"
        config CAMERA_SC132GS_MIPI_RAW10_544X640_60FPS
            bool "MIPI 2-lane, 24M input, 544x640 60fps, RAW10"
            default n
            help
                RAW10 format at 544x640 resolution with 60fps framerate.
                Requires MIPI CSI-2 2-lane interface with 24MHz input clock.

        config CAMERA_SC132GS_MIPI_RAW10_1080X1280_60FPS
            bool "MIPI 2-lane, 24M input, 1080x1280 60fps, RAW10"
            default y
            help
                RAW10 format at 1080x1280 resolution with 60fps framerate.
                Requires MIPI CSI-2 2-lane interface with 24MHz input clock.
    endmenu

    choice CAMERA_SC132GS_MIPI_DEFAULT_FMT
        prompt "Select default output format for MIPI CSI interface"
        default CAMERA_SC132GS_MIPI_DEFAULT_FMT_RAW10_544X640_60FPS
        help
            This option allows you to select the default video format for the SC132GS sensor
            when it is initialized on the MIPI CSI interface. The selected format will be used
            when the sensor is detected and initialized, and can be changed later when the
            sensor is in stream off state.

        config CAMERA_SC132GS_MIPI_DEFAULT_FMT_RAW10_544X640_60FPS
            bool "MIPI 2-lane, 24M input, 544x640 60fps, RAW10"
            depends on CAMERA_SC132GS_MIPI_RAW10_544X640_60FPS

        config CAMERA_SC132GS_MIPI_DEFAULT_FMT_RAW10_1080X1280_60FPS
            bool "MIPI 2-lane, 24M input, 1080x1280 60fps, RAW10"
            depends on CAMERA_SC132GS_MIPI_RAW10_1080X1280_60FPS
    endchoice # CAMERA_SC132GS_MIPI_DEFAULT_FMT

    config CAMERA_SC132GS_MIPI_IF_FORMAT_INDEX_DEFAULT
        int
        default 0 if CAMERA_SC132GS_MIPI_DEFAULT_FMT_RAW10_544X640_60FPS
        default 1 if CAMERA_SC132GS_MIPI_DEFAULT_FMT_RAW10_1080X1280_60FPS
        help
            Sets the default configuration for the MIPI CSI interface.
            Use query_support_formats() API to get more format options.

    config CAMERA_SC132GS_ABSOLUTE_GAIN_LIMIT
            int "Maximum absolute gain limit"
            default 26281
            range 4000 28547
            help
                Use this value to limit the maximum gain that upper level applications can use.
                To avoid using float type, the size of this value is gain x 1000.
                Excessive gain can lead to a worse signal-to-noise ratio and may cause the device to overheat, affecting its functionality.

    choice CAMERA_SC132GS_IPA_JSON_CONFIGURATION_FILE
        prompt "IPA JSON Configuration File"
        default CAMERA_SC132GS_DEFAULT_IPA_JSON_CONFIGURATION_FILE
        help
            Select SC132GS JSON configuration file.

        config CAMERA_SC132GS_DEFAULT_IPA_JSON_CONFIGURATION_FILE
            bool "Default"
            help
                Use the "esp_cam_sensor/sensors/sc132gs/cfg/sc132gs_default.json".

        config CAMERA_SC132GS_CUSTOMIZED_IPA_JSON_CONFIGURATION_FILE
            bool "Customized"
            help
                Use a customized SC132GS JSON configuration file. Users should configure
                the file's path using the option "CAMERA_SC132GS_CUSTOMIZED_IPA_JSON_CONFIGURATION_FILE_PATH."
    endchoice

    config CAMERA_SC132GS_CUSTOMIZED_IPA_JSON_CONFIGURATION_FILE_PATH
        string "SC132GS Customized JSON Configuration File Path"
        depends on CAMERA_SC132GS_CUSTOMIZED_IPA_JSON_CONFIGURATION_FILE
        help
            Customized SC132GS JSON configuration file's path and this path is evaluated
            relative to the project root directory by default.
endif
```

## esp_cam_sensor/sensors/sc2337p/Kconfig.sc2337p
```kconfig
menuconfig CAMERA_SC2337P
    bool "SC2337P"
    default n
    depends on SOC_MIPI_CSI_SUPPORTED
    help
        Enable support for the SC2337P CMOS image sensor.

if CAMERA_SC2337P
    menu "Auto detect SC2337P"
        config CAMERA_SC2337P_AUTO_DETECT_MIPI_INTERFACE_SENSOR
            bool "Detect for MIPI CSI interface sensor"
            default y
            help
                When enabled, the SC2337P sensor will be automatically detected
                and initialized on the MIPI CSI interface at startup without requiring
                manual detection call(sc2337p_detect) in your application.
    endmenu

    config CAMERA_SC2337P_SID_HIGH
        bool "Set SID pin to high"
        default n
        help
            This option allows you to configure the sensor ID. When the SID pin uses a high level,
            the sensor ID will be configured as 0x32, otherwise, the sensor ID will be configured as 0x30.

    menu "Choose supported formats for MIPI CSI interface"
        config CAMERA_SC2337P_MIPI_RAW10_1088X1080_30FPS
            bool "MIPI 2-lane, 24M input, 1088x1080 30fps, RAW10"
            default y
            help
                RAW10 color format at 1088x1080 resolution with 30fps framerate.
                Requires MIPI CSI-2 2-lane interface with 24MHz input clock.

        config CAMERA_SC2337P_MIPI_RAW10_1920X1080_30FPS
            bool "MIPI 2-lane, 24M input, 1920x1080 30fps, RAW10"
            default n
            help
                RAW10 color format at 1920x1080 resolution (FHD) with 30fps framerate.
                Requires MIPI CSI-2 2-lane interface with 24MHz input clock.

        config CAMERA_SC2337P_MIPI_RAW8_1920X1080_30FPS
            bool "MIPI 2-lane, 24M input, 1920x1080 30fps, RAW8"
            default n
            help
                RAW8 color format at 1920x1080 resolution (FHD) with 30fps framerate.
                Requires MIPI CSI-2 2-lane interface with 24MHz input clock.
    endmenu

    choice CAMERA_SC2337P_MIPI_DEFAULT_FMT
        prompt "Select default output format for MIPI CSI interface"
        default CAMERA_SC2337P_MIPI_DEFAULT_FMT_RAW10_1088X1080_30FPS
        help
            This option allows you to select the default video format for the SC2337P sensor
            when it is initialized on the MIPI CSI interface. The selected format will be used
            when the sensor is detected and initialized, and can be changed later when the
            sensor is in stream off state.

        config CAMERA_SC2337P_MIPI_DEFAULT_FMT_RAW10_1088X1080_30FPS
            bool "MIPI 2-lane, 24M input, 1088x1080 30fps, RAW10"
            depends on CAMERA_SC2337P_MIPI_RAW10_1088X1080_30FPS

        config CAMERA_SC2337P_MIPI_DEFAULT_FMT_RAW10_1920X1080_30FPS
            bool "MIPI 2-lane, 24M input, 1920x1080 30fps, RAW10"
            depends on CAMERA_SC2337P_MIPI_RAW10_1920X1080_30FPS

        config CAMERA_SC2337P_MIPI_DEFAULT_FMT_RAW8_1920X1080_30FPS
            bool "MIPI 2-lane, 24M input, 1920x1080 30fps, RAW8"
            depends on CAMERA_SC2337P_MIPI_RAW8_1920X1080_30FPS
    endchoice # CAMERA_SC2337P_MIPI_DEFAULT_FMT

    config CAMERA_SC2337P_MIPI_IF_FORMAT_INDEX_DEFAULT
        int
        default 0 if CAMERA_SC2337P_MIPI_DEFAULT_FMT_RAW10_1088X1080_30FPS
        default 1 if CAMERA_SC2337P_MIPI_DEFAULT_FMT_RAW10_1920X1080_30FPS
        default 2 if CAMERA_SC2337P_MIPI_DEFAULT_FMT_RAW8_1920X1080_30FPS
        help
            Sets the default configuration for the MIPI CSI interface.
            Use query_support_formats() API to get more format options.

    config CAMERA_SC2337P_ABSOLUTE_GAIN_LIMIT
            int "Maximum absolute gain limit (x1000)"
            default 66016
            range 4000 126016
            help
                Set the maximum gain limit that can be applied by upper-level applications.

                Value is gain multiplied by 1000 to avoid floating-point arithmetic:
                - 4000 = 4x gain (minimum)
                - 66016 = 66.016x gain (default)
                - 126016 = 126.016x gain (maximum)

                Lower values reduce noise but may limit low-light performance.
                Higher values improve low-light sensitivity but increase noise and
                may cause sensor overheating.

                Recommended values:
                - 32000 (32x): Good balance for most applications
                - 66016 (66x): Enhanced low-light performance
                - 126016 (126x): Maximum sensitivity (use with caution)

    choice CAMERA_SC2337P_ABS_GAIN_MAP_PRIORITY
        prompt "Gain control priority"
        default CAMERA_SC2337P_ANA_GAIN_PRIORITY
        help
            Select the gain control strategy to balance image quality and noise.

            The gain mapping affects noise levels and brightness transition smoothness.
            Analog gain generally produces less noise than digital gain, but digital
            gain provides smoother brightness transitions.

        config CAMERA_SC2337P_ANA_GAIN_PRIORITY
            bool "Analog gain priority"
            help
                Prioritize analog gain over digital gain for noise reduction.
        config CAMERA_SC2337P_DIG_GAIN_PRIORITY
            bool "Digital gain priority"
            help
                Prioritize digital gain over analog gain for smooth transitions.
    endchoice # CAMERA_SC2337P_ABS_GAIN_MAP_PRIORITY

    choice CAMERA_SC2337P_IPA_JSON_CONFIGURATION_FILE
        prompt "IPA Configuration File"
        default CAMERA_SC2337P_DEFAULT_IPA_JSON_CONFIGURATION_FILE
        help
            Select the Image Processing Algorithm (IPA) JSON configuration file
            for the SC2337P sensor.

        config CAMERA_SC2337P_DEFAULT_IPA_JSON_CONFIGURATION_FILE
            bool "Use default configuration"
            help
                Use the built-in default IPA configuration file:
                "esp_cam_sensor/sensors/sc2337p/cfg/sc2337p_default.json"

                This configuration provides optimized settings for general use cases
                and is recommended for most applications.

        config CAMERA_SC2337P_CUSTOMIZED_IPA_JSON_CONFIGURATION_FILE
            bool "Use custom configuration"
            help
                Use a custom IPA configuration file with your own optimized settings.

                This option allows you to fine-tune sensor parameters for specific
                lighting conditions, color requirements, or application needs.

                You must specify the custom file path in the configuration below.
    endchoice

    config CAMERA_SC2337P_CUSTOMIZED_IPA_JSON_CONFIGURATION_FILE_PATH
        string "Custom IPA configuration file path"
        depends on CAMERA_SC2337P_CUSTOMIZED_IPA_JSON_CONFIGURATION_FILE
        help
            Specify the path to your custom SC2337P IPA JSON configuration file.

            The path is relative to your project root directory.

            Example: "components/my_camera_config/sc2337p_custom.json"

            Ensure the file exists and contains valid JSON configuration
            parameters compatible with the SC2337P sensor.
endif
```
