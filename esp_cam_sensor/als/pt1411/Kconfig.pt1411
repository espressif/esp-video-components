## esp_cam_sensor/sensors/tc358743/Kconfig.tc358743
```kconfig
menuconfig CAMERA_TC358743
    bool "TC358743"
    default n
    depends on SOC_MIPI_CSI_SUPPORTED
    help
        Enable support for the TC358743 HDMI To MIPI-CSI bridge sensor.

if CAMERA_TC358743
    menu "Auto detect TC358743"
        config CAMERA_TC358743_AUTO_DETECT_MIPI_INTERFACE_SENSOR
            bool "Detect for MIPI interface sensor"
            default y
            help
                When enabled, the TC358743 sensor will be automatically detected
                and initialized on the MIPI interface at startup without requiring
                manual detection call(tc358743_detect) in your application.
    endmenu
    
    menu "Choose supported formats for MIPI interface"
        config CAMERA_TC358743_MIPI_RGB888_1920X1080_30FPS
            bool "MIPI 2-lane, 27M input, 1920x1080 30fps, RGB888"
            default y if IDF_TARGET_ESP32P4
            default y
            help
                RGB888 color format at 1920x1080 resolution (1080p)
                with 30fps framerate. Requires MIPI CSI-2 2-lane interface with 27MHz input clock.

        config CAMERA_TC358743_MIPI_YUV422_1920X1080_30FPS
            bool "MIPI 2-lane, 27M input, 1920x1080 30fps, YUV422"
            default n
            help
                YUV422(UYVY) color format at 1920x1080 resolution (1080p)
                with 30fps framerate. Requires MIPI CSI-2 2-lane interface with 27MHz input clock.
    endmenu

    choice CAMERA_TC358743_MIPI_DEFAULT_FMT
        prompt "Select default output format for MIPI interface"
        default CAMERA_TC358743_MIPI_DEFAULT_FMT_RGB888_1920X1080_30FPS
        help
            This is an internal choice that ensures only one format can be selected as default.
            It is automatically controlled by the "Set as default format" options above.

        config CAMERA_TC358743_MIPI_DEFAULT_FMT_RGB888_1920X1080_30FPS
            bool "MIPI 2-lane, 27M input, 1920x1080 30fps, RGB888"
            depends on CAMERA_TC358743_MIPI_RGB888_1920X1080_30FPS

        config CAMERA_TC358743_MIPI_DEFAULT_FMT_YUV422_1920X1080_30FPS
            bool "MIPI 2-lane, 27M input, 1920x1080 30fps, YUV422"
            depends on CAMERA_TC358743_MIPI_YUV422_1920X1080_30FPS
    endchoice # CAMERA_TC358743_MIPI_DEFAULT_FMT

    config CAMERA_TC358743_MIPI_IF_FORMAT_INDEX_DEFAULT
        int
        default 0 if CAMERA_TC358743_MIPI_DEFAULT_FMT_RGB888_1920X1080_30FPS
        default 1 if CAMERA_TC358743_MIPI_DEFAULT_FMT_YUV422_1920X1080_30FPS
        help
            Sets the default configuration for the MIPI interface.
            Use query_support_formats() API to get more format options.
endif
```

## esp_cam_sensor/test_apps/detect/sdkconfig.defaults.esp32p4
```kconfig
CONFIG_CAMERA_SC2336=y

CONFIG_SPIRAM_SPEED_200M=y

CONFIG_CAM_ALS_PT1411=y  

CONFIG_CAM_LED_IR2835=y
  
```

## esp_sccb_intf/Kconfig
```kconfig
menu "Espressif SCCB Configurations"

    config ESP_SCCB_TRANS_TIMEOUT_DEFAULT
    int "SCCB transmit wait timeout in ms"
    range -1 2000
    default 500
    help
        Timeout for SCCB transmit In ms.
        Use -1 to disable timeout and wait forever.

endmenu
```

## esp_video/examples/fast_startup/deep_sleep/main/Kconfig.projbuild
```kconfig
menu "Example Configuration"
    config EXAMPLE_CT_MIN
        int "Minimum color temperature (K)"
        default 3000
        range 2000 20000
        help
            Cold boot keeps streaming until the IPA color temperature is at least this value.

    config EXAMPLE_CT_MAX
        int "Maximum color temperature (K)"
        default 8000
        range EXAMPLE_CT_MIN 20000
        help
            Cold boot keeps streaming until the IPA color temperature is at most this value.

    config EXAMPLE_CT_WAIT_MS
        int "Color temperature wait timeout (ms)"
        default 30000
        range 1000 300000
        help
            Give up this boot if color temperature is still outside the range after this time.
            The device does not save IPA state and does not enter deep sleep.

    config EXAMPLE_RECV_TIMEOUT_MS
        int "Frame receive timeout (ms)"
        default 1000
        range 10 60000
        help
            DQBUF timeout applied to the camera and JPEG devices after open, and used while
            recycling frames until color temperature is in range. During color-temperature
            wait, each DQBUF uses the smaller of this value and the remaining wait deadline.
            One frame that does not arrive within that time stops this boot.

    config EXAMPLE_SLEEP_TIME_SEC
        int "Deep sleep time (seconds)"
        default 10
        range 1 86400
        help
            Timer wakeup interval after the IPA state has been stored in RTC memory.

    config EXAMPLE_JPEG_COMPRESSION_QUALITY
        int "JPEG compression quality (%)"
        default 80
        range 1 100
        help
            JPEG quality of the first frame saved after wakeup.

    config EXAMPLE_IMAGE_FILE_NAME
        string "Image file name"
        default "fast_startup_deep_sleep"
        help
            Base name of the JPEG saved after wakeup.
            The file is stored as <mount point>/<name>_no.<index>.jpg.
            The index is a 4-digit number kept in RTC memory and increases after a successful write.
endmenu
```

## esp_video/examples/fast_startup/deep_sleep/sdkconfig.defaults.esp32p4
```kconfig
CONFIG_BOOTLOADER_LOG_LEVEL_ERROR=y
CONFIG_BOOTLOADER_SKIP_VALIDATE_IN_DEEP_SLEEP=y
CONFIG_BOOT_ROM_LOG_ALWAYS_OFF=y

CONFIG_CAMERA_SC2336=y
CONFIG_CAMERA_SC2336_MIPI_RAW8_1280X720_30FPS=n
CONFIG_CAMERA_SC2336_MIPI_RAW8_1920X1080_30FPS=y

CONFIG_ESPTOOLPY_FLASHMODE_QIO=y
CONFIG_ESPTOOLPY_FLASHSIZE_16MB=y

CONFIG_ESP_CONSOLE_USB_SERIAL_JTAG=y

CONFIG_ESP_VIDEO_ENABLE_DVP_VIDEO_DEVICE=n
CONFIG_ESP_VIDEO_ENABLE_ISP_PIPELINE_CONTROLLER=y

CONFIG_EXAMPLE_SELECT_ESP32P4_FUNCTION_EV_BOARD_V1_5=y
CONFIG_EXAMPLE_MIPI_CSI_SCCB_I2C_FREQ=400000

CONFIG_IDF_EXPERIMENTAL_FEATURES=y

CONFIG_LOG_DEFAULT_LEVEL_ERROR=y
CONFIG_LOG_MAXIMUM_LEVEL_WARN=y

CONFIG_SPIRAM=y
CONFIG_SPIRAM_SPEED_250M=y
CONFIG_SPIRAM_MEMTEST=n
```

## esp_video/examples/fast_startup/nvs/main/Kconfig.projbuild
```kconfig
menu "Example Configuration"
    config EXAMPLE_STABLE_FRAMES
        int "Stable frames in a row"
        default 6
        range 2 100
        help
            The IPA counts as stable when exposure, gain and color temperature have each
            stayed within their tolerance for this many frames in a row. The AGC holds
            for exposure_frame_delay/gain_frame_delay frames after every update (3 for
            SC2336), so keep this value larger than that delay.

    config EXAMPLE_STABLE_AE_TOL_PCT
        int "Stable tolerance: exposure and gain (%)"
        default 2
        range 0 100
        help
            Largest frame-to-frame change of exposure and of sensor gain that still counts
            as stable. 0 requires the values to stay exactly the same.

    config EXAMPLE_STABLE_CT_TOL_K
        int "Stable tolerance: color temperature (K)"
        default 300
        range 0 5000
        help
            Largest frame-to-frame change of the AWB color temperature that still counts
            as stable. Not checked when the AWB does not publish a color temperature
            (only AWB model 2 with export_ct does).

    config EXAMPLE_STABLE_WAIT_MS
        int "Stable wait timeout (ms)"
        default 30000
        range 1000 300000
        help
            Give up waiting for the IPA to become stable after this time. Cold boot then
            stops without a picture. Warm boot keeps its picture and leaves the NVS cache
            unchanged.

    config EXAMPLE_RECV_TIMEOUT_MS
        int "Frame receive timeout (ms)"
        default 1000
        range 10 60000
        help
            DQBUF timeout applied to the camera and JPEG devices after open. One frame
            that does not arrive within that time stops this boot.

    config EXAMPLE_CACHE_BRIGHTNESS_DIFF_PCT
        int "NVS rewrite threshold: brightness change (%)"
        default 20
        range 1 1000
        help
            Rewrite the NVS cache when the AGC total gain (exposure and sensor gain
            together) differs from the cached value by at least this percentage.
            Larger values mean fewer flash writes.

    config EXAMPLE_CACHE_CT_DIFF_K
        int "NVS rewrite threshold: color temperature change (K)"
        default 300
        range 1 20000
        help
            Rewrite the NVS cache when the color temperature differs from the cached value
            by at least this amount. Larger values mean fewer flash writes.

    config EXAMPLE_JPEG_COMPRESSION_QUALITY
        int "JPEG compression quality (%)"
        default 80
        range 1 100
        help
            JPEG quality of the saved picture.

    config EXAMPLE_IMAGE_FILE_NAME
        string "Image file name"
        default "fast_startup_nvs"
        help
            Base name of the saved JPEG, stored as <mount point>/<name>_no.<index>.jpg.
            Each boot uses the first index whose <name>_no.<index>.jpg does not exist yet.

    config EXAMPLE_SAVE_COLD_FIRST_FRAME
        bool "Save first frame on cold boot"
        default y
        help
            On cold boot, also save the first frame, before the IPA is stable, as
            <name>_no.<index>_cold_first.jpg. Compare it with a warm-boot picture of the
            same scene to see what the NVS cache changes in the first frame.

    config EXAMPLE_RESTART_AFTER_CAPTURE
        bool "Restart after capture"
        default n
        help
            Call esp_restart() after each capture to test the warm path in a loop
            without cutting power.

    config EXAMPLE_RESTART_DELAY_MS
        int "Restart delay (ms)"
        default 3000
        range 0 600000
        depends on EXAMPLE_RESTART_AFTER_CAPTURE
endmenu
```

## esp_video/examples/fast_startup/nvs/sdkconfig.defaults
```kconfig
CONFIG_ESP_VIDEO_ENABLE_HW_JPEG_ENC_VIDEO_DEVICE=y

CONFIG_FATFS_LFN_HEAP=y
CONFIG_FATFS_VFS_FSTAT_BLKSIZE=4096
CONFIG_VFS_MAX_COUNT=15

CONFIG_PARTITION_TABLE_CUSTOM=y
CONFIG_PARTITION_TABLE_CUSTOM_FILENAME="partitions.csv"
```
