## esp_cam_sensor/als/pt1411/Kconfig.pt1411
```kconfig
menuconfig CAM_ALS_PT1411
    bool "PT1411"
    default n
    select CAMERA_ALS_DEVICE_USED
    help
        Enable support for the PT1411 IC.

if CAM_ALS_PT1411        
    config PT1411_DEFAULT_SAMPLE_RATE_TICKS
        int "Default sampling period (FreeRTOS ticks)"
        range 1 10000
        default 50
        help
            Default sampling interval of the timer, in FreeRTOS ticks.
endif
```

## esp_cam_sensor/ircuts/ap1511b/Kconfig.ap1511b
```kconfig
menuconfig CAM_IRCUT_AP1511B
    bool "AP1511B"
    default n
    select CAMERA_IRCUT_DEVICE_USED
    help
        Enable support for the AP1511B IRCUT driver IC.

if CAM_IRCUT_AP1511B        
    config CAM_IRCUT_AP1511B_SWITCH_DELAY_MS
        int "Waiting time for stabilization after switching (milliseconds)"
        range 100 5000
        default 1000
        help
            Set the delay time after switching IRCUT.
            This time is typically related to the size of the capacitor connected to the CE pin and can be affected by temperature and humidity.
            If unsure about the delay time, increase it to ensure sufficient delay.
endif
```

## esp_cam_sensor/leds/ir2835/Kconfig.ir2835
```kconfig
menuconfig CAM_LED_IR2835
    bool "IR2835"
    default n
    select CAMERA_LED_DEVICE_USED
    help
        Enable support for the IR2835 led.
```

## esp_cam_sensor/leds/tcj60/Kconfig.tcj60
```kconfig
menuconfig CAM_LED_TCJ60
    bool "TCJ60"
    default n
    select CAMERA_LED_DEVICE_USED
    help
        Enable support for the TCJ60 white fill light dimmed by LEDC PWM, e.g. driven by a MOSFET or a
        constant current driver with a PWM dimming input. Use ESP_CAM_LED_HW_TYPE_LEDC, the control
        pin is the PWM output and the enable pin is optional.

if CAM_LED_TCJ60
    config CAM_LED_TCJ60_LEDC_TIMER
        int "LEDC timer"
        range 0 3
        default 1
        help
            LEDC low speed timer used by the fill light. It must not be shared with a channel of
            another frequency, e.g. the camera XCLK, which defaults to timer 0 in the examples.

    config CAM_LED_TCJ60_LEDC_CHANNEL
        int "LEDC channel"
        range 0 7
        default 1
        help
            LEDC low speed channel used by the fill light. It must not be used by the camera XCLK,
            which defaults to channel 0 in the examples.

    config CAM_LED_TCJ60_FREQ_HZ
        int "PWM frequency (Hz)"
        range 100 100000
        default 25000
        help
            PWM frequency of the fill light. A frequency well above the frame rate avoids banding in
            the image. The duty resolution is the highest one the LEDC clock allows at this frequency.

    config CAM_LED_TCJ60_OUTPUT_INVERT
        bool "Low level turns the LED on"
        default n
        help
            Invert the PWM output if a low level turns the LED on.
endif
```

## esp_cam_sensor/sensors/bf3031/Kconfig.bf3031
```kconfig
menuconfig CAMERA_BF3031
    bool "BF3031"
    default n
    depends on SOC_LCDCAM_CAM_SUPPORTED
    help
        Enable support for the BF3031 CMOS image sensor.

if CAMERA_BF3031
    menu "Auto detect BF3031"
        config CAMERA_BF3031_AUTO_DETECT_DVP_INTERFACE_SENSOR
            bool "Detect for DVP interface sensor"
            default y
            help
                When enabled, the BF3031 sensor will be automatically detected
                and initialized on the DVP interface at startup without requiring
                manual detection call(bf3031_detect) in your application.
    endmenu

    config CAMERA_BF3031_SID_HIGH
        bool "Set SID pin to high"
        default n
        help
            This option allows you to configure the sensor ID. When the SID pin uses a high level, 
            the sensor ID will be configured as 0x6d, otherwise, the sensor ID will be configured as 0x6e.

    menu "Choose supported formats for DVP interface"
        config CAMERA_BF3031_DVP_YUV422_838X640_25FPS
            bool "DVP 8-bit, 20M input, 838x640 25fps, YUV422"
            default y
            help
                Standard color format using YUV422 at 838x640 resolution
                with 25fps framerate. Requires 8-bit DVP interface and 20MHz input.
    endmenu

    choice CAMERA_BF3031_DVP_DEFAULT_FMT
        prompt "Select default output format for DVP interface"
        default CAMERA_BF3031_DVP_DEFAULT_FMT_YUV422_838X640_25FPS
        help
            This is an internal choice that ensures only one format can be selected as default.
            It is automatically controlled by the "Set as default format" options above.

        config CAMERA_BF3031_DVP_DEFAULT_FMT_YUV422_838X640_25FPS
            bool "DVP 8-bit, 20M input, 838x640 25fps, YUV422"
            depends on CAMERA_BF3031_DVP_YUV422_838X640_25FPS
    endchoice # CAMERA_BF3031_DVP_DEFAULT_FMT

    config CAMERA_BF3031_DVP_IF_FORMAT_INDEX_DEFAULT
        int
        default 0 if CAMERA_BF3031_DVP_DEFAULT_FMT_YUV422_838X640_25FPS
        help
            Sets the default configuration for the DVP interface.
            Use query_support_formats() API to get more format options.
endif
```

## esp_cam_sensor/sensors/gc032a/Kconfig.gc032a
```kconfig
menuconfig CAMERA_GC032A
    bool "GC032A"
    default n
    depends on SOC_LCDCAM_CAM_SUPPORTED
    help
        Enable support for the GC032A CMOS image sensor.

if CAMERA_GC032A
    menu "Auto detect GC032A"
        config CAMERA_GC032A_AUTO_DETECT_DVP_INTERFACE_SENSOR
            bool "Detect for DVP interface sensor"
            default y
            help
                When enabled, the GC032A sensor will be automatically detected
                and initialized on the DVP interface at startup without requiring
                manual detection call(gc032a_detect) in your application.
    endmenu

    menu "Choose supported formats for DVP interface"
        config CAMERA_GC032A_DVP_YUV422_YUYV_640X480_7FPS
            bool "DVP 8-bit, 20M input, 640x480 7fps, YUV422(YUYV)"
            default n
            help
                YUV422(YUYV) color format at 640x480 resolution (VGA) with 7fps framerate.
                Requires 8-bit DVP interface and 20MHz input clock.

        config CAMERA_GC032A_DVP_RGB565_640X480_30FPS
            bool "DVP 8-bit, 24M input, 640x480 30fps, RGB565"
            default y
            help
                RGB565 color format at 640x480 resolution (VGA) with 30fps framerate.
                Requires 8-bit DVP interface and 24MHz input clock.
    endmenu

    choice CAMERA_GC032A_DVP_DEFAULT_FMT
        prompt "Select default output format for DVP interface"
        default CAMERA_GC032A_DVP_DEFAULT_FMT_RGB565_640X480_30FPS
        help
            This option allows you to select the default video format for the GC032A sensor
            when it is initialized on the DVP interface. The selected format will be used
            when the sensor is detected and initialized, and can be changed later when the
            sensor is in stream off state.

        config CAMERA_GC032A_DVP_DEFAULT_FMT_YUV422_YUYV_640X480_7FPS
            bool "DVP 8-bit, 20M input, 640x480 7fps, YUV422(YUYV)"
            depends on CAMERA_GC032A_DVP_YUV422_YUYV_640X480_7FPS

        config CAMERA_GC032A_DVP_DEFAULT_FMT_RGB565_640X480_30FPS
            bool "DVP 8-bit, 24M input, 640x480 30fps, RGB565"
            depends on CAMERA_GC032A_DVP_RGB565_640X480_30FPS
    endchoice # CAMERA_GC032A_DVP_DEFAULT_FMT

    config CAMERA_GC032A_DVP_IF_FORMAT_INDEX_DEFAULT
        int
        default 0 if CAMERA_GC032A_DVP_DEFAULT_FMT_YUV422_YUYV_640X480_7FPS
        default 1 if CAMERA_GC032A_DVP_DEFAULT_FMT_RGB565_640X480_30FPS
        help
            Sets the default configuration for the DVP interface.
            Use query_support_formats() API to get more format options.
endif
```

## esp_cam_sensor/sensors/gc2053/Kconfig.gc2053
```kconfig
menuconfig CAMERA_GC2053
    bool "GC2053"
    default n
    depends on SOC_MIPI_CSI_SUPPORTED
    help
        Enable support for the GC2053 CMOS image sensor.

if CAMERA_GC2053
    menu "Auto detect GC2053"
        config CAMERA_GC2053_AUTO_DETECT_MIPI_INTERFACE_SENSOR
            bool "Detect for MIPI CSI interface sensor"
            default y
            depends on SOC_MIPI_CSI_SUPPORTED
            help
                When enabled, the GC2053 sensor will be automatically detected
                and initialized on the MIPI CSI interface at startup without requiring
                manual detection call(gc2053_detect) in your application.
    endmenu

    menu "Choose supported formats for MIPI CSI interface"
        config CAMERA_GC2053_MIPI_RAW10_1920X1080_30FPS
            bool "MIPI 2-lane, 24M input, 1920x1080 30fps, RAW10"
            default n
            help
                RAW10 color format at 1920x1080 resolution (FHD) with 30fps framerate.
                Requires MIPI CSI-2 2-lane interface with 24MHz input clock.

        config CAMERA_GC2053_MIPI_RAW8_1920X1080_25FPS
            bool "MIPI 2-lane, 24M input, 1920x1080 25fps, RAW8"
            default y
            help
                RAW8 color format at 1920x1080 resolution (FHD) with 25fps framerate.
                Requires MIPI CSI-2 2-lane interface with 24MHz input clock.
    endmenu

    choice CAMERA_GC2053_MIPI_DEFAULT_FMT
        prompt "Select default output format for MIPI CSI interface"
        default CAMERA_GC2053_MIPI_DEFAULT_FMT_RAW10_1920X1080_30FPS
        help
            This option allows you to select the default video format for the GC2053 sensor
            when it is initialized on the MIPI CSI interface. The selected format will be used
            when the sensor is detected and initialized, and can be changed later when the
            sensor is in stream off state.

        config CAMERA_GC2053_MIPI_DEFAULT_FMT_RAW10_1920X1080_30FPS
            bool "MIPI 2-lane, 24M input, 1920x1080 30fps, RAW10"
            depends on CAMERA_GC2053_MIPI_RAW10_1920X1080_30FPS

        config CAMERA_GC2053_MIPI_DEFAULT_FMT_RAW8_1920X1080_25FPS
            bool "MIPI 2-lane, 24M input, 1920x1080 25fps, RAW8"
            depends on CAMERA_GC2053_MIPI_RAW8_1920X1080_25FPS
    endchoice # CAMERA_GC2053_MIPI_DEFAULT_FMT

    config CAMERA_GC2053_MIPI_IF_FORMAT_INDEX_DEFAULT
        int
        default 0 if CAMERA_GC2053_MIPI_DEFAULT_FMT_RAW10_1920X1080_30FPS
        default 1 if CAMERA_GC2053_MIPI_DEFAULT_FMT_RAW8_1920X1080_25FPS
        help
            Sets the default configuration for the MIPI CSI interface.
            Use query_support_formats() API to get more format options.

    choice CAMERA_GC2053_IPA_JSON_CONFIGURATION_FILE
        prompt "IPA Configuration File"
        default CAMERA_GC2053_DEFAULT_IPA_JSON_CONFIGURATION_FILE
        help
            Select the Image Processing Algorithm (IPA) JSON configuration file
            for the GC2053 sensor.

        config CAMERA_GC2053_DEFAULT_IPA_JSON_CONFIGURATION_FILE
            bool "Use default configuration"
            help
                Use the built-in default IPA configuration file:
                "esp_cam_sensor/sensors/gc2053/cfg/gc2053_mono_default.json"

                This configuration provides optimized settings for monochrome
                machine vision applications and is recommended for most use cases.

        config CAMERA_GC2053_CUSTOMIZED_IPA_JSON_CONFIGURATION_FILE
            bool "Use custom configuration"
            help
                Use a custom IPA configuration file with your own optimized settings.

                This option allows you to fine-tune sensor parameters for specific
                lighting conditions, exposure requirements, or application needs.

                You must specify the custom file path in the configuration below.
    endchoice

    config CAMERA_GC2053_CUSTOMIZED_IPA_JSON_CONFIGURATION_FILE_PATH
        string "Custom IPA configuration file path"
        depends on CAMERA_GC2053_CUSTOMIZED_IPA_JSON_CONFIGURATION_FILE
        help
            Specify the path to your custom GC2053 IPA JSON configuration file.

            The path is relative to your project root directory.

            Example: "components/my_camera_config/gc2053_custom.json"

            Ensure the file exists and contains valid JSON configuration
            parameters compatible with the GC2053 global shutter sensor.

    config CAMERA_GC2053_ABSOLUTE_GAIN_LIMIT
        int "Maximum absolute gain limit (x1000)"
        default 15813
        range 1000 61859
        help
            Set the maximum gain limit that can be applied by upper-level applications.

            Value is gain multiplied by 1000 to avoid floating-point arithmetic:
            - 1000 = 1x gain (minimum)
            - 15813 = 15.813x gain (default)

            Lower values reduce noise but may limit low-light performance.
            Higher values improve low-light sensitivity but increase noise and
            may cause sensor overheating.

            Recommended values:
            - 10000 (10x): Good balance for most applications
            - 15813 (15.813x): Default sensitivity
endif
```
