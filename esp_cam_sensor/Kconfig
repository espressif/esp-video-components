## esp_cam_sensor/sensors/bf3045/Kconfig.bf3045
```kconfig
menuconfig CAMERA_BF3045
    bool "BF3045"
    default n
    depends on SOC_LCDCAM_CAM_SUPPORTED
    help
        Enable support for the BF3045 CMOS image sensor.

if CAMERA_BF3045
    menu "Auto detect BF3045"
        config CAMERA_BF3045_AUTO_DETECT_DVP_INTERFACE_SENSOR
            bool "Detect for DVP interface sensor"
            default y
            help
                When enabled, the BF3045 sensor will be automatically detected
                and initialized on the DVP interface at startup without requiring
                manual detection call(bf3045_detect) in your application.
    endmenu

    menu "Choose supported formats for DVP interface"
        config CAMERA_BF3045_DVP_RGB565_BE_640X480_15FPS
            bool "DVP 8-bit, 20M input, 640x480 15fps, RGB565(BE)"
            default y
            help
                Standard color format using RGB565(BE) at 640x480 resolution (VGA)
                with 15fps framerate. Requires 8-bit DVP interface and 20MHz input.
                Only format supported by BF3045.
    endmenu

    choice CAMERA_BF3045_DVP_DEFAULT_FMT
        prompt "Select default output format for DVP interface"
        default CAMERA_BF3045_DVP_DEFAULT_FMT_RGB565_BE_640X480_15FPS
        help
            This is an internal choice that ensures only one format can be selected as default.
            It is automatically controlled by the "Set as default format" options above.

        config CAMERA_BF3045_DVP_DEFAULT_FMT_RGB565_BE_640X480_15FPS
            bool "DVP 8-bit, 20M input, 640x480 15fps, RGB565(BE)"
            depends on CAMERA_BF3045_DVP_RGB565_BE_640X480_15FPS
    endchoice # CAMERA_BF3045_DVP_DEFAULT_FMT

    config CAMERA_BF3045_DVP_IF_FORMAT_INDEX_DEFAULT
        int
        default 0 if CAMERA_BF3045_DVP_DEFAULT_FMT_RGB565_BE_640X480_15FPS
        help
            Sets the default configuration for the DVP interface.
            Use query_support_formats() API to get more format options.
endif
```

## esp_cam_sensor/sensors/bf3901/Kconfig.bf3901
```kconfig
menuconfig CAMERA_BF3901
    bool "BF3901"
    default n
    help
        Enable support for the BF3901 CMOS image sensor.

if CAMERA_BF3901
    menu "Auto detect BF3901"
        config CAMERA_BF3901_AUTO_DETECT_SPI_INTERFACE_SENSOR
            bool "Detect for SPI interface sensor"
            default y
            help
                When enabled, the BF3901 sensor will be automatically detected
                and initialized on the SPI interface at startup without requiring
                manual detection call(bf3901_detect) in your application.
    endmenu

    menu "Choose supported formats for SPI interface"
        config CAMERA_BF3901_SPI_RGB565_240X320_15FPS
            bool "SPI 1-bit, 24M input, 240x320 15fps, RGB565"
            default n
            help
                RGB565 color format at 240x320 resolution with 15fps framerate.
                Requires 1-bit SPI interface with 24MHz input clock.

        config CAMERA_BF3901_SPI_YUV422_120X160_5FPS
            bool "SPI 1-bit, 20M input, 120x160  5fps, YUV422"
            default n
            help
                YUV422 color format at 120x160 resolution with 5fps framerate.
                Requires 1-bit SPI interface with 20MHz input clock.

        config CAMERA_BF3901_SPI_YUV422_240X320_12FPS
            bool "SPI 1-bit, 20M input, 240x320 12fps, YUV422"
            default n
            help
                YUV422 color format at 240x320 resolution with 12fps framerate.
                Requires 1-bit SPI interface with 20MHz input clock.

        config CAMERA_BF3901_SPI_YUV422_120X160_10FPS
            bool "SPI 1-bit, 24M input, 120x160 10fps, YUV422"
            default n
            help
                YUV422 color format at 120x160 resolution with 10fps framerate.
                Requires 1-bit SPI interface with 24MHz input clock.

        config CAMERA_BF3901_SPI_YUV422_240X240_10FPS
            bool "SPI 1-bit, 24M input, 240x240 10fps, YUV422"
            default n
            help
                YUV422 color format at 240x240 resolution with 10fps framerate.
                Requires 1-bit SPI interface with 24MHz input clock.

        config CAMERA_BF3901_SPI_YUV422_240X320_15FPS
            bool "SPI 1-bit, 24M input, 240x320 15fps, YUV422"
            default y
            help
                YUV422 color format at 240x320 resolution with 15fps framerate.
                Requires 1-bit SPI interface with 24MHz input clock.

        config CAMERA_BF3901_SPI2_YUV422_240X320_20FPS
            bool "SPI 2-bit, 24M input, 240x320 20fps, YUV422"
            default n
            help
                YUV422 color format at 240x320 resolution with 20fps framerate.
                Requires 2-bit SPI interface with 24MHz input clock.
    endmenu

    choice CAMERA_BF3901_SPI_DEFAULT_FMT
        prompt "Select default output format for SPI interface"
        default CAMERA_BF3901_SPI_DEFAULT_FMT_YUV422_240X320_15FPS if CAMERA_SENSOR_XCLK_INPUT_24M
        default CAMERA_BF3901_SPI_DEFAULT_FMT_YUV422_120X160_5FPS
        help
            This option allows you to select the default video format for the BF3901 sensor
            when it is initialized on the SPI interface. The selected format will be used
            when the sensor is detected and initialized, and can be changed later when the
            sensor is in stream off state.

        config CAMERA_BF3901_SPI_DEFAULT_FMT_RGB565_240X320_15FPS
            bool "SPI 1-bit, 24M input, 240x320 15fps, RGB565"
            depends on CAMERA_BF3901_SPI_RGB565_240X320_15FPS

        config CAMERA_BF3901_SPI_DEFAULT_FMT_YUV422_120X160_5FPS
            bool "SPI 1-bit, 20M input, 120x160  5fps, YUV422"
            depends on CAMERA_BF3901_SPI_YUV422_120X160_5FPS

        config CAMERA_BF3901_SPI_DEFAULT_FMT_YUV422_240X320_12FPS
            bool "SPI 1-bit, 20M input, 240x320 12fps, YUV422"
            depends on CAMERA_BF3901_SPI_YUV422_240X320_12FPS

        config CAMERA_BF3901_SPI_DEFAULT_FMT_YUV422_120X160_10FPS
            bool "SPI 1-bit, 24M input, 120x160 10fps, YUV422"
            depends on CAMERA_BF3901_SPI_YUV422_120X160_10FPS

        config CAMERA_BF3901_SPI_DEFAULT_FMT_YUV422_240X240_10FPS
            bool "SPI 1-bit, 24M input, 240x240 10fps, YUV422"
            depends on CAMERA_BF3901_SPI_YUV422_240X240_10FPS

        config CAMERA_BF3901_SPI_DEFAULT_FMT_YUV422_240X320_15FPS
            bool "SPI 1-bit, 24M input, 240x320 15fps, YUV422"
            depends on CAMERA_BF3901_SPI_YUV422_240X320_15FPS

        config CAMERA_BF3901_SPI2_DEFAULT_FMT_YUV422_240X320_20FPS
            bool "SPI 2-bit, 24M input, 240x320 20fps, YUV422"
            depends on CAMERA_BF3901_SPI2_YUV422_240X320_20FPS
    endchoice # CAMERA_BF3901_SPI_DEFAULT_FMT

    config CAMERA_BF3901_SPI_IF_FORMAT_INDEX_DEFAULT
        int
        default 0 if CAMERA_BF3901_SPI_DEFAULT_FMT_RGB565_240X320_15FPS
        default 1 if CAMERA_BF3901_SPI_DEFAULT_FMT_YUV422_240X320_15FPS
        default 2 if CAMERA_BF3901_SPI_DEFAULT_FMT_YUV422_240X320_12FPS
        default 3 if CAMERA_BF3901_SPI_DEFAULT_FMT_YUV422_240X240_10FPS
        default 4 if CAMERA_BF3901_SPI_DEFAULT_FMT_YUV422_120X160_10FPS
        default 5 if CAMERA_BF3901_SPI_DEFAULT_FMT_YUV422_120X160_5FPS
        default 6 if CAMERA_BF3901_SPI2_DEFAULT_FMT_YUV422_240X320_20FPS
        help
            Sets the default configuration for the SPI interface.
            Use query_support_formats() API to get more format options.
endif
```

## esp_cam_sensor/sensors/bf3a03/Kconfig.bf3a03
```kconfig
menuconfig CAMERA_BF3A03
    bool "BF3A03"
    default n
    depends on SOC_LCDCAM_CAM_SUPPORTED
    help
        Enable support for the BF3A03 CMOS image sensor.

if CAMERA_BF3A03
    menu "Auto detect BF3A03"
        config CAMERA_BF3A03_AUTO_DETECT_DVP_INTERFACE_SENSOR
            bool "Detect for DVP interface sensor"
            default y
            help
                When enabled, the BF3A03 sensor will be automatically detected
                and initialized on the DVP interface at startup without requiring
                manual detection call(bf3a03_detect) in your application.
    endmenu
    
    menu "Choose supported formats for DVP interface"
        config CAMERA_BF3A03_DVP_YUV422_640X480_15FPS
            bool "DVP 8-bit, 20M input, 640x480 15fps, YUV422"
            default y
            help
                Standard color format using YUV422 at 640x480 resolution (VGA)
                with 15fps framerate. Requires 8-bit DVP interface and 20MHz input.

        config CAMERA_BF3A03_DVP_YUV422_MONO_640X480_15FPS
            bool "DVP 8-bit, 20M input, 640x480 15fps, YUV422(MONO)"
            default n
            help
                Grayscale format using YUV422 mono at 640x480 resolution (VGA)
                with 15fps framerate. Requires 8-bit DVP interface and 20MHz input.
    endmenu

    choice CAMERA_BF3A03_DVP_DEFAULT_FMT
        prompt "Select default output format for DVP interface"
        default CAMERA_BF3A03_DVP_DEFAULT_FMT_YUV422_640X480_15FPS
        help
            This is an internal choice that ensures only one format can be selected as default.
            It is automatically controlled by the "Set as default format" options above.

        config CAMERA_BF3A03_DVP_DEFAULT_FMT_YUV422_640X480_15FPS
            bool "DVP 8-bit, 20M input, 640x480 15fps, YUV422"
            depends on CAMERA_BF3A03_DVP_YUV422_640X480_15FPS

        config CAMERA_BF3A03_DVP_DEFAULT_FMT_YUV422_MONO_640X480_15FPS
            bool "DVP 8-bit, 20M input, 640x480 15fps, YUV422(MONO)"
            depends on CAMERA_BF3A03_DVP_YUV422_MONO_640X480_15FPS
    endchoice # CAMERA_BF3A03_DVP_DEFAULT_FMT

    config CAMERA_BF3A03_DVP_IF_FORMAT_INDEX_DEFAULT
        int
        default 0 if CAMERA_BF3A03_DVP_DEFAULT_FMT_YUV422_640X480_15FPS
        default 1 if CAMERA_BF3A03_DVP_DEFAULT_FMT_YUV422_MONO_640X480_15FPS
        help
            Sets the default configuration for the DVP interface.
            Use query_support_formats() API to get more format options.
endif
```

## esp_cam_sensor/sensors/gc0308/Kconfig.gc0308
```kconfig
menuconfig CAMERA_GC0308
    bool "GC0308"
    default n
    depends on SOC_LCDCAM_CAM_SUPPORTED
    help
        Enable support for the GC0308 CMOS image sensor.

if CAMERA_GC0308
    menu "Auto detect GC0308"
        config CAMERA_GC0308_AUTO_DETECT_DVP_INTERFACE_SENSOR
            bool "Detect for DVP interface sensor"
            default y
            help
                When enabled, the GC0308 sensor will be automatically detected
                and initialized on the DVP interface at startup without requiring
                manual detection call(gc0308_detect) in your application.
    endmenu

    menu "Choose supported formats for DVP interface"
        config CAMERA_GC0308_DVP_GRAY_320X240_20FPS
            bool "DVP 8-bit, 20M input,  320x240  20fps, GRAY"
            default n
            help
                Grayscale format at 320x240 resolution (QVGA) with 20fps framerate.
                Requires 8-bit DVP interface and 20MHz input.

        config CAMERA_GC0308_DVP_GRAY_640X480_16FPS
            bool "DVP 8-bit, 20M input,  640x480  16fps, GRAY"
            default n
            help
                Grayscale format at 640x480 resolution (VGA) with 16fps framerate.
                Requires 8-bit DVP interface and 20MHz input.

        config CAMERA_GC0308_DVP_RGB565_320X240_20FPS
            bool "DVP 8-bit, 20M input,  320x240  20fps, RGB565"
            default n
            help
                Standard color format using RGB565 at 320x240 resolution (QVGA)
                with 20fps framerate. Requires 8-bit DVP interface and 20MHz input.

        config CAMERA_GC0308_DVP_RGB565_640X480_16FPS
            bool "DVP 8-bit, 20M input,  640x480  16fps, RGB565"
            default n
            help
                Standard color format using RGB565 at 640x480 resolution (VGA)
                with 16fps framerate. Requires 8-bit DVP interface and 20MHz input.

        config CAMERA_GC0308_DVP_YUV422_320X240_20FPS
            bool "DVP 8-bit, 20M input,  320x240  20fps, YUV422"
            default n
            help
                YUV422 color format at 320x240 resolution (QVGA) with 20fps framerate.
                Requires 8-bit DVP interface and 20MHz input.

        config CAMERA_GC0308_DVP_YUV422_640X480_16FPS
            bool "DVP 8-bit, 20M input,  640x480  16fps, YUV422"
            default y
            help
                Standard color format using YUV422 at 640x480 resolution (VGA)
                with 16fps framerate. Requires 8-bit DVP interface and 20MHz input.
    endmenu

    choice CAMERA_GC0308_DVP_DEFAULT_FMT
        prompt "Select default output format for DVP interface"
        default CAMERA_GC0308_DVP_DEFAULT_FMT_YUV422_640X480_16FPS
        help
            This is an internal choice that ensures only one format can be selected as default.
            It is automatically controlled by the "Set as default format" options above.

        config CAMERA_GC0308_DVP_DEFAULT_FMT_GRAY_320X240_20FPS
            bool "DVP 8-bit, 20M input,  320x240  20fps, GRAY"
            depends on CAMERA_GC0308_DVP_GRAY_320X240_20FPS

        config CAMERA_GC0308_DVP_DEFAULT_FMT_GRAY_640X480_16FPS
            bool "DVP 8-bit, 20M input,  640x480  16fps, GRAY"
            depends on CAMERA_GC0308_DVP_GRAY_640X480_16FPS

        config CAMERA_GC0308_DVP_DEFAULT_FMT_RGB565_320X240_20FPS
            bool "DVP 8-bit, 20M input,  320x240  20fps, RGB565"
            depends on CAMERA_GC0308_DVP_RGB565_320X240_20FPS

        config CAMERA_GC0308_DVP_DEFAULT_FMT_RGB565_640X480_16FPS
            bool "DVP 8-bit, 20M input,  640x480  16fps, RGB565"
            depends on CAMERA_GC0308_DVP_RGB565_640X480_16FPS

        config CAMERA_GC0308_DVP_DEFAULT_FMT_YUV422_320X240_20FPS
            bool "DVP 8-bit, 20M input,  320x240  20fps, YUV422"
            depends on CAMERA_GC0308_DVP_YUV422_320X240_20FPS

        config CAMERA_GC0308_DVP_DEFAULT_FMT_YUV422_640X480_16FPS
            bool "DVP 8-bit, 20M input,  640x480  16fps, YUV422"
            depends on CAMERA_GC0308_DVP_YUV422_640X480_16FPS
    endchoice # CAMERA_GC0308_DVP_DEFAULT_FMT

    config CAMERA_GC0308_DVP_IF_FORMAT_INDEX_DEFAULT
        int
        default 0 if CAMERA_GC0308_DVP_DEFAULT_FMT_YUV422_640X480_16FPS
        default 1 if CAMERA_GC0308_DVP_DEFAULT_FMT_RGB565_640X480_16FPS
        default 2 if CAMERA_GC0308_DVP_DEFAULT_FMT_GRAY_640X480_16FPS
        default 3 if CAMERA_GC0308_DVP_DEFAULT_FMT_YUV422_320X240_20FPS
        default 4 if CAMERA_GC0308_DVP_DEFAULT_FMT_GRAY_320X240_20FPS
        default 5 if CAMERA_GC0308_DVP_DEFAULT_FMT_RGB565_320X240_20FPS
        help
            Sets the default configuration for the DVP interface.
            Use query_support_formats() API to get more format options.
endif
```
