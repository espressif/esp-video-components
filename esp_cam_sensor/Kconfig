## esp_cam_sensor/sensors/sc101iot/Kconfig.sc101iot
```kconfig
menuconfig CAMERA_SC101IOT
    bool "SC101IOT"
    default n
    help
        Enabling this option will add the support for SC101IOT.

if CAMERA_SC101IOT
    menuconfig CAMERA_SC101IOT_AUTO_DETECT
        bool "Auto detect SC101IOT"
        default y
        help
            When enabled, it provides the ability in application layer to automatically
            detect camera sensors one by one.

    if CAMERA_SC101IOT_AUTO_DETECT
        config CAMERA_SC101IOT_AUTO_DETECT_DVP_INTERFACE_SENSOR
            bool "Detect for DVP interface sensor"
            default y
            help
                When enabled, you don't need to call sc101iot_detect manaually, SC101IOT will
                be automatically detected and connected to the DVP interface when the
                application starts.
    endif

    config CAMERA_SC101IOT_DVP_IF_FORMAT_INDEX_DAFAULT
        int "Default format index for SC101IOT DVP Interface"
        default 0
        range 0 1
        help
            Set the configuration loaded by default for the DVP interface.
            More information can be obtained by calling the query_support_formats().
endif
```

## esp_cam_sensor/sensors/sc121at/Kconfig.sc121at
```kconfig
menuconfig CAMERA_SC121AT
    bool "SC121AT"
    default n
    depends on SOC_MIPI_CSI_SUPPORTED || SOC_LCDCAM_CAM_SUPPORTED
    help
        Enable support for the SC121AT CMOS image sensor. 

if CAMERA_SC121AT
    menu "Auto detect SC121AT"
        config CAMERA_SC121AT_AUTO_DETECT_DVP_INTERFACE_SENSOR
            bool "Detect for DVP interface sensor"
            default n
            depends on SOC_LCDCAM_CAM_SUPPORTED
            help
                When enabled, the SC121AT sensor will be automatically detected
                and initialized on the DVP interface at startup without requiring
                manual detection call(sc121at_detect) in your application.

        config CAMERA_SC121AT_AUTO_DETECT_MIPI_INTERFACE_SENSOR
            bool "Detect for MIPI CSI interface sensor"
            default y
            depends on SOC_MIPI_CSI_SUPPORTED
            help
                When enabled, the SC121AT sensor will be automatically detected
                and initialized on the MIPI CSI interface at startup without requiring
                manual detection call(sc121at_detect) in your application.
    endmenu

    menu "Choose supported formats for MIPI CSI interface"
        depends on SOC_MIPI_CSI_SUPPORTED
        config CAMERA_SC121AT_MIPI_YUV422_1280X800_25FPS
            bool "MIPI 2-lane, 24M input, 1280x800  25fps, YUV422(UYVY)"
            default y
            help
                YUV422(UYVY) color format at 1280x800 resolution with 25fps framerate.
    endmenu

    choice CAMERA_SC121AT_MIPI_DEFAULT_FMT
        prompt "Select default output format for MIPI CSI interface"
        depends on SOC_MIPI_CSI_SUPPORTED
        default CAMERA_SC121AT_MIPI_DEFAULT_FMT_YUV422_1280X800_25FPS
        help
            This option allows you to select the default video format for the SC121AT sensor
            when it is initialized on the MIPI CSI interface. The selected format will be used
            when the sensor is detected and initialized, and can be changed later when the
            sensor is in stream off state.

        config CAMERA_SC121AT_MIPI_DEFAULT_FMT_YUV422_1280X800_25FPS
            bool "MIPI 2-lane, 24M input, 1280x800  25fps, YUV422(UYVY)"
            depends on CAMERA_SC121AT_MIPI_YUV422_1280X800_25FPS

    endchoice # CAMERA_SC121AT_MIPI_DEFAULT_FMT

    config CAMERA_SC121AT_MIPI_IF_FORMAT_INDEX_DEFAULT
        int
        depends on SOC_MIPI_CSI_SUPPORTED
        default 0 if CAMERA_SC121AT_MIPI_DEFAULT_FMT_YUV422_1280X800_25FPS
        help
            Sets the default configuration for the MIPI CSI interface.
            Use query_support_formats() API to get more format options.

endif
```
