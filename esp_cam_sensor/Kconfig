## esp_cam_sensor/sensors/ov3640/Kconfig.ov3640
```kconfig
menuconfig CAMERA_OV3640
    bool "OV3640"
    default n
    depends on SOC_LCDCAM_CAM_SUPPORTED
    help
        Enable support for the OV3640 CMOS image sensor.

if CAMERA_OV3640
    menu "Auto detect OV3640"
        config CAMERA_OV3640_AUTO_DETECT_DVP_INTERFACE_SENSOR
            bool "Detect for DVP interface sensor"
            default y
            help
                When enabled, the OV3640 sensor will be automatically detected
                and initialized on the DVP interface at startup without requiring
                manual detection call(ov3640_detect) in your application.
    endmenu

    menu "Choose supported formats for DVP interface"
        config CAMERA_OV3640_DVP_RGB565_LE_640X480_7FPS
            bool "DVP 8-bit, 24M input,  640x480  7fps, RGB565(LE)"
            default y
            help
                RGB565(LE) color format at 640x480 resolution (VGA) with 7fps framerate.
                Requires 8-bit DVP interface and 24MHz input clock.

        config CAMERA_OV3640_DVP_YUV422_UYVY_640X480_30FPS
            bool "DVP 8-bit, 24M input,  640x480  30fps, YUV422(UYVY)"
            default n
            help
                YUV422(UYVY) color format at 640x480 resolution (VGA) with 30fps framerate.
                Requires 8-bit DVP interface and 24MHz input clock.

        config CAMERA_OV3640_DVP_YUV422_UYVY_1024X768_5FPS
            bool "DVP 8-bit, 24M input, 1024x768   5fps, YUV422(UYVY)"
            default n
            help
                YUV422(UYVY) color format at 1024x768 resolution with 5fps framerate.
                Requires 8-bit DVP interface and 24MHz input clock.

        config CAMERA_OV3640_DVP_YUV422_UYVY_1024X768_25FPS
            bool "DVP 8-bit, 24M input, 1024x768  25fps, YUV422(UYVY)"
            default n
            help
                YUV422(UYVY) color format at 1024x768 resolution with 25fps framerate.
                Requires 8-bit DVP interface and 24MHz input clock.

        config CAMERA_OV3640_DVP_JPEG_1024X768_25FPS
            bool "DVP 8-bit, 24M input, 1024x768  25fps, JPEG"
            default n
            help
                JPEG format at 1024x768 resolution with 25fps framerate.
                Requires 8-bit DVP interface and 24MHz input clock.

        config CAMERA_OV3640_DVP_YUV422_UYVY_1280X720_15FPS
            bool "DVP 8-bit, 24M input, 1280x720  15fps, YUV422(UYVY)"
            default n
            help
                YUV422(UYVY) color format at 1280x720 resolution (720P) with 15fps framerate.
                Requires 8-bit DVP interface and 24MHz input clock.

        config CAMERA_OV3640_DVP_JPEG_1280X720_15FPS
            bool "DVP 8-bit, 24M input, 1280x720  15fps, JPEG"
            default n
            help
                JPEG format at 1280x720 resolution (720P) with 15fps framerate.
                Requires 8-bit DVP interface and 24MHz input clock.

        config CAMERA_OV3640_DVP_JPEG_2048X1536_15FPS
            bool "DVP 8-bit, 24M input, 2048x1536  15fps, JPEG"
            default n
            help
                JPEG format at 2048x1536 resolution with 15fps framerate.
                Requires 8-bit DVP interface and 24MHz input clock.
    endmenu

    choice CAMERA_OV3640_DVP_DEFAULT_FMT
        prompt "Select default output format for DVP interface"
        default CAMERA_OV3640_DVP_DEFAULT_FMT_RGB565_LE_640X480_7FPS
        help
            This option allows you to select the default video format for the OV3640 sensor
            when it is initialized on the DVP interface. The selected format will be used
            when the sensor is detected and initialized, and can be changed later when the
            sensor is in stream off state.

        config CAMERA_OV3640_DVP_DEFAULT_FMT_RGB565_LE_640X480_7FPS
            bool "DVP 8-bit, 24M input,  640x480  7fps, RGB565(LE)"
            depends on CAMERA_OV3640_DVP_RGB565_LE_640X480_7FPS

        config CAMERA_OV3640_DVP_DEFAULT_FMT_YUV422_UYVY_640X480_30FPS
            bool "DVP 8-bit, 24M input,  640x480  30fps, YUV422(UYVY)"
            depends on CAMERA_OV3640_DVP_YUV422_UYVY_640X480_30FPS

        config CAMERA_OV3640_DVP_DEFAULT_FMT_YUV422_UYVY_1024X768_5FPS
            bool "DVP 8-bit, 24M input, 1024x768   5fps, YUV422(UYVY)"
            depends on CAMERA_OV3640_DVP_YUV422_UYVY_1024X768_5FPS

        config CAMERA_OV3640_DVP_DEFAULT_FMT_YUV422_UYVY_1024X768_25FPS
            bool "DVP 8-bit, 24M input, 1024x768  25fps, YUV422(UYVY)"
            depends on CAMERA_OV3640_DVP_YUV422_UYVY_1024X768_25FPS

        config CAMERA_OV3640_DVP_DEFAULT_FMT_YUV422_UYVY_1280X720_15FPS
            bool "DVP 8-bit, 24M input, 1280x720  15fps, YUV422(UYVY)"
            depends on CAMERA_OV3640_DVP_YUV422_UYVY_1280X720_15FPS

        config CAMERA_OV3640_DVP_DEFAULT_FMT_JPEG_2048X1536_15fps
            bool "DVP 8-bit, 24M input, 2048x1536  15fps, JPEG"
            depends on CAMERA_OV3640_DVP_JPEG_2048X1536_15FPS

        config CAMERA_OV3640_DVP_DEFAULT_FMT_JPEG_1024X768_25FPS
            bool "DVP 8-bit, 24M input, 1024x768  25fps, JPEG"
            depends on CAMERA_OV3640_DVP_JPEG_1024X768_25FPS

        config CAMERA_OV3640_DVP_DEFAULT_FMT_JPEG_1280X720_15FPS
            bool "DVP 8-bit, 24M input, 1280x720  15fps, JPEG"
            depends on CAMERA_OV3640_DVP_JPEG_1280X720_15FPS

    endchoice # CAMERA_OV3640_DVP_DEFAULT_FMT

    config CAMERA_OV3640_DVP_IF_FORMAT_INDEX_DEFAULT
        int
        default 0 if CAMERA_OV3640_DVP_DEFAULT_FMT_RGB565_LE_640X480_7FPS
        default 1 if CAMERA_OV3640_DVP_DEFAULT_FMT_YUV422_UYVY_640X480_30FPS
        default 2 if CAMERA_OV3640_DVP_DEFAULT_FMT_YUV422_UYVY_1024X768_5FPS
        default 3 if CAMERA_OV3640_DVP_DEFAULT_FMT_YUV422_UYVY_1024X768_25FPS
        default 4 if CAMERA_OV3640_DVP_DEFAULT_FMT_YUV422_UYVY_1280X720_15FPS
        default 5 if CAMERA_OV3640_DVP_DEFAULT_FMT_JPEG_2048X1536_15fps
        default 6 if CAMERA_OV3640_DVP_DEFAULT_FMT_JPEG_1024X768_25FPS
        default 7 if CAMERA_OV3640_DVP_DEFAULT_FMT_JPEG_1280X720_15FPS
        help
            Sets the default configuration for the DVP interface.
            Use query_support_formats() API to get more format options.
endif
```

## esp_cam_sensor/sensors/ov3660/Kconfig.ov3660
```kconfig
menuconfig CAMERA_OV3660
    bool "OV3660"
    default n
    depends on SOC_LCDCAM_CAM_SUPPORTED
    help
        Enable support for the OV3660 CMOS image sensor.

if CAMERA_OV3660
    menu "Auto detect OV3660"
        config CAMERA_OV3660_AUTO_DETECT_DVP_INTERFACE_SENSOR
            bool "Detect for DVP interface sensor"
            default y
            help
                When enabled, the OV3660 sensor will be automatically detected
                and initialized on the DVP interface at startup without requiring
                manual detection call(ov3660_detect) in your application.
    endmenu

    menu "Choose supported formats for DVP interface"
        config CAMERA_OV3660_DVP_JPEG_1280X720_12FPS
            bool "DVP 8-bit, 10M input, 1280x720  12fps, JPEG"
            default n
            help
                JPEG format at 1280x720 resolution (HD) with 12fps framerate.
                Requires 8-bit DVP interface and 10MHz input clock.

        config CAMERA_OV3660_DVP_RGB565_240X240_24FPS
            bool "DVP 8-bit, 20M input,  240x240  24fps, RGB565"
            default n
            help
                RGB565 color format at 240x240 resolution with 24fps framerate.
                Requires 8-bit DVP interface and 20MHz input clock.

        config CAMERA_OV3660_DVP_RGB565_640X480_10FPS
            bool "DVP 8-bit, 20M input,  640x480  10fps, RGB565"
            default n
            help
                RGB565 color format at 640x480 resolution (VGA) with 10fps framerate.
                Requires 8-bit DVP interface and 20MHz input clock.

        config CAMERA_OV3660_DVP_YUV422_240X240_24FPS
            bool "DVP 8-bit, 20M input,  240x240  24fps, YUV422"
            default n
            help
                YUV422 color format at 240x240 resolution with 24fps framerate.
                Requires 8-bit DVP interface and 20MHz input clock.

        config CAMERA_OV3660_DVP_YUV422_640X480_10FPS
            bool "DVP 8-bit, 20M input,  640x480  10fps, YUV422"
            default y
            help
                YUV422 color format at 640x480 resolution (VGA) with 10fps framerate.
                Requires 8-bit DVP interface and 20MHz input clock.
    endmenu

    choice CAMERA_OV3660_DVP_DEFAULT_FMT
        prompt "Select default output format for DVP interface"
        default CAMERA_OV3660_DVP_DEFAULT_FMT_YUV422_640X480_10FPS
        help
            This option allows you to select the default video format for the OV3660 sensor
            when it is initialized on the DVP interface. The selected format will be used
            when the sensor is detected and initialized, and can be changed later when the
            sensor is in stream off state.

        config CAMERA_OV3660_DVP_DEFAULT_FMT_JPEG_1280X720_12FPS
            bool "DVP 8-bit, 10M input, 1280x720  12fps, JPEG"
            depends on CAMERA_OV3660_DVP_JPEG_1280X720_12FPS

        config CAMERA_OV3660_DVP_DEFAULT_FMT_RGB565_240X240_24FPS
            bool "DVP 8-bit, 20M input,  240x240  24fps, RGB565"
            depends on CAMERA_OV3660_DVP_RGB565_240X240_24FPS

        config CAMERA_OV3660_DVP_DEFAULT_FMT_RGB565_640X480_10FPS
            bool "DVP 8-bit, 20M input,  640x480  10fps, RGB565"
            depends on CAMERA_OV3660_DVP_RGB565_640X480_10FPS

        config CAMERA_OV3660_DVP_DEFAULT_FMT_YUV422_240X240_24FPS
            bool "DVP 8-bit, 20M input,  240x240  24fps, YUV422"
            depends on CAMERA_OV3660_DVP_YUV422_240X240_24FPS

        config CAMERA_OV3660_DVP_DEFAULT_FMT_YUV422_640X480_10FPS
            bool "DVP 8-bit, 20M input,  640x480  10fps, YUV422"
            depends on CAMERA_OV3660_DVP_YUV422_640X480_10FPS
    endchoice # CAMERA_OV3660_DVP_DEFAULT_FMT

    config CAMERA_OV3660_DVP_IF_FORMAT_INDEX_DEFAULT
        int
        default 0 if CAMERA_OV3660_DVP_DEFAULT_FMT_RGB565_240X240_24FPS
        default 1 if CAMERA_OV3660_DVP_DEFAULT_FMT_YUV422_240X240_24FPS
        default 2 if CAMERA_OV3660_DVP_DEFAULT_FMT_RGB565_640X480_10FPS
        default 3 if CAMERA_OV3660_DVP_DEFAULT_FMT_YUV422_640X480_10FPS
        default 4 if CAMERA_OV3660_DVP_DEFAULT_FMT_JPEG_1280X720_12FPS
        help
            Sets the default configuration for the DVP interface.
            Use query_support_formats() API to get more format options.
endif
```

## esp_cam_sensor/sensors/ov5640/Kconfig.ov5640
```kconfig
menuconfig CAMERA_OV5640
    bool "OV5640"
    default n
    help
        Enabling this option will add the support for OV5640.

if CAMERA_OV5640
    menuconfig CAMERA_OV5640_AUTO_DETECT
        bool "Auto detect OV5640"
        default y
        help
            When enabled, it provides the ability in application layer to automatically
            detect camera sensors one by one.

    if CAMERA_OV5640_AUTO_DETECT
        config CAMERA_OV5640_AUTO_DETECT_MIPI_INTERFACE_SENSOR
            bool "Detect for MIPI interface sensor"
            default y
            help
                When enabled, you don't need to call ov5640_detect manaually, OV5640
                will be automatically detected and connected to the MIPI CSI interface
                when the application starts.
    
        config CAMERA_OV5640_AUTO_DETECT_DVP_INTERFACE_SENSOR
            bool "Detect for DVP interface sensor"
            default n
            help
                When enabled, you don't need to call ov5640_detect manaually, OV5640 will
                be automatically detected and connected to the DVP interface when the
                application starts.
    endif

    choice CAMERA_OV5640_MIPI_DEFAULT_FMT
        prompt "Default format select"
        default CAMERA_OV5640_MIPI_RGB565_1280X720_14FPS
        help
            Select the default format to load when the sensor is detected.
            When the sensor is in stream off state, the format can be changed.
    
        config CAMERA_OV5640_MIPI_RGB565_1280X720_14FPS
            bool "RGB565 1280x760 14fps, MIPI 2lane 24M input"
    endchoice # CAMERA_OV5640_MIPI_DEFAULT_FMT

    config CAMERA_OV5640_MIPI_IF_FORMAT_INDEX_DAFAULT
        int
        default 0 if CAMERA_OV5640_MIPI_RGB565_1280X720_14FPS
        help
            Set the configuration loaded by default for the MIPI interface.
            More information can be obtained by calling the query_support_formats().

    choice CAMERA_OV5640_DVP_DEFAULT_FMT
        prompt "Default format select for DVP"
        default CAMERA_OV5640_DVP_YUV422_800X600_10FPS
        help
            Select the default format to load when the sensor is detected.
            When the sensor is in stream off state, the format can be changed.
    
        config CAMERA_OV5640_DVP_YUV422_800X600_10FPS
            bool "YUV422 800x600 10fps, DVP 8bit 24M input"
    endchoice # CAMERA_OV5640_DVP_DEFAULT_FMT

    config CAMERA_OV5640_DVP_IF_FORMAT_INDEX_DAFAULT
        int
        default 1 if CAMERA_OV5640_DVP_YUV422_800X600_10FPS
        help
            Set the configuration loaded by default for the DVP interface.
            More information can be obtained by calling the query_support_formats().

    config CAMERA_OV5640_CSI_LINESYNC_ENABLE
        bool "CSI Line sync enable"
        default y
        help
            If enabled, send line short packet for each line.
endif
```
