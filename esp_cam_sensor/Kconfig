## esp_cam_sensor/Kconfig
```kconfig
menu "Espressif Camera Sensors Configurations"
    menu "Camera Sensor Configuration"
        menu "Select and Set Camera Sensor"
            rsource "sensors/bf3901/Kconfig.bf3901"
            rsource "sensors/bf3925/Kconfig.bf3925"
            rsource "sensors/bf3a03/Kconfig.bf3a03"
            rsource "sensors/gc0308/Kconfig.gc0308"
            rsource "sensors/gc2145/Kconfig.gc2145"
            rsource "sensors/ov2640/Kconfig.ov2640"
            rsource "sensors/ov2710/Kconfig.ov2710"
            rsource "sensors/ov5640/Kconfig.ov5640"
            rsource "sensors/ov5645/Kconfig.ov5645"
            rsource "sensors/ov5647/Kconfig.ov5647"
            rsource "sensors/sc030iot/Kconfig.sc030iot"
            rsource "sensors/sc035hgs/Kconfig.sc035hgs"
            rsource "sensors/sc101iot/Kconfig.sc101iot"
            rsource "sensors/sc202cs/Kconfig.sc202cs"
            rsource "sensors/sc2336/Kconfig.sc2336"
        endmenu

        config CAMERA_SENSOR_SWAP_PIXEL_BYTE_ORDER
            bool "Enable pixel byte order swapping"
            default y if IDF_TARGET_ESP32P4
            default n if IDF_TARGET_ESP32S3
            depends on CAMERA_OV2640 || CAMERA_BF3901
            help
                Enable pixel byte order swapping to match display or processing requirements.

                This feature exchanges the byte order of pixel data, which is useful when interfacing
                with different display controllers or image processing pipelines that expect specific
                byte ordering.

                Supported transformations:

                RGB565 format:
                  Original: [R₁G₁B₁][R₂G₂B₂] → Swapped: [B₁G₁R₁][B₂G₂R₂]
                  Byte sequence: 0xRG 0xBR 0xGB → 0xBG 0xRB 0xGR

                YUYV format:
                  Original: [Y₁U₁Y₂V₁] → Swapped: [U₁Y₁V₁Y₂]
                  Byte sequence: Y U Y V → U Y V Y

                Platform compatibility:
                - ESP32-P4: Default enabled
                - ESP32-S3: Default disabled

                Note: This option only applies to OV2640 and BF3901 sensors.
                For other sensors, use ESP_VIDEO_ENABLE_SWAP_BYTE (ESP32-P4 only).
    endmenu

    menu "Camera XCLK Generator Configuration"
        config CAMERA_XCLK_USE_LEDC
            bool "Generate XCLK using LEDC"
            default n if IDF_TARGET_ESP32P4
            default y
            help
                Use the LED Control (LEDC) peripheral to generate the external clock (XCLK) signal
                for camera sensors.

                The LEDC peripheral provides a flexible PWM-based clock generation method that is
                compatible with most ESP32 variants. It offers good frequency accuracy and is
                suitable for most camera sensor applications.

        config CAMERA_XCLK_USE_ESP_CLOCK_ROUTER
            bool "Generate XCLK using ESP clock router"
            depends on IDF_TARGET_ESP32P4
            default y
            help
                Use the ESP32-P4's dedicated clock router to generate the external clock (XCLK)
                signal for camera sensors.

                The clock router provides high-precision clock generation directly from the SoC's
                root clock sources, offering superior frequency stability and accuracy compared
                to LEDC-based generation.

                For detailed clock tree information, refer to:
                https://docs.espressif.com/projects/esp-idf/en/latest/esp32p4/api-reference/peripherals/clk_tree.html

                Recommended for: High-performance camera applications requiring precise timing.
    endmenu

    menu "Camera Motor Control Configuration"
        rsource "motors/dw9714/Kconfig.dw9714"

        config CAMERA_MOTOR_DEVICE_USED
            bool
            default n
            help
                Internal configuration flag indicating whether any camera motor driver is enabled.

                This flag is automatically set when any motor driver (such as autofocus motors,
                zoom motors, or iris control motors) is enabled in the configuration. It is used
                internally by the build system to include necessary motor control libraries and
                initialization code.

                Do not modify this setting manually - it is managed automatically based on
                your motor driver selections.

    endmenu

    menu "Camera SPI Controller Configuration"
        config CAM_CTLR_SPI_ISR_CACHE_SAFE
            bool "Enable cache-safe SPI interrupt handling"
            default y
            select SPI_SLAVE_ISR_IN_IRAM
            help
                Ensure camera controller SPI interrupt service routine (ISR) remains accessible
                when cache is disabled.

                When enabled, the SPI ISR code is placed in internal RAM (IRAM), allowing it to
                execute even when external flash cache is temporarily disabled during operations
                like flash writes, OTA updates, or power management transitions.

                Benefits:
                - Prevents SPI communication interruptions during cache-disabled periods
                - Ensures reliable camera data transfer during system operations
                - Reduces latency in time-critical camera control scenarios

                Trade-offs:
                - Uses additional IRAM memory
                - Slightly increases firmware size

                Recommended: Enable for production applications requiring reliable camera operation
                during all system states.

                Note: This automatically enables SPI_SLAVE_ISR_IN_IRAM for the SPI peripheral.
    endmenu
endmenu
```

## esp_cam_sensor/motors/dw9714/Kconfig.dw9714
```kconfig
menuconfig CAM_MOTOR_DW9714
    bool "DW9714"
    default n
    select CAMERA_MOTOR_DEVICE_USED
    help
        Enabling this option will add the support for DW9714 camera motor.

if CAM_MOTOR_DW9714
    config CAM_MOTOR_DW9714_AUTO_DETECT
        bool "Auto detect DW9714"
        default y
        help
            When enabled, it provides the ability in application layer to automatically
            detect camera motors one by one.

    choice CAM_MOTOR_DW9714_DEFAULT_FMT
        prompt "Default format select"
        default CAM_MOTOR_DW9714_DLC_MCLK02_SRC17
        help
            We define a "format" structure in the software to store the initialization information of the motor device.
            Here, the default format is selected for loading when the motor is detected.
    
        config CAM_MOTOR_DW9714_LSC_MCLK01_SRC03
            bool "LSC mode with mclk01 src03"
        config CAM_MOTOR_DW9714_DLC_MCLK02_SRC17
            bool "DLC mode with mclk02 src17"
    endchoice # CAM_MOTOR_DW9714_DEFAULT_FMT

    config DW9714_FORMAT_INDEX_DEFAULT
        int
        default 0 if CAM_MOTOR_DW9714_LSC_MCLK01_SRC03
        default 1 if CAM_MOTOR_DW9714_DLC_MCLK02_SRC17
        help
            Set the configuration loaded by default.
            More information can be obtained by calling the query_support_formats().
endif
```

## esp_cam_sensor/sensors/arducam/imx500/Kconfig.arducam_imx500
```kconfig
menuconfig CAMERA_ARDUCAM_IMX500
    bool "Arducam IMX500"
    default n
    depends on SOC_MIPI_CSI_SUPPORTED
    help
        Enable support for the Arducam IMX500 CMOS image sensor module.

if CAMERA_ARDUCAM_IMX500
    menu "Auto detect Arducam IMX500"
        config CAMERA_ARDUCAM_IMX500_AUTO_DETECT_MIPI_INTERFACE_SENSOR
            bool "Detect for MIPI CSI interface sensor"
            default y
            help
                When enabled, the Arducam IMX500 sensor module will be automatically detected
                and initialized on the MIPI CSI interface at startup without requiring
                manual detection call(arducam_imx500_detect) in your application.
    endmenu

    menu "Choose supported formats for MIPI CSI interface"

         config CAMERA_ARDUCAM_IMX500_MIPI_RAW10_1920X1080_30FPS
            bool "MIPI 2-lane, 24M input, 1920x1080  30fps, RAW10"
            default y
            help
                RAW10 color format at 1920x1080 resolution with 30fps framerate.
                Requires MIPI CSI-2 2-lane interface with 24MHz input clock.

        config CAMERA_ARDUCAM_IMX500_MIPI_RAW10_1600X1200_30FPS
            bool "MIPI 2-lane, 24M input, 1600x1200  30fps, RAW10"
            default n
            help
                RAW10 color format at 1600x1200 resolution with 30fps framerate.
                Requires MIPI CSI-2 2-lane interface with 24MHz input clock.

        config CAMERA_ARDUCAM_IMX500_MIPI_RAW10_1280X720_30FPS
            bool "MIPI 2-lane, 24M input, 1280x720  30fps, RAW10"
            default n
            help
                RAW10 color format at 1280x720 resolution with 30fps framerate.
                Requires MIPI CSI-2 2-lane interface with 24MHz input clock.

        config CAMERA_ARDUCAM_IMX500_MIPI_RAW10_1024X600_30FPS
            bool "MIPI 2-lane, 24M input, 1024x600  30fps, RAW10"
            default n
            help
                RAW10 color format at 1024x600 resolution with 30fps framerate.
                Requires MIPI CSI-2 2-lane interface with 24MHz input clock.
        
        config CAMERA_ARDUCAM_IMX500_MIPI_RAW10_640X480_30FPS
            bool "MIPI 2-lane, 24M input, 640x480  30fps, RAW10"
            default n
            help
                RAW10 color format at 640x480 resolution with 30fps framerate.
                Requires MIPI CSI-2 2-lane interface with 24MHz input clock.
    endmenu

    choice CAMERA_ARDUCAM_IMX500_MIPI_DEFAULT_FMT
        prompt "Select default output format for MIPI CSI interface"
        default CAMERA_ARDUCAM_IMX500_MIPI_DEFAULT_FMT_RAW10_1920X1080_30FPS
        help
            Select the default video output format for the Arducam IMX500 camera sensor module over MIPI CSI.
            The actual supported resolutions and frame rates must be enumerated from the sensor
            firmware during driver initialization. The selected default format will be applied
            only if it is supported by the sensor; otherwise, the first enumerated valid format
            will be used automatically.
        

        config CAMERA_ARDUCAM_IMX500_MIPI_DEFAULT_FMT_RAW10_1920X1080_30FPS
            bool "MIPI 2-lane, 24M input, 1920x1080  30fps, RAW10"
            depends on CAMERA_ARDUCAM_IMX500_MIPI_RAW10_1920X1080_30FPS

        config CAMERA_ARDUCAM_IMX500_MIPI_DEFAULT_FMT_RAW10_1600X1200_30FPS
            bool "MIPI 2-lane, 24M input, 1600x1200  30fps, RAW10"
            depends on CAMERA_ARDUCAM_IMX500_MIPI_RAW10_1600X1200_30FPS
        
        config CAMERA_ARDUCAM_IMX500_MIPI_DEFAULT_FMT_RAW10_1280X720_30FPS
            bool "MIPI 2-lane, 24M input, 1280x720  30fps, RAW10"
            depends on CAMERA_ARDUCAM_IMX500_MIPI_RAW10_1280X720_30FPS

        config CAMERA_ARDUCAM_IMX500_MIPI_DEFAULT_FMT_RAW10_1024X600_30FPS
            bool "MIPI 2-lane, 24M input, 1024x600  30fps, RAW10"
            depends on CAMERA_ARDUCAM_IMX500_MIPI_RAW10_1024X600_30FPS
        
        config CAMERA_ARDUCAM_IMX500_MIPI_DEFAULT_FMT_RAW10_640X480_30FPS
            bool "MIPI 2-lane, 24M input, 640x480  30fps, RAW10"
            depends on CAMERA_ARDUCAM_IMX500_MIPI_RAW10_640X480_30FPS

    endchoice # CAMERA_ARDUCAM_IMX500_MIPI_DEFAULT_FMT

    config CAMERA_ARDUCAM_IMX500_MIPI_IF_FORMAT_INDEX_DEFAULT
        int
        default 0 if CAMERA_ARDUCAM_IMX500_MIPI_DEFAULT_FMT_RAW10_1920X1080_30FPS
        default 1 if CAMERA_ARDUCAM_IMX500_MIPI_DEFAULT_FMT_RAW10_1600X1200_30FPS
        default 2 if CAMERA_ARDUCAM_IMX500_MIPI_DEFAULT_FMT_RAW10_1280X720_30FPS
        default 3 if CAMERA_ARDUCAM_IMX500_MIPI_DEFAULT_FMT_RAW10_1024X600_30FPS
        default 4 if CAMERA_ARDUCAM_IMX500_MIPI_DEFAULT_FMT_RAW10_640X480_30FPS
        help
            Sets the default configuration for the MIPI CSI interface.
            Use query_support_formats() API to get more format options.

    choice CAMERA_ARDUCAM_IMX500_IPA_JSON_CONFIGURATION_FILE
        prompt "IPA Configuration File"
        default CAMERA_ARDUCAM_IMX500_DEFAULT_IPA_JSON_CONFIGURATION_FILE
        help
            Select the Image Processing Algorithm (IPA) JSON configuration file
            for the Arducam IMX500 sensor module.

        config CAMERA_ARDUCAM_IMX500_DEFAULT_IPA_JSON_CONFIGURATION_FILE
            bool "Use default configuration"
            help
                Use the built-in default IPA configuration file:
                "esp_cam_sensor/sensors/arducam/imx500/cfg/arducam_imx500_default.json"

                This configuration provides optimized settings for general use cases
                and is recommended for most applications.

        config CAMERA_ARDUCAM_IMX500_CUSTOMIZED_IPA_JSON_CONFIGURATION_FILE
            bool "Use custom configuration"
            help
                Use a custom IPA configuration file with your own optimized settings.

                This option allows you to fine-tune sensor parameters for specific
                lighting conditions, color requirements, or application needs.

                You must specify the custom file path in the configuration below.
    endchoice

    config CAMERA_ARDUCAM_IMX500_CUSTOMIZED_IPA_JSON_CONFIGURATION_FILE_PATH
        string "Custom IPA configuration file path"
        depends on CAMERA_ARDUCAM_IMX500_CUSTOMIZED_IPA_JSON_CONFIGURATION_FILE
        help
            Specify the path to your custom Arducam IMX500 IPA JSON configuration file.

            The path is relative to your project root directory.

            Example: "components/my_camera_config/imx500_custom.json"

            Ensure the file exists and contains valid JSON configuration
            parameters compatible with the Arducam IMX500 sensor module.
endif
```

## esp_cam_sensor/sensors/bf20a6/Kconfig.bf20a6
```kconfig
menuconfig CAMERA_BF20A6
    bool "BF20A6"
    default n
    depends on SOC_LCDCAM_CAM_SUPPORTED
    help
        Enable support for the BF20A6 CMOS image sensor.

if CAMERA_BF20A6
    menu "Auto detect BF20A6"
        config CAMERA_BF20A6_AUTO_DETECT_DVP_INTERFACE_SENSOR
            bool "Detect for DVP interface sensor"
            default y
            help
                When enabled, the BF20A6 sensor will be automatically detected
                and initialized on the DVP interface at startup without requiring
                manual detection call(bf20a6_detect) in your application.
    endmenu

    menu "Choose supported formats for DVP interface"
        config CAMERA_BF20A6_DVP_GRAY_640X480_15FPS
            bool "DVP 8-bit, 20M input, 640x480 15fps, GRAY"
            default y
            help
                Standard color format using Grayscale at 640x480 resolution (VGA)
                with 15fps framerate. Requires 8-bit DVP interface and 20MHz input.
    endmenu

    choice CAMERA_BF20A6_DVP_DEFAULT_FMT
        prompt "Select default output format for DVP interface"
        default CAMERA_BF20A6_DVP_DEFAULT_FMT_GRAY_640X480_15FPS
        help
            This is an internal choice that ensures only one format can be selected as default.
            It is automatically controlled by the "Set as default format" options above.
    
        config CAMERA_BF20A6_DVP_DEFAULT_FMT_GRAY_640X480_15FPS
            bool "DVP 8-bit, 20M input, 640x480 15fps, GRAY"
            depends on CAMERA_BF20A6_DVP_GRAY_640X480_15FPS
    endchoice # CAMERA_BF20A6_DVP_DEFAULT_FMT

    config CAMERA_BF20A6_DVP_IF_FORMAT_INDEX_DEFAULT
        int
        default 0 if CAMERA_BF20A6_DVP_DEFAULT_FMT_GRAY_640X480_15FPS
        help
            Sets the default configuration for the DVP interface.
            Use query_support_formats() API to get more format options.
endif
```
