## esp_cam_sensor/sensors/ov2640/Kconfig.ov2640
```kconfig
menuconfig CAMERA_OV2640
    bool "OV2640"
    default n
    depends on SOC_LCDCAM_CAM_SUPPORTED
    help
        Enable support for the OV2640 CMOS image sensor.

if CAMERA_OV2640
    menu "Auto detect OV2640"
        config CAMERA_OV2640_AUTO_DETECT_DVP_INTERFACE_SENSOR
            bool "Detect for DVP interface sensor"
            default y
            help
                When enabled, the OV2640 sensor will be automatically detected
                and initialized on the DVP interface at startup without requiring
                manual detection call(ov2640_detect) in your application.
    endmenu

    menu "Choose supported formats for DVP interface"
        config CAMERA_OV2640_DVP_JPEG_320X240_50FPS
            bool "DVP 8-bit, 20M input,  320x240  50fps, JPEG"
            default n
            help
                JPEG format at 320x240 resolution (QVGA) with 50fps framerate.
                Requires 8-bit DVP interface and 20MHz input clock.

        config CAMERA_OV2640_DVP_JPEG_640X480_25FPS
            bool "DVP 8-bit, 20M input,  640x480  25fps, JPEG"
            default n
            help
                JPEG format at 640x480 resolution (VGA) with 25fps framerate.
                Requires 8-bit DVP interface and 20MHz input clock.

        config CAMERA_OV2640_DVP_JPEG_1280X720_12FPS
            bool "DVP 8-bit, 20M input, 1280x720  12fps, JPEG"
            default n
            help
                JPEG format at 1280x720 resolution (HD) with 12fps framerate.
                Requires 8-bit DVP interface and 20MHz input clock.

        config CAMERA_OV2640_DVP_JPEG_1600X1200_12FPS
            bool "DVP 8-bit, 20M input, 1600x1200 12fps, JPEG"
            default n
            help
                JPEG format at 1600x1200 resolution (UXGA) with 12fps framerate.
                Requires 8-bit DVP interface and 20MHz input clock.

        config CAMERA_OV2640_DVP_RAW8_800X640_15FPS
            bool "DVP 8-bit, 20M input,  800x640  15fps, RAW8"
            default n
            help
                RAW8 format at 800x640 resolution with 15fps framerate.
                Requires 8-bit DVP interface and 20MHz input clock.

        config CAMERA_OV2640_DVP_RAW8_800X640_30FPS
            bool "DVP 8-bit, 20M input,  800x640  30fps, RAW8"
            default n
            help
                RAW8 format at 800x640 resolution with 30fps framerate.
                Requires 8-bit DVP interface and 20MHz input clock.

        config CAMERA_OV2640_DVP_RAW8_800X800_15FPS
            bool "DVP 8-bit, 20M input,  800x800  15fps, RAW8"
            default n
            help
                RAW8 format at 800x800 resolution with 15fps framerate.
                Requires 8-bit DVP interface and 20MHz input clock.

        config CAMERA_OV2640_DVP_RAW8_1024X600_15FPS
            bool "DVP 8-bit, 20M input, 1024x600  15fps, RAW8"
            default n
            help
                RAW8 format at 1024x600 resolution with 15fps framerate.
                Requires 8-bit DVP interface and 20MHz input clock.

        config CAMERA_OV2640_DVP_RGB565_BE_240X240_25FPS
            bool "DVP 8-bit, 20M input,  240x240  25fps, RGB565(BE)"
            default n
            help
                RGB565(BE) color format at 240x240 resolution with 25fps framerate.
                Requires 8-bit DVP interface and 20MHz input clock.

        config CAMERA_OV2640_DVP_RGB565_BE_640X480_6FPS
            bool "DVP 8-bit, 20M input,  640x480   6fps, RGB565(BE)"
            default n
            help
                RGB565(BE) color format at 640x480 resolution (VGA) with 6fps framerate.
                Requires 8-bit DVP interface and 20MHz input clock.

        config CAMERA_OV2640_DVP_RGB565_240X240_25FPS
            bool "DVP 8-bit, 20M input,  240x240  25fps, RGB565(LE)"
            default n
            help
                RGB565(LE) color format at 240x240 resolution with 25fps framerate.
                Requires 8-bit DVP interface and 20MHz input clock.

        config CAMERA_OV2640_DVP_RGB565_640X480_6FPS
            bool "DVP 8-bit, 20M input,  640x480   6fps, RGB565(LE)"
            default n
            help
                RGB565(LE) color format at 640x480 resolution (VGA) with 6fps framerate.
                Requires 8-bit DVP interface and 20MHz input clock.

        config CAMERA_OV2640_DVP_YUV422_240X240_25FPS
            bool "DVP 8-bit, 20M input,  240x240  25fps, YUV422(UYVY)"
            default n
            help
                YUV422(UYVY) color format at 240x240 resolution with 25fps framerate.
                Requires 8-bit DVP interface and 20MHz input clock.

        config CAMERA_OV2640_DVP_YUV422_320x240_25FPS
            bool "DVP 8-bit, 20M input,  320x240  25fps, YUV422(UYVY)"
            default n
            help
                YUV422(UYVY) color format at 320x240 resolution with 25fps framerate.
                Requires 8-bit DVP interface and 20MHz input clock.

        config CAMERA_OV2640_DVP_YUV422_640X480_6FPS
            bool "DVP 8-bit, 20M input,  640x480   6fps, YUV422(UYVY)"
            default y if IDF_TARGET_ESP32P4
            default n
            help
                YUV422(UYVY) color format at 640x480 resolution (VGA) with 6fps framerate.
                Requires 8-bit DVP interface and 20MHz input clock.

        config CAMERA_OV2640_DVP_YUV422_YUYV_240X240_25FPS
            bool "DVP 8-bit, 20M input,  240x240  25fps, YUV422(YUYV)"
            default n
            help
                YUV422(YUYV) color format at 240x240 resolution with 25fps framerate.
                Requires 8-bit DVP interface and 20MHz input clock.

        config CAMERA_OV2640_DVP_YUV422_YUYV_320x240_25FPS
            bool "DVP 8-bit, 20M input,  320x240  25fps, YUV422(YUYV)"
            default n
            help
                YUV422(YUYV) color format at 320x240 resolution with 25fps framerate.
                Requires 8-bit DVP interface and 20MHz input clock.

        config CAMERA_OV2640_DVP_YUV422_YUYV_640X480_6FPS
            bool "DVP 8-bit, 20M input,  640x480   6fps, YUV422(YUYV)"
            default y if !IDF_TARGET_ESP32P4
            default n
            help
                YUV422(YUYV) color format at 640x480 resolution (VGA) with 6fps framerate.
                Requires 8-bit DVP interface and 20MHz input clock.
    endmenu

    choice CAMERA_OV2640_DVP_DEFAULT_FMT
        prompt "Select default output format for DVP interface"
        default CAMERA_OV2640_DVP_DEFAULT_FMT_RGB565_640X480_6FPS
        help
            This is an internal choice that ensures only one format can be selected as default.
            It is automatically controlled by the "Set as default format" options above.

        config CAMERA_OV2640_DVP_DEFAULT_FMT_JPEG_320X240_50FPS
            bool "DVP 8-bit, 20M input,  320x240  50fps, JPEG"
            depends on CAMERA_OV2640_DVP_JPEG_320X240_50FPS

        config CAMERA_OV2640_DVP_DEFAULT_FMT_JPEG_640X480_25FPS
            bool "DVP 8-bit, 20M input,  640x480  25fps, JPEG"
            depends on CAMERA_OV2640_DVP_JPEG_640X480_25FPS

        config CAMERA_OV2640_DVP_DEFAULT_FMT_JPEG_1280X720_12FPS
            bool "DVP 8-bit, 20M input, 1280x720  12fps, JPEG"
            depends on CAMERA_OV2640_DVP_JPEG_1280X720_12FPS

        config CAMERA_OV2640_DVP_DEFAULT_FMT_JPEG_1600X1200_12FPS
            bool "DVP 8-bit, 20M input, 1600x1200 12fps, JPEG"
            depends on CAMERA_OV2640_DVP_JPEG_1600X1200_12FPS

        config CAMERA_OV2640_DVP_DEFAULT_FMT_RAW8_800X640_15FPS
            bool "DVP 8-bit, 20M input,  800x640  15fps, RAW8"
            depends on CAMERA_OV2640_DVP_RAW8_800X640_15FPS

        config CAMERA_OV2640_DVP_DEFAULT_FMT_RAW8_800X640_30FPS
            bool "DVP 8-bit, 20M input,  800x640  30fps, RAW8"
            depends on CAMERA_OV2640_DVP_RAW8_800X640_30FPS

        config CAMERA_OV2640_DVP_DEFAULT_FMT_RAW8_800X800_15FPS
            bool "DVP 8-bit, 20M input,  800x800  15fps, RAW8"
            depends on CAMERA_OV2640_DVP_RAW8_800X800_15FPS

        config CAMERA_OV2640_DVP_DEFAULT_FMT_RAW8_1024X600_15FPS
            bool "DVP 8-bit, 20M input, 1024x600  15fps, RAW8"
            depends on CAMERA_OV2640_DVP_RAW8_1024X600_15FPS

        config CAMERA_OV2640_DVP_DEFAULT_FMT_RGB565_BE_240X240_25FPS
            bool "DVP 8-bit, 20M input,  240x240  25fps, RGB565(BE)"
            depends on CAMERA_OV2640_DVP_RGB565_BE_240X240_25FPS

        config CAMERA_OV2640_DVP_DEFAULT_FMT_RGB565_BE_640X480_6FPS
            bool "DVP 8-bit, 20M input,  640x480   6fps, RGB565(BE)"
            depends on CAMERA_OV2640_DVP_RGB565_BE_640X480_6FPS

        config CAMERA_OV2640_DVP_DEFAULT_FMT_RGB565_240X240_25FPS
            bool "DVP 8-bit, 20M input,  240x240  25fps, RGB565(LE)"
            depends on CAMERA_OV2640_DVP_RGB565_240X240_25FPS

        config CAMERA_OV2640_DVP_DEFAULT_FMT_RGB565_640X480_6FPS
            bool "DVP 8-bit, 20M input,  640x480   6fps, RGB565(LE)"
            depends on CAMERA_OV2640_DVP_RGB565_640X480_6FPS

        config CAMERA_OV2640_DVP_DEFAULT_FMT_YUV422_240X240_25FPS
            bool "DVP 8-bit, 20M input,  240x240  25fps, YUV422(UYVY)"
            depends on CAMERA_OV2640_DVP_YUV422_240X240_25FPS

        config CAMERA_OV2640_DVP_DEFAULT_FMT_YUV422_320x240_25FPS
            bool "DVP 8-bit, 20M input,  320x240  25fps, YUV422(UYVY)"
            depends on CAMERA_OV2640_DVP_YUV422_320x240_25FPS

        config CAMERA_OV2640_DVP_DEFAULT_FMT_YUV422_640X480_6FPS
            bool "DVP 8-bit, 20M input,  640x480   6fps, YUV422(UVYV)"
            depends on CAMERA_OV2640_DVP_YUV422_640X480_6FPS

        config CAMERA_OV2640_DVP_DEFAULT_FMT_YUV422_YUYV_240X240_25FPS
            bool "DVP 8-bit, 20M input,  240x240  25fps, YUV422(YUYV)"
            depends on CAMERA_OV2640_DVP_YUV422_YUYV_240X240_25FPS

        config CAMERA_OV2640_DVP_DEFAULT_FMT_YUV422_YUYV_320x240_25FPS
            bool "DVP 8-bit, 20M input,  320x240  25fps, YUV422(YUYV)"
            depends on CAMERA_OV2640_DVP_YUV422_YUYV_320x240_25FPS

        config CAMERA_OV2640_DVP_DEFAULT_FMT_YUV422_YUYV_640X480_6FPS
            bool "DVP 8-bit, 20M input,  640x480   6fps, YUV422(YUYV)"
            depends on CAMERA_OV2640_DVP_YUV422_YUYV_640X480_6FPS
    endchoice # CAMERA_OV2640_DVP_DEFAULT_FMT

    config CAMERA_OV2640_DVP_IF_FORMAT_INDEX_DEFAULT
        int
        default 0 if CAMERA_OV2640_DVP_DEFAULT_FMT_RGB565_640X480_6FPS
        default 1 if CAMERA_OV2640_DVP_DEFAULT_FMT_YUV422_640X480_6FPS
        default 2 if CAMERA_OV2640_DVP_DEFAULT_FMT_JPEG_640X480_25FPS
        default 3 if CAMERA_OV2640_DVP_DEFAULT_FMT_RGB565_240X240_25FPS
        default 4 if CAMERA_OV2640_DVP_DEFAULT_FMT_YUV422_240X240_25FPS
        default 5 if CAMERA_OV2640_DVP_DEFAULT_FMT_JPEG_320X240_50FPS
        default 6 if CAMERA_OV2640_DVP_DEFAULT_FMT_JPEG_1280X720_12FPS
        default 7 if CAMERA_OV2640_DVP_DEFAULT_FMT_JPEG_1600X1200_12FPS
        default 8 if CAMERA_OV2640_DVP_DEFAULT_FMT_RAW8_800X640_30FPS
        default 9 if CAMERA_OV2640_DVP_DEFAULT_FMT_RAW8_800X640_15FPS
        default 10 if CAMERA_OV2640_DVP_DEFAULT_FMT_RAW8_800X800_15FPS
        default 11 if CAMERA_OV2640_DVP_DEFAULT_FMT_RAW8_1024X600_15FPS
        default 12 if CAMERA_OV2640_DVP_DEFAULT_FMT_RGB565_BE_640X480_6FPS
        default 13 if CAMERA_OV2640_DVP_DEFAULT_FMT_YUV422_YUYV_640X480_6FPS
        default 14 if CAMERA_OV2640_DVP_DEFAULT_FMT_RGB565_BE_240X240_25FPS
        default 15 if CAMERA_OV2640_DVP_DEFAULT_FMT_YUV422_YUYV_240X240_25FPS
        default 16 if CAMERA_OV2640_DVP_DEFAULT_FMT_YUV422_320x240_25FPS
        default 17 if CAMERA_OV2640_DVP_DEFAULT_FMT_YUV422_YUYV_320x240_25FPS
        help
            Sets the default configuration for the DVP interface.
            Use query_support_formats() API to get more format options.
endif
```
