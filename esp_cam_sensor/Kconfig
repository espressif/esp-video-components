## esp_cam_sensor/sensors/os04c10/Kconfig.os04c10
```kconfig
menuconfig CAMERA_OS04C10
    bool "OS04C10"
    default n
    depends on SOC_MIPI_CSI_SUPPORTED
    help
        Enable support for the OS04C10 CMOS image sensor.

if CAMERA_OS04C10
    menu "Auto detect OS04C10"
        config CAMERA_OS04C10_AUTO_DETECT_MIPI_INTERFACE_SENSOR
            bool "Detect for MIPI CSI interface sensor"
            default y
            depends on SOC_MIPI_CSI_SUPPORTED
            help
                When enabled, the OS04C10 sensor will be automatically detected
                and initialized on the MIPI CSI interface at startup without requiring
                manual detection call(os04c10_detect) in your application.
    endmenu

    config CAMERA_OS04C10_SID_HIGH
        bool "Set SID pin to high"
        default n
        help
            This option allows you to configure the sensor ID. When the SID pin uses a high level, 
            the sensor ID will be configured as 0x10, otherwise, the sensor ID will be configured as 0x36.

    menu "Choose supported formats for MIPI CSI interface"
        config CAMERA_OS04C10_MIPI_RAW10_810X1080_30FPS
            bool "MIPI 1-lane, 24M input, 810x1080 30fps, RAW10"
            default y
            help
                RAW10 color format at 810x1080 resolution with 30fps framerate.
                Requires MIPI CSI-2 1-lane interface with 24MHz input clock.

        config CAMERA_OS04C10_MIPI_RAW10_960X1280_30FPS
            bool "MIPI 1-lane, 24M input, 960x1280 30fps, RAW10"
            default n
            help
                RAW10 color format at 960x1280 resolution with 30fps framerate.
                Requires MIPI CSI-2 1-lane interface with 24MHz input clock.
    endmenu

    choice CAMERA_OS04C10_MIPI_DEFAULT_FMT
        prompt "Select default output format for MIPI CSI interface"
        default CAMERA_OS04C10_MIPI_DEFAULT_FMT_RAW10_810X1080_30FPS
        help
            This option allows you to select the default video format for the OS04C10 sensor
            when it is initialized on the MIPI CSI interface. The selected format will be used
            when the sensor is detected and initialized, and can be changed later when the
            sensor is in stream off state.

        config CAMERA_OS04C10_MIPI_DEFAULT_FMT_RAW10_810X1080_30FPS
            bool "MIPI 1-lane, 24M input, 810x1080 30fps, RAW10"
            depends on CAMERA_OS04C10_MIPI_RAW10_810X1080_30FPS

        config CAMERA_OS04C10_MIPI_DEFAULT_FMT_RAW10_960X1280_30FPS
            bool "MIPI 1-lane, 24M input, 960x1280 30fps, RAW10"
            depends on CAMERA_OS04C10_MIPI_RAW10_960X1280_30FPS
    endchoice # CAMERA_OS04C10_MIPI_DEFAULT_FMT

    config CAMERA_OS04C10_MIPI_IF_FORMAT_INDEX_DEFAULT
        int
        default 0 if CAMERA_OS04C10_MIPI_DEFAULT_FMT_RAW10_810X1080_30FPS
        default 1 if CAMERA_OS04C10_MIPI_DEFAULT_FMT_RAW10_960X1280_30FPS
        help
            Sets the default configuration for the MIPI CSI interface.
            Use query_support_formats() API to get more format options.

    config CAMERA_OS04C10_ABSOLUTE_GAIN_LIMIT
        int "Maximum absolute gain limit (x1000)"
        default 12000
        range 4000 15000
        help
            Set the maximum gain limit that can be applied by upper-level applications.

            Value is gain multiplied by 1000 to avoid floating-point arithmetic:
            - 4000 = 4x gain (minimum)
            - 15000 = 15x gain (maximum)

            Lower values reduce noise but may limit low-light performance.
            Higher values improve low-light sensitivity but increase noise and
            may cause sensor overheating.

            Recommended values:
            - 8000 (8x): Good balance for most applications
            - 12000 (12x): Enhanced low-light performance
            - 15000 (15x): Maximum sensitivity (use with caution)

    choice CAMERA_OS04C10_IPA_JSON_CONFIGURATION_FILE
        prompt "IPA Configuration File"
        default CAMERA_OS04C10_DEFAULT_IPA_JSON_CONFIGURATION_FILE
        help
            Select the Image Processing Algorithm (IPA) JSON configuration file
            for the OS04C10 sensor.

        config CAMERA_OS04C10_DEFAULT_IPA_JSON_CONFIGURATION_FILE
            bool "Use default configuration"
            help
                Use the built-in default IPA configuration file:
                "esp_cam_sensor/sensors/os04c10/cfg/os04c10_default.json"

                This configuration provides optimized settings for general use cases
                and is recommended for most applications.

        config CAMERA_OS04C10_CUSTOMIZED_IPA_JSON_CONFIGURATION_FILE
            bool "Use custom configuration"
            help
                Use a custom IPA configuration file with your own optimized settings.

                This option allows you to fine-tune sensor parameters for specific
                lighting conditions, color requirements, or application needs.

                You must specify the custom file path in the configuration below.
    endchoice

    config CAMERA_OS04C10_CUSTOMIZED_IPA_JSON_CONFIGURATION_FILE_PATH
        string "Custom IPA configuration file path"
        depends on CAMERA_OS04C10_CUSTOMIZED_IPA_JSON_CONFIGURATION_FILE
        help
            Specify the path to your custom OS04C10 IPA JSON configuration file.

            The path is relative to your project root directory.

            Example: "components/my_camera_config/os04c10_custom.json"

            Ensure the file exists and contains valid JSON configuration
            parameters compatible with the OS04C10 sensor.
endif
```
