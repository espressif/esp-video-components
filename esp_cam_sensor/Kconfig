## esp_cam_sensor/sensors/ov5645/Kconfig.ov5645
```kconfig
menuconfig CAMERA_OV5645
    bool "OV5645"
    default n
    depends on SOC_MIPI_CSI_SUPPORTED
    help
        Enabling this option will add the support for OV5645.

if CAMERA_OV5645
    menu "Auto detect OV5645"
        config CAMERA_OV5645_AUTO_DETECT_MIPI_INTERFACE_SENSOR
            bool "Detect for MIPI interface sensor"
            default y
            help
                When enabled, you don't need to call ov5645_detect manaually, OV5645
                will be automatically detected and connected to the MIPI CSI interface
                when the application starts.
    endmenu

    choice CAMERA_OV5645_MIPI_DEFAULT_FMT
        prompt "Default format select"
        default CAMERA_OV5645_MIPI_YUV422_1280X960_30FPS
        help
            Select the default format to load when the sensor is detected.
            When the sensor is in stream off state, the format can be changed.
    
        config CAMERA_OV5645_MIPI_YUV422_1280X960_30FPS
            bool "YUV422 1280x960 30fps, MIPI 2lane 24M input"
        config CAMERA_OV5645_MIPI_RGB565_1280X960_30FPS
            bool "RGB565 1280x960 30fps, MIPI 2lane 24M input"
        config CAMERA_OV5645_MIPI_YUV420_1280X960_30FPS
            bool "YUV420 1280x960 30fps, MIPI 2lane 24M input"
        config CAMERA_OV5645_MIPI_YUV422_2592X1944_15FPS
            bool "YUV422 2592x1944 15fps, MIPI 2lane 24M input"
        config CAMERA_OV5645_MIPI_YUV422_1920X1080_15FPS
            bool "YUV422 1920x1080 15fps, MIPI 2lane 24M input"
        config CAMERA_OV5645_MIPI_YUV422_640X480_24FPS
            bool "YUV422 640x480 24fps, MIPI 2lane 24M input"
    endchoice # CAMERA_OV5645_MIPI_DEFAULT_FMT

    config CAMERA_OV5645_MIPI_IF_FORMAT_INDEX_DAFAULT
        int
        default 0 if CAMERA_OV5645_MIPI_YUV422_1280X960_30FPS
        default 1 if CAMERA_OV5645_MIPI_RGB565_1280X960_30FPS
        default 2 if CAMERA_OV5645_MIPI_YUV420_1280X960_30FPS
        default 3 if CAMERA_OV5645_MIPI_YUV422_2592X1944_15FPS
        default 4 if CAMERA_OV5645_MIPI_YUV422_1920X1080_15FPS
        default 5 if CAMERA_OV5645_MIPI_YUV422_640X480_24FPS
        help
            Set the configuration loaded by default for the MIPI interface.
            More information can be obtained by calling the query_support_formats().

    config CAMERA_OV5645_CSI_LINESYNC_ENABLE
        bool "CSI Line sync enable"
        default y
        help
            If enabled, send line short packet for each line.
endif
```

## esp_cam_sensor/sensors/ov5647/Kconfig.ov5647
```kconfig
menuconfig CAMERA_OV5647
    bool "OV5647"
    default n
    help
        Enabling this option will add the support for OV5647.

if CAMERA_OV5647
    menuconfig CAMERA_OV5647_AUTO_DETECT
        bool "Auto detect OV5647"
        default y
        help
            When enabled, it provides the ability in application layer to automatically
            detect camera sensors one by one.

    if CAMERA_OV5647_AUTO_DETECT
        config CAMERA_OV5647_AUTO_DETECT_MIPI_INTERFACE_SENSOR
            bool "Detect for MIPI interface sensor"
            default y
            help
                When enabled, you don't need to call ov5647_detect manaually, ov5647
                will be automatically detected and connected to the MIPI CSI interface
                when the application starts.
    endif

    choice CAMERA_OV5647_MIPI_DEFAULT_FMT
        prompt "Default format select"
        default CAMERA_OV5647_MIPI_RAW8_800x800_50FPS
        help
            Select the default format to load when the sensor is detected.
            When the sensor is in stream off state, the format can be changed.
    
        config CAMERA_OV5647_MIPI_RAW8_800x1280_50FPS
            bool "RAW8 800x1280 50fps, MIPI 2lane 24M input"
        config CAMERA_OV5647_MIPI_RAW8_800x640_50FPS
            bool "RAW8 800x640 50fps, MIPI 2lane 24M input"
        config CAMERA_OV5647_MIPI_RAW8_800x800_50FPS
            bool "RAW8 800x800 50fps, MIPI 2lane 24M input"
    endchoice # CAMERA_OV5647_MIPI_DEFAULT_FMT

    config CAMERA_OV5647_MIPI_IF_FORMAT_INDEX_DAFAULT
        int
        default 0 if CAMERA_OV5647_MIPI_RAW8_800x1280_50FPS
        default 1 if CAMERA_OV5647_MIPI_RAW8_800x640_50FPS
        default 2 if CAMERA_OV5647_MIPI_RAW8_800x800_50FPS
        help
            Set the configuration loaded by default for the MIPI interface.
            More information can be obtained by calling the query_support_formats().

    config CAMERA_OV5647_CSI_LINESYNC_ENABLE
        bool "CSI Line sync enable"
        default y
        help
            If enabled, send line short packet for each line.

    config CAMERA_OV5647_ISP_AF_ENABLE
        bool "AF(auto focus) enable"
        default y
        help
            If enabled, the camera module will enable some IO pins to drive the
            VCM motor.
endif
```

## esp_cam_sensor/sensors/ov9281/Kconfig.ov9281
```kconfig
menuconfig CAMERA_OV9281
    bool "OV9281"
    default n
    depends on SOC_MIPI_CSI_SUPPORTED
    help
        Enable support for the OV9281 CMOS image sensor.

if CAMERA_OV9281
    menu "Auto detect OV9281"
        config CAMERA_OV9281_AUTO_DETECT_MIPI_INTERFACE_SENSOR
            bool "Detect for MIPI CSI interface sensor"
            default y
            help
                When enabled, the OV9281 sensor will be automatically detected
                and initialized on the MIPI CSI interface at startup without requiring
                manual detection call(ov9281_detect) in your application.
    endmenu

    menu "Choose supported formats for MIPI CSI interface"
        config CAMERA_OV9281_MIPI_RAW8_640X400_100FPS
            bool "MIPI 2-lane, 24M input,  640x400 100fps, RAW8"
            default y
            help
                RAW8 color format at 640x400 resolution with 100fps framerate.
                Requires MIPI CSI-2 2-lane interface with 24MHz input clock.

        config CAMERA_OV9281_MIPI_RAW8_1280X720_50FPS
            bool "MIPI 2-lane, 24M input, 1280x720 50fps, RAW8"
            default n
            help
                RAW8 color format at 1280x720 resolution (HD) with 50fps framerate.
                Requires MIPI CSI-2 2-lane interface with 24MHz input clock.
    endmenu

    choice CAMERA_OV9281_MIPI_DEFAULT_FMT
        prompt "Select default output format for MIPI CSI interface"
        default CAMERA_OV9281_MIPI_DEFAULT_FMT_RAW8_640X400_100FPS
        help
            This option allows you to select the default video format for the OV9281 sensor
            when it is initialized on the MIPI CSI interface. The selected format will be used
            when the sensor is detected and initialized, and can be changed later when the
            sensor is in stream off state.

        config CAMERA_OV9281_MIPI_DEFAULT_FMT_RAW8_640X400_100FPS
            bool "MIPI 2-lane, 24M input,  640x400 100fps, RAW8"
            depends on CAMERA_OV9281_MIPI_RAW8_640X400_100FPS

        config CAMERA_OV9281_MIPI_DEFAULT_FMT_RAW8_1280X720_50FPS
            bool "MIPI 2-lane, 24M input, 1280x720 50fps, RAW8"
            depends on CAMERA_OV9281_MIPI_RAW8_1280X720_50FPS
    endchoice # CAMERA_OV9281_MIPI_DEFAULT_FMT

    config CAMERA_OV9281_MIPI_IF_FORMAT_INDEX_DEFAULT
        int
        default 0 if CAMERA_OV9281_MIPI_DEFAULT_FMT_RAW8_640X400_100FPS
        default 1 if CAMERA_OV9281_MIPI_DEFAULT_FMT_RAW8_1280X720_50FPS
        help
            Sets the default configuration for the MIPI CSI interface.
            Use query_support_formats() API to get more format options.

    config CAMERA_OV9281_SID_LOW
        bool "Set SID pin to low"
        default n
        help
            This option allows you to configure the sensor ID. When the SID pin uses a high level,
            the sensor ID will be configured as 0xe0, otherwise, the sensor ID will be configured as 0x60.

    config CAMERA_OV9281_ABSOLUTE_GAIN_LIMIT
        int "Maximum absolute gain limit (x1000)"
        default 11750
        range 4000 15750
        help
            Set the maximum gain limit that can be applied by upper-level applications.

            Value is gain multiplied by 1000 to avoid floating-point arithmetic:
            - 4000 = 4x gain (minimum)

            Lower values reduce noise but may limit low-light performance.
            Higher values improve low-light sensitivity but increase noise and
            may cause sensor overheating.

    choice CAMERA_OV9281_IPA_JSON_CONFIGURATION_FILE
        prompt "IPA Configuration File"
        default CAMERA_OV9281_DEFAULT_IPA_JSON_CONFIGURATION_FILE
        help
            Select the Image Processing Algorithm (IPA) JSON configuration file
            for the OV9281 sensor.

        config CAMERA_OV9281_DEFAULT_IPA_JSON_CONFIGURATION_FILE
            bool "Use default configuration"
            help
                Use the built-in default IPA configuration file:
                "esp_cam_sensor/sensors/ov9281/cfg/ov9281_default.json"

                This configuration provides optimized settings for general use cases
                and is recommended for most applications.

        config CAMERA_OV9281_CUSTOMIZED_IPA_JSON_CONFIGURATION_FILE
            bool "Use custom configuration"
            help
                Use a custom IPA configuration file with your own optimized settings.

                This option allows you to fine-tune sensor parameters for specific
                lighting conditions, color requirements, or application needs.

                You must specify the custom file path in the configuration below.
    endchoice

    config CAMERA_OV9281_CUSTOMIZED_IPA_JSON_CONFIGURATION_FILE_PATH
        string "Custom IPA configuration file path"
        depends on CAMERA_OV9281_CUSTOMIZED_IPA_JSON_CONFIGURATION_FILE
        help
            Specify the path to your custom OV9281 IPA JSON configuration file.

            The path is relative to your project root directory.

            Example: "components/my_camera_config/ov9281_custom.json"

            Ensure the file exists and contains valid JSON configuration
            parameters compatible with the OV9281 sensor.
endif
```
