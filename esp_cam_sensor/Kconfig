## esp_cam_sensor/sensors/pivariety/Kconfig.pivariety
```kconfig
menuconfig CAMERA_PIVARIETY
    bool "PIVARIETY"
    default n
    depends on SOC_MIPI_CSI_SUPPORTED
    help
        Enable support for the PIVARIETY CMOS image sensor.

if CAMERA_PIVARIETY
    menu "Auto detect PIVARIETY"
        config CAMERA_PIVARIETY_AUTO_DETECT_MIPI_INTERFACE_SENSOR
            bool "Detect for MIPI CSI interface sensor"
            default y
            help
                When enabled, the PIVARIETY sensor will be automatically detected
                and initialized on the MIPI CSI interface at startup without requiring
                manual detection call(pivariety_detect) in your application.
    endmenu

    menu "Choose supported formats for MIPI CSI interface"

         config CAMERA_PIVARIETY_MIPI_RAW10_1920X1080_30FPS
            bool "MIPI 2-lane, 24M input, 1920x1080  30fps, RAW10"
            default y
            help
                RAW10 color format at 1920x1080 resolution with 30fps framerate.
                Requires MIPI CSI-2 2-lane interface with 24MHz input clock.

        config CAMERA_PIVARIETY_MIPI_RAW10_1600X1200_30FPS
            bool "MIPI 2-lane, 24M input, 1600x1200  30fps, RAW10"
            default n
            help
                RAW10 color format at 1600x1200 resolution with 30fps framerate.
                Requires MIPI CSI-2 2-lane interface with 24MHz input clock.

        config CAMERA_PIVARIETY_MIPI_RAW10_1280X720_30FPS
            bool "MIPI 2-lane, 24M input, 1280x720  30fps, RAW10"
            default n
            help
                RAW10 color format at 1280x720 resolution with 30fps framerate.
                Requires MIPI CSI-2 2-lane interface with 24MHz input clock.

        config CAMERA_PIVARIETY_MIPI_RAW10_1024X600_30FPS
            bool "MIPI 2-lane, 24M input, 1024x600  30fps, RAW10"
            default n
            help
                RAW10 color format at 1024x600 resolution with 30fps framerate.
                Requires MIPI CSI-2 2-lane interface with 24MHz input clock.
        
        config CAMERA_PIVARIETY_MIPI_RAW10_640X480_30FPS
            bool "MIPI 2-lane, 24M input, 640x480  30fps, RAW10"
            default n
            help
                RAW10 color format at 640x480 resolution with 30fps framerate.
                Requires MIPI CSI-2 2-lane interface with 24MHz input clock.
    endmenu

    choice CAMERA_PIVARIETY_MIPI_DEFAULT_FMT
        prompt "Select default output format for MIPI CSI interface"
        default CAMERA_PIVARIETY_MIPI_DEFAULT_FMT_RAW10_1920X1080_30FPS
        help
            Select the default video output format for the Pivariety camera sensor over MIPI CSI.
            The actual supported resolutions and frame rates must be enumerated from the sensor
            firmware during driver initialization. The selected default format will be applied
            only if it is supported by the sensor; otherwise, the first enumerated valid format
            will be used automatically.
        

        config CAMERA_PIVARIETY_MIPI_DEFAULT_FMT_RAW10_1920X1080_30FPS
            bool "MIPI 2-lane, 24M input, 1920x1080  30fps, RAW10"
            depends on CAMERA_PIVARIETY_MIPI_RAW10_1920X1080_30FPS

        config CAMERA_PIVARIETY_MIPI_DEFAULT_FMT_RAW10_1600X1200_30FPS
            bool "MIPI 2-lane, 24M input, 1600x1200  30fps, RAW10"
            depends on CAMERA_PIVARIETY_MIPI_RAW10_1600X1200_30FPS
        
        config CAMERA_PIVARIETY_MIPI_DEFAULT_FMT_RAW10_1280X720_30FPS
            bool "MIPI 2-lane, 24M input, 1280x720  30fps, RAW10"
            depends on CAMERA_PIVARIETY_MIPI_RAW10_1280X720_30FPS

        config CAMERA_PIVARIETY_MIPI_DEFAULT_FMT_RAW10_1024X600_30FPS
            bool "MIPI 2-lane, 24M input, 1024x600  30fps, RAW10"
            depends on CAMERA_PIVARIETY_MIPI_RAW10_1024X600_30FPS
        
        config CAMERA_PIVARIETY_MIPI_DEFAULT_FMT_RAW10_640X480_30FPS
            bool "MIPI 2-lane, 24M input, 640x480  30fps, RAW10"
            depends on CAMERA_PIVARIETY_MIPI_RAW10_640X480_30FPS

    endchoice # CAMERA_PIVARIETY_MIPI_DEFAULT_FMT

    config CAMERA_PIVARIETY_MIPI_IF_FORMAT_INDEX_DEFAULT
        int
        default 0 if CAMERA_PIVARIETY_MIPI_DEFAULT_FMT_RAW10_1920X1080_30FPS
        default 1 if CAMERA_PIVARIETY_MIPI_DEFAULT_FMT_RAW10_1600X1200_30FPS
        default 2 if CAMERA_PIVARIETY_MIPI_DEFAULT_FMT_RAW10_1280X720_30FPS
        default 3 if CAMERA_PIVARIETY_MIPI_DEFAULT_FMT_RAW10_1024X600_30FPS
        default 4 if CAMERA_PIVARIETY_MIPI_DEFAULT_FMT_RAW10_640X480_30FPS
        help
            Sets the default configuration for the MIPI CSI interface.
            Use query_support_formats() API to get more format options.

    choice CAMERA_PIVARIETY_IPA_JSON_CONFIGURATION_FILE
        prompt "IPA Configuration File"
        default CAMERA_PIVARIETY_DEFAULT_IPA_JSON_CONFIGURATION_FILE
        help
            Select the Image Processing Algorithm (IPA) JSON configuration file
            for the PIVARIETY sensor.

        config CAMERA_PIVARIETY_DEFAULT_IPA_JSON_CONFIGURATION_FILE
            bool "Use default configuration"
            help
                Use the built-in default IPA configuration file:
                "esp_cam_sensor/sensors/pivariety/cfg/pivariety_default.json"

                This configuration provides optimized settings for general use cases
                and is recommended for most applications.

        config CAMERA_PIVARIETY_CUSTOMIZED_IPA_JSON_CONFIGURATION_FILE
            bool "Use custom configuration"
            help
                Use a custom IPA configuration file with your own optimized settings.

                This option allows you to fine-tune sensor parameters for specific
                lighting conditions, color requirements, or application needs.

                You must specify the custom file path in the configuration below.
    endchoice

    config CAMERA_PIVARIETY_CUSTOMIZED_IPA_JSON_CONFIGURATION_FILE_PATH
        string "Custom IPA configuration file path"
        depends on CAMERA_PIVARIETY_CUSTOMIZED_IPA_JSON_CONFIGURATION_FILE
        help
            Specify the path to your custom PIVARIETY IPA JSON configuration file.

            The path is relative to your project root directory.

            Example: "components/my_camera_config/pivariety_custom.json"

            Ensure the file exists and contains valid JSON configuration
            parameters compatible with the PIVARIETY sensor.
endif
```

## esp_cam_sensor/sensors/sc030iot/Kconfig.sc030iot
```kconfig
menuconfig CAMERA_SC030IOT
    bool "SC030IOT"
    default n
    depends on SOC_MIPI_CSI_SUPPORTED || SOC_LCDCAM_CAM_SUPPORTED
    help
        Enabling this option will add the support for SC030IOT.

if CAMERA_SC030IOT
    menu "Auto detect SC030IOT"
        config CAMERA_SC030IOT_AUTO_DETECT_DVP_INTERFACE_SENSOR
            bool "Detect for DVP interface sensor"
            default y
            depends on SOC_LCDCAM_CAM_SUPPORTED
            help
                When enabled, you don't need to call sc030iot_detect manaually, SC030IOT will
                be automatically detected and connected to the DVP interface when the
                application starts.
    
        config CAMERA_SC030IOT_AUTO_DETECT_MIPI_INTERFACE_SENSOR
            bool "Detect for MIPI interface sensor"
            default n
            depends on SOC_MIPI_CSI_SUPPORTED
            help
                When enabled, you don't need to call sc030iot_detect manaually, SC030IOT will
                be automatically detected and connected to the MIPI CSI interface when
                the application starts.
    endmenu

    choice CAMERA_SC030IOT_DVP_DEFAULT_FMT
        prompt "Default format select"
        default CAMERA_SC030IOT_DVP_YUV422_640X480_26FPS
        depends on SOC_LCDCAM_CAM_SUPPORTED
        help
            Select the default format to load when the sensor is detected.
            When the sensor is in stream off state, the format can be changed.
    
        config CAMERA_SC030IOT_DVP_YUV422_640X480_26FPS
            bool "YUV422 640x480 26fps, DVP 8bit 20M input"
        config CAMERA_SC030IOT_DVP_RAW8_640X480_26FPS
            bool "RAW8 640x480 26fps, DVP 8bit 20M input"
    endchoice # CAMERA_SC030IOT_DVP_DEFAULT_FMT

    config CAMERA_SC030IOT_DVP_IF_FORMAT_INDEX_DAFAULT
        int
        depends on SOC_LCDCAM_CAM_SUPPORTED
        default 0 if CAMERA_SC030IOT_DVP_YUV422_640X480_26FPS
        default 1 if CAMERA_SC030IOT_DVP_RAW8_640X480_26FPS
        help
            Set the configuration loaded by default for the DVP interface.
            More information can be obtained by calling the query_support_formats().
    
    choice CAMERA_SC030IOT_MIPI_DEFAULT_FMT
        prompt "Default format select for MIPI"
        default CAMERA_SC030IOT_MIPI_YUV422_640X480_25FPS
        depends on SOC_MIPI_CSI_SUPPORTED
        help
            Select the default format to load when the sensor is detected.
            When the sensor is in stream off state, the format can be changed.
    
        config CAMERA_SC030IOT_MIPI_YUV422_640X480_25FPS
            bool "YUV422 640x480 25fps, MIPI 1lane 24M input"
        config CAMERA_SC030IOT_MIPI_YUV422_640X480_50FPS
            bool "YUV422 640x480 50fps, MIPI 1lane 24M input"
        config CAMERA_SC030IOT_MIPI_RAW8_640X480_60FPS
            bool "RAW8 640x480 60fps, MIPI 1lane 24M input"
    endchoice # CAMERA_SC030IOT_MIPI_DEFAULT_FMT

    config CAMERA_SC030IOT_MIPI_IF_FORMAT_INDEX_DAFAULT
        int
        depends on SOC_MIPI_CSI_SUPPORTED
        default 0 if CAMERA_SC030IOT_MIPI_YUV422_640X480_25FPS
        default 1 if CAMERA_SC030IOT_MIPI_YUV422_640X480_50FPS
        default 2 if CAMERA_SC030IOT_MIPI_RAW8_640X480_60FPS
        help
            Set the configuration loaded by default for the MIPI interface.
            More information can be obtained by calling the query_support_formats().
endif
```

## esp_cam_sensor/sensors/sc035hgs/Kconfig.sc035hgs
```kconfig
menuconfig CAMERA_SC035HGS
    bool "SC035HGS"
    default n
    depends on SOC_MIPI_CSI_SUPPORTED
    help
        Enable support for the SC035HGS CMOS image sensor.

if CAMERA_SC035HGS
    menu "Auto detect SC035HGS"
        config CAMERA_SC035HGS_AUTO_DETECT_MIPI_INTERFACE_SENSOR
            bool "Detect for MIPI CSI interface sensor"
            default y
            depends on SOC_MIPI_CSI_SUPPORTED
            help
                When enabled, the SC035HGS sensor will be automatically detected
                and initialized on the MIPI CSI interface at startup without requiring
                manual detection call(sc035hgs_detect) in your application.
    endmenu

    menu "Choose supported formats for MIPI CSI interface"
        config CAMERA_SC035HGS_MIPI_RAW8_640X480_50FPS
            bool "MIPI 2-lane, 24M input, 640x480  50fps, RAW8"
            default n
            help
                RAW8 format at 640x480 resolution (VGA) with 50fps framerate.
                Requires MIPI CSI-2 2-lane interface with 24MHz input clock.

        config CAMERA_SC035HGS_MIPI_RAW8_640X480_100FPS
            bool "MIPI 2-lane, 24M input, 640x480 100fps, RAW8"
            default n
            help
                RAW8 format at 640x480 resolution (VGA) with 100fps framerate.
                Requires MIPI CSI-2 2-lane interface with 24MHz input clock.

        config CAMERA_SC035HGS_MIPI_RAW10_640X480_48FPS
            bool "MIPI 1-lane, 20M input, 640x480  48fps, RAW10"
            default y
            help
                RAW10 format at 640x480 resolution (VGA) with 48fps framerate.
                Requires MIPI CSI-2 1-lane interface with 20MHz input clock.

        config CAMERA_SC035HGS_MIPI_RAW10_640X480_120FPS
            bool "MIPI 1-lane, 24M input, 640x480 120fps, RAW10"
            default n
            help
                RAW10 format at 640x480 resolution (VGA) with 120fps framerate.
                Requires MIPI CSI-2 1-lane interface with 24MHz input clock.
    endmenu

    choice CAMERA_SC035HGS_MIPI_DEFAULT_FMT
        prompt "Select default output format for MIPI CSI interface"
        default CAMERA_SC035HGS_MIPI_DEFAULT_FMT_RAW10_640X480_48FPS
        depends on SOC_MIPI_CSI_SUPPORTED
        help
            This option allows you to select the default video format for the SC035HGS sensor
            when it is initialized on the MIPI CSI interface. The selected format will be used
            when the sensor is detected and initialized, and can be changed later when the
            sensor is in stream off state.

        config CAMERA_SC035HGS_MIPI_DEFAULT_FMT_RAW8_640X480_50FPS
            bool "MIPI 2-lane, 24M input, 640x480  50fps, RAW8"
            depends on CAMERA_SC035HGS_MIPI_RAW8_640X480_50FPS

        config CAMERA_SC035HGS_MIPI_DEFAULT_FMT_RAW8_640X480_100FPS
            bool "MIPI 2-lane, 24M input, 640x480 100fps, RAW8"
            depends on CAMERA_SC035HGS_MIPI_RAW8_640X480_100FPS

        config CAMERA_SC035HGS_MIPI_DEFAULT_FMT_RAW10_640X480_48FPS
            bool "MIPI 1-lane, 20M input, 640x480  48fps, RAW10"
            depends on CAMERA_SC035HGS_MIPI_RAW10_640X480_48FPS

        config CAMERA_SC035HGS_MIPI_DEFAULT_FMT_RAW10_640X480_120FPS
            bool "MIPI 1-lane, 24M input, 640x480 120fps, RAW10"
            depends on CAMERA_SC035HGS_MIPI_RAW10_640X480_120FPS
    endchoice # CAMERA_SC035HGS_MIPI_DEFAULT_FMT

    config CAMERA_SC035HGS_MIPI_IF_FORMAT_INDEX_DEFAULT
        int
        depends on SOC_MIPI_CSI_SUPPORTED
        default 0 if CAMERA_SC035HGS_MIPI_DEFAULT_FMT_RAW10_640X480_48FPS
        default 1 if CAMERA_SC035HGS_MIPI_DEFAULT_FMT_RAW10_640X480_120FPS
        default 2 if CAMERA_SC035HGS_MIPI_DEFAULT_FMT_RAW8_640X480_50FPS
        default 3 if CAMERA_SC035HGS_MIPI_DEFAULT_FMT_RAW8_640X480_100FPS
        help
            Sets the default configuration for the MIPI CSI interface.
            Use query_support_formats() API to get more format options.

    choice CAMERA_SC035HGS_IPA_JSON_CONFIGURATION_FILE
        prompt "IPA Configuration File"
        default CAMERA_SC035HGS_DEFAULT_IPA_JSON_CONFIGURATION_FILE
        help
            Select the Image Processing Algorithm (IPA) JSON configuration file
            for the SC035HGS sensor.

        config CAMERA_SC035HGS_DEFAULT_IPA_JSON_CONFIGURATION_FILE
            bool "Use default configuration"
            help
                Use the built-in default IPA configuration file:
                "esp_cam_sensor/sensors/sc035hgs/cfg/sc035hgs_mono_default.json"

                This configuration provides optimized settings for monochrome
                machine vision applications and is recommended for most use cases.

        config CAMERA_SC035HGS_CUSTOMIZED_IPA_JSON_CONFIGURATION_FILE
            bool "Use custom configuration"
            help
                Use a custom IPA configuration file with your own optimized settings.

                This option allows you to fine-tune sensor parameters for specific
                lighting conditions, exposure requirements, or application needs.

                You must specify the custom file path in the configuration below.
    endchoice

    config CAMERA_SC035HGS_CUSTOMIZED_IPA_JSON_CONFIGURATION_FILE_PATH
        string "Custom IPA configuration file path"
        depends on CAMERA_SC035HGS_CUSTOMIZED_IPA_JSON_CONFIGURATION_FILE
        help
            Specify the path to your custom SC035HGS IPA JSON configuration file.

            The path is relative to your project root directory.

            Example: "components/my_camera_config/sc035hgs_custom.json"

            Ensure the file exists and contains valid JSON configuration
            parameters compatible with the SC035HGS global shutter sensor.
endif
```
