## esp_cam_sensor/sensors/gc2145/Kconfig.gc2145
```kconfig
menuconfig CAMERA_GC2145
    bool "GC2145"
    default n
    help
        Enabling this option will add the support for GC2145.

if CAMERA_GC2145
    menuconfig CAMERA_GC2145_AUTO_DETECT
        bool "Auto detect GC2145"
        default y
        help
            When enabled, it provides the ability in application layer to automatically
            detect camera sensors one by one.

    if CAMERA_GC2145_AUTO_DETECT
        config CAMERA_GC2145_AUTO_DETECT_MIPI_INTERFACE_SENSOR
            bool "Detect for MIPI interface sensor"
            default y
            help
                When enabled, you don't need to call gc2145_detect manaually, GC2145 will
                be automatically detected and connected to the MIPI interface when the
                application starts.
    
        config CAMERA_GC2145_AUTO_DETECT_DVP_INTERFACE_SENSOR
        bool "Detect for DVP interface sensor"
        default n
        help
            When enabled, you don't need to call gc2145_detect manaually, GC2145 will
            be automatically detected and connected to the DVP interface when the
            application starts.
    endif

    choice CAMERA_GC2145_MIPI_DEFAULT_FMT
        prompt "Default format select for MIPI"
        default CAMERA_GC2145_MIPI_RGB565_640X480_15FPS
        help
            Select the default format to load when the sensor is detected.
            When the sensor is in stream off state, the format can be changed.
    
        config CAMERA_GC2145_MIPI_RGB565_1600X1200_7FPS
            bool "RGB565 1600x1200 7fps, MIPI 1lane 24M input"
        config CAMERA_GC2145_MIPI_RGB565_800X600_30FPS
            bool "RGB565 800x600 30fps, MIPI 1lane 24M input"
        config CAMERA_GC2145_MIPI_RGB565_640X480_15FPS
            bool "RGB565 640x480 15fps, MIPI 1lane 24M input"
    endchoice # CAMERA_GC2145_MIPI_DEFAULT_FMT

    config CAMERA_GC2145_MIPI_IF_FORMAT_INDEX_DAFAULT
        int
        default 0 if CAMERA_GC2145_MIPI_RGB565_1600X1200_7FPS
        default 1 if CAMERA_GC2145_MIPI_RGB565_800X600_30FPS
        default 2 if CAMERA_GC2145_MIPI_RGB565_640X480_15FPS
        help
            Set the configuration loaded by default for the MIPI interface.
            More information can be obtained by calling the query_support_formats().
    
    choice CAMERA_GC2145_DVP_DEFAULT_FMT
        prompt "Default format select for DVP"
        default CAMERA_GC2145_DVP_RGB565_640X480_15FPS
        help
            Select the default format to load when the sensor is detected.
            When the sensor is in stream off state, the format can be changed.
    
        config CAMERA_GC2145_DVP_RGB565_640X480_15FPS
            bool "RGB565 640x480 15fps, DVP 8bit 20M input"
        config CAMERA_GC2145_DVP_RGB565_1600X1200_13FPS
            bool "RGB565 1600x1200 13fps, DVP 8bit 20M input"
        config CAMERA_GC2145_DVP_RGB565_800X600_20FPS
            bool "RGB565 800x600 20fps, DVP 8bit 20M input"
    endchoice # CAMERA_GC2145_DVP_DEFAULT_FMT

    config CAMERA_GC2145_DVP_IF_FORMAT_INDEX_DAFAULT
        int
        default 3 if CAMERA_GC2145_DVP_RGB565_640X480_15FPS
        default 4 if CAMERA_GC2145_DVP_RGB565_1600X1200_13FPS
        default 5 if CAMERA_GC2145_DVP_RGB565_800X600_20FPS
        help
            Set the configuration loaded by default for the DVP interface.
            More information can be obtained by calling the query_support_formats().
    
    choice CAMERA_GC2145_MIPI_DATA_SEQ
        prompt "Data seq for MIPI"
        default CAMERA_GC2145_MIPI_DATA_SHORT_SWAPPED
        depends on CAMERA_GC2145_AUTO_DETECT_MIPI_INTERFACE_SENSOR
        help
            When the sensor outputs RGB565 or YUV422 format, the each pixel corresponds to two bytes of data.
            If the byte order is incorrect, the image may have abnormal colors or edges.
            Enabling this option will enable the byte order swap function in esp-video.
    
        config CAMERA_GC2145_MIPI_DATA_SHORT_SWAPPED
            bool "Codec short swapped"
        config CAMERA_GC2145_MIPI_DATA_INTERNAL_SWAPPED
            bool "Internal endian order swapped"
        config CAMERA_GC2145_MIPI_DATA_NONE_SWAPPED
            bool "None swap"
    endchoice # CAMERA_SC2336_MIPI_DEFAULT_FMT
endif
```

## esp_cam_sensor/sensors/lt6911/Kconfig.lt6911
```kconfig
menuconfig CAMERA_LT6911
    bool "LT6911"
    default n
    depends on SOC_LCDCAM_CAM_SUPPORTED
    help
        Enable support for the LT6911 HDMI To MIPI-CSI bridge sensor.

if CAMERA_LT6911
    menu "Auto detect LT6911"
        config CAMERA_LT6911_AUTO_DETECT_MIPI_INTERFACE_SENSOR
            bool "Detect for MIPI interface sensor"
            default y
            help
                When enabled, the LT6911 sensor will be automatically detected
                and initialized on the MIPI interface at startup without requiring
                manual detection call(lt6911_detect) in your application.
    endmenu
    
    menu "Choose supported formats for MIPI interface"
        config CAMERA_LT6911_MIPI_YUV422_1280X720_60FPS
            bool "MIPI 2-lane, 24M input, 1280x720 60fps, YUV422"
            default y if IDF_TARGET_ESP32P4
            default n
            help
                Standard color format using YUV422(UYVY) at 1280x720 resolution (720p)
                with 60fps framerate. Requires MIPI CSI-2 2-lane interface with 24MHz input clock..

        config CAMERA_LT6911_MIPI_YUV422_1920X1080_48FPS
            bool "MIPI 2-lane, 24M input, 1920x1080 48fps, YUV422"
            default n
            help
                YUV422(YUYV) at 1920x1080 resolution (1080p) with 48fps framerate.
                Requires MIPI CSI-2 2-lane interface with 24MHz input clock.
    endmenu

    choice CAMERA_LT6911_MIPI_DEFAULT_FMT
        prompt "Select default output format for MIPI interface"
        default CAMERA_LT6911_MIPI_DEFAULT_FMT_YUV422_1280X720_60FPS
        help
            This is an internal choice that ensures only one format can be selected as default.
            It is automatically controlled by the "Set as default format" options above.

        config CAMERA_LT6911_MIPI_DEFAULT_FMT_YUV422_1280X720_60FPS
            bool "MIPI 8-bit, 20M input, 1280X720 60fps, YUV422(UYVY)"
            depends on CAMERA_LT6911_MIPI_YUV422_1280X720_60FPS

        config CAMERA_LT6911_MIPI_DEFAULT_FMT_YUV422_1920X1080_48FPS
            bool "MIPI 2-lane, 24M input, 1920x1080 48fps, YUV422(YUYV)"
            depends on CAMERA_LT6911_MIPI_YUV422_1920X1080_48FPS
    endchoice # CAMERA_LT6911_MIPI_DEFAULT_FMT

    config CAMERA_LT6911_MIPI_IF_FORMAT_INDEX_DEFAULT
        int
        default 0 if CAMERA_LT6911_MIPI_DEFAULT_FMT_YUV422_1280X720_60FPS
        default 1 if CAMERA_LT6911_MIPI_DEFAULT_FMT_YUV422_1920X1080_48FPS
        help
            Sets the default configuration for the MIPI interface.
            Use query_support_formats() API to get more format options.
endif
```

## esp_cam_sensor/sensors/mira220/Kconfig.mira220
```kconfig
menuconfig CAMERA_MIRA220
    bool "MIRA220"
    default n
    depends on SOC_MIPI_CSI_SUPPORTED
    help
        Enable support for the MIRA220 CMOS image sensor.

if CAMERA_MIRA220
    menu "Auto detect MIRA220"
        config CAMERA_MIRA220_AUTO_DETECT_MIPI_INTERFACE_SENSOR
            bool "Detect for MIPI CSI interface sensor"
            default y
            help
                When enabled, the MIRA220 sensor will be automatically detected
                and initialized on the MIPI CSI interface at startup without requiring
                manual detection call(mira220_detect) in your application.
    endmenu

    menu "Choose supported formats for MIPI CSI interface"
        config CAMERA_MIRA220_MIPI_RAW8_1024X600_15FPS
            bool "MIPI 2-lane, 24M input, 1024x600  15fps, RAW8"
            default y
            help
                RAW8 color format at 1024x600 resolution with 15fps framerate.
                Requires MIPI CSI-2 2-lane interface with 24MHz input clock.
    endmenu

    choice CAMERA_MIRA220_MIPI_DEFAULT_FMT
        prompt "Select default output format for MIPI CSI interface"
        default CAMERA_MIRA220_MIPI_DEFAULT_FMT_RAW8_1024X600_15FPS
        help
            This option allows you to select the default video format for the MIRA220 sensor
            when it is initialized on the MIPI CSI interface. The selected format will be used
            when the sensor is detected and initialized, and can be changed later when the
            sensor is in stream off state.

        config CAMERA_MIRA220_MIPI_DEFAULT_FMT_RAW8_1024X600_15FPS
            bool "MIPI 2-lane, 24M input, 1024x600  15fps, RAW8"
            depends on CAMERA_MIRA220_MIPI_RAW8_1024X600_15FPS
    endchoice # CAMERA_MIRA220_MIPI_DEFAULT_FMT

    config CAMERA_MIRA220_MIPI_IF_FORMAT_INDEX_DEFAULT
        int
        default 0 if CAMERA_MIRA220_MIPI_DEFAULT_FMT_RAW8_1024X600_15FPS
        help
            Sets the default configuration for the MIPI CSI interface.
            Use query_support_formats() API to get more format options.

    choice CAMERA_MIRA220_IPA_JSON_CONFIGURATION_FILE
        prompt "IPA Configuration File"
        default CAMERA_MIRA220_DEFAULT_IPA_JSON_CONFIGURATION_FILE
        help
            Select the Image Processing Algorithm (IPA) JSON configuration file
            for the MIRA220 sensor.

        config CAMERA_MIRA220_DEFAULT_IPA_JSON_CONFIGURATION_FILE
            bool "Use default configuration"
            help
                Use the built-in default IPA configuration file:
                "esp_cam_sensor/sensors/mira220/cfg/mira220_default.json"

                This configuration provides optimized settings for general use cases
                and is recommended for most applications.

        config CAMERA_MIRA220_CUSTOMIZED_IPA_JSON_CONFIGURATION_FILE
            bool "Use custom configuration"
            help
                Use a custom IPA configuration file with your own optimized settings.

                This option allows you to fine-tune sensor parameters for specific
                lighting conditions, color requirements, or application needs.

                You must specify the custom file path in the configuration below.
    endchoice

    config CAMERA_MIRA220_CUSTOMIZED_IPA_JSON_CONFIGURATION_FILE_PATH
        string "Custom IPA configuration file path"
        depends on CAMERA_MIRA220_CUSTOMIZED_IPA_JSON_CONFIGURATION_FILE
        help
            Specify the path to your custom MIRA220 IPA JSON configuration file.

            The path is relative to your project root directory.

            Example: "components/my_camera_config/mira220_custom.json"

            Ensure the file exists and contains valid JSON configuration
            parameters compatible with the MIRA220 sensor.
endif
```

## esp_cam_sensor/sensors/mt9d111/Kconfig.mt9d111
```kconfig
menuconfig CAMERA_MT9D111
    bool "MT9D111"
    default n
    depends on SOC_LCDCAM_CAM_SUPPORTED
    help
        Enable support for the MT9D111 CMOS image sensor.

if CAMERA_MT9D111
    menu "Auto detect MT9D111"
        config CAMERA_MT9D111_AUTO_DETECT_DVP_INTERFACE_SENSOR
            bool "Detect for DVP interface sensor"
            default y
            help
                When enabled, the MT9D111 sensor will be automatically detected
                and initialized on the DVP interface at startup without requiring
                manual detection call(mt9d111_detect) in your application.
    endmenu

    menu "Choose supported formats for DVP interface"
        config CAMERA_MT9D111_DVP_RGB565_320X240_10FPS
            bool "DVP 8-bit, 20M input, 320x240 10fps, RGB565"
            default y
            help
                RGB565 color format at 320X240 resolution (QVGA) with 10fps framerate.
                Requires 8-bit DVP interface and 20MHz input clock.

        config CAMERA_MT9D111_DVP_RGB565_800X600_10FPS
            bool "DVP 8-bit, 20M input, 800x600 10fps, RGB565"
            default n
            help
                RGB565 color format at 800X600 resolution (SVGA) with 10fps framerate.
                Requires 8-bit DVP interface and 20MHz input clock.

        config CAMERA_MT9D111_DVP_YUV422_800X600_8FPS
            bool "DVP 8-bit, 20M input, 800x600  8fps, YUV422"
            default n
            help
                YUV422 color format at 800X600 resolution (SVGA) with 8fps framerate.
                Requires 8-bit DVP interface and 20MHz input clock.

        config CAMERA_MT9D111_DVP_YUV422_800X600_14FPS
            bool "DVP 8-bit, 20M input, 800x600 14fps, YUV422"
            default n
            help
                YUV422 color format at 800X600 resolution (SVGA) with 14fps framerate.
                Requires 8-bit DVP interface and 20MHz input clock.

        config CAMERA_MT9D111_DVP_YUV422_800X600_16FPS
            bool "DVP 8-bit, 24M input, 800x600 16fps, YUV422"
            default n
            help
                YUV422 color format at 800X600 resolution (SVGA) with 16fps framerate.
                Requires 8-bit DVP interface and 24MHz input clock.
    endmenu

    choice CAMERA_MT9D111_DVP_DEFAULT_FMT
        prompt "Select default output format for DVP interface"
        default CAMERA_MT9D111_DVP_DEFAULT_FMT_RGB565_320X240_10FPS
        help
            This is an internal choice that ensures only one format can be selected as default.
            It is automatically controlled by the "Set as default format" options above.
    
        config CAMERA_MT9D111_DVP_DEFAULT_FMT_RGB565_320X240_10FPS
            bool "DVP 8-bit, 20M input, 320x240 10fps, RGB565"
            depends on CAMERA_MT9D111_DVP_RGB565_320X240_10FPS

        config CAMERA_MT9D111_DVP_DEFAULT_FMT_RGB565_800X600_10FPS
            bool "DVP 8-bit, 20M input, 800x600 10fps, RGB565"
            depends on CAMERA_MT9D111_DVP_RGB565_800X600_10FPS

        config CAMERA_MT9D111_DVP_DEFAULT_FMT_YUV422_800X600_8FPS
            bool "DVP 8-bit, 20M input, 800x600  8fps, YUV422"
            depends on CAMERA_MT9D111_DVP_YUV422_800X600_8FPS

        config CAMERA_MT9D111_DVP_DEFAULT_FMT_YUV422_800X600_14FPS
            bool "DVP 8-bit, 20M input, 800x600 14fps, YUV422"
            depends on CAMERA_MT9D111_DVP_YUV422_800X600_14FPS

        config CAMERA_MT9D111_DVP_DEFAULT_FMT_YUV422_800X600_16FPS
            bool "DVP 8-bit, 24M input, 800x600 16fps, YUV422"
            depends on CAMERA_MT9D111_DVP_YUV422_800X600_16FPS
    endchoice # CAMERA_MT9D111_DVP_DEFAULT_FMT

    config CAMERA_MT9D111_DVP_IF_FORMAT_INDEX_DEFAULT
        int
        default 0 if CAMERA_MT9D111_DVP_DEFAULT_FMT_RGB565_320X240_10FPS
        default 1 if CAMERA_MT9D111_DVP_DEFAULT_FMT_YUV422_800X600_8FPS
        default 2 if CAMERA_MT9D111_DVP_DEFAULT_FMT_RGB565_800X600_10FPS
        default 3 if CAMERA_MT9D111_DVP_DEFAULT_FMT_YUV422_800X600_14FPS
        default 4 if CAMERA_MT9D111_DVP_DEFAULT_FMT_YUV422_800X600_16FPS
        help
            Sets the default configuration for the DVP interface.
            Use query_support_formats() API to get more format options.
endif
```
