## esp_video/test_apps/posix/main/Kconfig.projbuild
```kconfig
menu "Example Configuration"

    choice TEST_APPS_CAM_SENSOR_INTERFACE
        prompt "Camera sensor interface"
        default TEST_APPS_ENABLE_MIPI_CSI_CAM_SENSOR
        help
            Select camera sensor interface based on development board.

        config TEST_APPS_ENABLE_MIPI_CSI_CAM_SENSOR
            bool "MIPI-CSI"
            depends on ESP_VIDEO_ENABLE_MIPI_CSI_VIDEO_DEVICE

        config TEST_APPS_ENABLE_DVP_CAM_SENSOR
            bool "DVP"
            depends on ESP_VIDEO_ENABLE_DVP_VIDEO_DEVICE

        config TEST_APPS_DISABLE_ALL_SENSORS
            bool "None"
    endchoice

    if TEST_APPS_ENABLE_MIPI_CSI_CAM_SENSOR
        config TEST_APPS_MIPI_CSI_SCCB_I2C_PORT
            int "MIPI CSI SCCB I2C Port Number"
            default 0
            range 0 1

        config TEST_APPS_MIPI_CSI_SCCB_I2C_SCL_PIN
            int "MIPI CSI SCCB I2C SCL Pin"
            default 8
            range -1 56

        config TEST_APPS_MIPI_CSI_SCCB_I2C_SDA_PIN
            int "MIPI CSI SCCB I2C SDA Pin"
            default 7
            range -1 56

        config TEST_APPS_MIPI_CSI_SCCB_I2C_FREQ
            int "MIPI CSI SCCB I2C Frequency"
            default 100000
            range 100000 400000
            help
                Increasing this value can reduce the camera sensor initialization time.
                Please refer to the relevant instructions of the camera sensor to adjust the value.

        config TEST_APPS_MIPI_CSI_CAM_SENSOR_RESET_PIN
            int "MIPI CSI Camera Sensor Reset Pin"
            default -1
            range -1 56

        config TEST_APPS_MIPI_CSI_CAM_SENSOR_PWDN_PIN
            int "MIPI CSI Camera Sensor Power Down Pin"
            default -1
            range -1 56
    endif

    if TEST_APPS_ENABLE_DVP_CAM_SENSOR
        config TEST_APPS_DVP_SCCB_I2C_PORT
            int "DVP SCCB I2C Port Number"
            default 1
            range 0 1

        config TEST_APPS_DVP_SCCB_I2C_SCL_PIN
            int "DVP SCCB I2C SCL Pin"
            default 33
            range -1 56

        config TEST_APPS_DVP_SCCB_I2C_SDA_PIN
            int "DVP SCCB I2C SDA Pin"
            default 32
            range -1 56

        config TEST_APPS_DVP_SCCB_I2C_FREQ
            int "DVP SCCB I2C Frequency"
            default 100000
            range 100000 400000
            help
                Increasing this value can reduce the camera sensor initialization time.
                Please refer to the relevant instructions of the camera sensor to adjust the value.

        config TEST_APPS_DVP_CAM_SENSOR_RESET_PIN
            int "DVP Camera Sensor Reset Pin"
            default -1
            range -1 56

        config TEST_APPS_DVP_CAM_SENSOR_PWDN_PIN
            int "DVP Camera Sensor Power Down Pin"
            default -1
            range -1 56

        config TEST_APPS_DVP_XCLK_FREQ
            int "DVP XCLK Frequency"
            default 20000000

        config TEST_APPS_DVP_XCLK_PIN
            int "DVP XCLK Pin"
            range 0 56
            default 20

        config TEST_APPS_DVP_PCLK_PIN
            int "DVP PCLK Pin"
            range 0 56
            default 21

        config TEST_APPS_DVP_VSYNC_PIN
            int "DVP VSYNC Pin"
            range 0 56
            default 23

        config TEST_APPS_DVP_DE_PIN
            int "DVP DE Pin"
            range 0 56
            default 22

        config TEST_APPS_DVP_D0_PIN
            int "DVP D0 Pin"
            range 0 56
            default 53

        config TEST_APPS_DVP_D1_PIN
            int "DVP D1 Pin"
            range 0 56
            default 54

        config TEST_APPS_DVP_D2_PIN
            int "DVP D2 Pin"
            range 0 56
            default 52

        config TEST_APPS_DVP_D3_PIN
            int "DVP D3 Pin"
            range 0 56
            default 1

        config TEST_APPS_DVP_D4_PIN
            int "DVP D4 Pin"
            range 0 56
            default 0

        config TEST_APPS_DVP_D5_PIN
            int "DVP D5 Pin"
            range 0 56
            default 45

        config TEST_APPS_DVP_D6_PIN
            int "DVP D6 Pin"
            range 0 56
            default 46

        config TEST_APPS_DVP_D7_PIN
            int "DVP D7 Pin"
            range 0 56
            default 47
    endif
endmenu
```

## esp_video/test_apps/posix/sdkconfig.defaults.esp32s3
```kconfig
CONFIG_ESP_VIDEO_ENABLE_SPI_VIDEO_DEVICE=y

CONFIG_EXAMPLE_ENABLE_SPI_CAM_SENSOR=y

CONFIG_SPIRAM=y
CONFIG_SPIRAM_SPEED_80M=y
CONFIG_SPIRAM_MODE_OCT=y
```

## examples/http_web_camera/main/Kconfig.projbuild
```kconfig
menu "HTTP Web Camera Configuration"

    config HTTP_WEB_CAM_COUNT
        int "Web Camera Count"
        default 1
        range 1 4
        help
            The count of web camera, the example will try to start
            cameras "/dev/videoX"(X=0, 1, ..., count-1)  in sequence
            until fail to open the target device.

    config HTTP_WEB_CAM_FRAME_BUFFER_COUNT
        int "Web Camera Frame Buffer Count"
        default 2
        help
            Web camera frame buffer count, too large value may cause
            memory allocation fails.

    config HTTP_WEB_CAM_ENABLE_MIPI_CSI
        bool "Enable MIPI-CSI Camera"
        default y
        depends on MIPI_CSI_VIDEO_DEVICE_ENABLE
        help
            Select this option, MIPI-CSI interface camera is enabled.

    config HTTP_WEB_CAM_ENABLE_DVP
        bool "Enable DVP Camera"
        default y
        depends on DVP_ENABLE
        help
            Select this option, DVP interface camera is enabled.

    config HTTP_WEB_CAM_ENABLE_SIM
        bool "Enable Sim Camera"
        default y
        depends on CAMERA_SIM
        help
            Select this option, simulation camera is enabled.
    
    config HTTP_WEB_CAM_SIM_COUNT
        int "Sim Camera Count"
        default 1
        range 1 2
        depends on HTTP_WEB_CAM_ENABLE_SIM
        help
            Initialized simulation camera count, camera ID are 0 and 1.
endmenu
```

## examples/mipi_csi_basic/sdkconfig.defaults.esp32p4
```kconfig
CONFIG_CAMERA_GC0308=n
CONFIG_CAMERA_OV2640=n
CONFIG_CAMERA_OV5640=n
CONFIG_CAMERA_SIM=n

CONFIG_MIPI_CSI_LINESYNC_SUPPORT=y
```

## examples/uvc/main/Kconfig.projbuild
```kconfig
menu "USB Video Class Configuration"

    config UVC_CAM_FRAME_BUFFER_COUNT
        int "UVC Camera Frame Buffer Count"
        default 4
        help
            UVC camera frame buffer count, too large value may cause
            memory allocation fails.

    config UVC_CAM_ENABLE_MIPI_CSI
        bool "Enable MIPI-CSI Camera"
        default y
        depends on MIPI_CSI_ENABLE
        help
            Select this option, MIPI-CSI interface camera is enabled.

    config UVC_CAM_ENABLE_DVP
        bool "Enable DVP Camera"
        default y
        depends on DVP_ENABLE
        help
            Select this option, DVP interface camera is enabled.
    
    config UVC_CAM_ENABLE_DVP_JPEG_SW_CODEC
        bool "Enable DVP JPEG Software Codec"
        default y
        depends on UVC_CAM_ENABLE_DVP
        select ESP_VIDEO_SW_CODEC
        help
            Select this option, frame from DVP interface camera is coded
            by JPEG software codec.
endmenu
```

## test/camera_test/main/Kconfig.projbuild
```kconfig
menu "Example Configuration"

    choice MIPI_CAM_SENSOR
        prompt "MIPI camera sensor"
        default MIPI_SENSOR_OV5640
        help
            The camera sensor connected to esp32 board.

        config MIPI_SENSOR_OV5640
            bool "MIPI OV5640"
        config MIPI_SENSOR_OV5647
            bool "MIPI OV5647"
        config MIPI_SENSOR_IMX219
            bool "MIPI IMX219"
    endchoice

    config EXAMPLE_MIPI_IDI_CLOCK_RATE
        int " IDI clock rate"
        default 182400000 if MIPI_SENSOR_IMX219
        default 100000000 if MIPI_SENSOR_OV5647
        default 80000000

    choice EXAMPLE_CAM_SENSOR_FORMAT
        prompt "Camera sensor output format"
        default SENSOR_FORMAT_RAW8
        help
            The camera sensor out type.

        config SENSOR_FORMAT_RAW8
            bool "RAW8"
        config SENSOR_FORMAT_RGB565
            bool "RGB565"
        config SENSOR_FORMAT_RGB888
            bool "RGB888"
    endchoice

    config EXAMPLE_CAM_HSIZE
        int "cam image width"
        default 800

    config EXAMPLE_CAM_VSIZE
        int "cam image height"
        default 800
endmenu
```

## test/camera_test/sdkconfig.defaults
```kconfig
CONFIG_MIPI_CSI_LINESYNC_SUPPORT=y


#
# These configurations are only for esp32p4 can run, should be removed later
#
CONFIG_ESPTOOLPY_FLASHMODE_DIO=y
CONFIG_ESPTOOLPY_FLASHFREQ_40M=y
CONFIG_ESPTOOLPY_FLASHSIZE_2MB=y

CONFIG_PARTITION_TABLE_SINGLE_APP=y
CONFIG_PARTITION_TABLE_FILENAME="partitions_singleapp.csv"

CONFIG_ESP_VIDEO_MEDIA_EMBED_FILE="configs/sim_default.json"

CONFIG_IDF_TARGET="esp32p4"

CONFIG_SPIRAM=y
CONFIG_SPIRAM_SPEED_20M=y

# CONFIG_CAMERA_SC2336 is not set
CONFIG_CAMERA_SIM=y
CONFIG_CAMERA_SIM_AUTO_DETECT=y
CONFIG_CAMERA_SIM_NAME="sim_cam"
```

## test_apps/driver_test/main/Kconfig.projbuild
```kconfig
menu "Board Support Package"
    choice
        prompt "Choose Board Type"
        default BSP_BOARD_TYPE_SAMPLE
            config BSP_BOARD_TYPE_FLY_LINE
                bool "Fly Line"

            config BSP_BOARD_TYPE_FIB
                bool "FIB"

            config BSP_BOARD_TYPE_SAMPLE
                bool "Customer Sample"
    endchoice
endmenu
```

## test_apps/pipeline_test/config_parse_test/sdkconfig.defaults
```kconfig
# For IDF 5.x
CONFIG_ESP_TASK_WDT_EN=n

# For IDF4.x
CONFIG_ESP_TASK_WDT=n

CONFIG_ESP_VIDEO_MEDIA_CONTROLLER=y
CONFIG_ESP_VIDEO_MEDIA_EMBED_FILE=""
```

## test_apps/pipeline_test/config_parse_test/sdkconfig.defaults.esp32p4
```kconfig
CONFIG_SPIRAM=y
CONFIG_SPIRAM_SPEED_20M=y

CONFIG_SIMULATED_INTF=y

CONFIG_CAMERA_SIM=y
CONFIG_CAMERA_SIM_AUTO_DETECT=y
CONFIG_CAMERA_SIM_NAME="sim_cam"

CONFIG_DVP_ENABLE=y
CONFIG_MIPI_CSI_VIDEO_DEVICE_ENABLE=y
CONFIG_CAM_ISP_GLOABL_ENABLE=y
CONFIG_CAMERA_SC2336=y

CONFIG_MIPI_CSI_LINESYNC_SUPPORT=y
```

## test_apps/pipeline_test/config_parse_test/sdkconfig.defaults.esp32s3
```kconfig
CONFIG_SPIRAM=n
CONFIG_ESP_CONSOLE_USB_SERIAL_JTAG=y

CONFIG_SIMULATED_INTF=y

CONFIG_CAMERA_SIM=y
CONFIG_CAMERA_SIM_AUTO_DETECT=y
CONFIG_CAMERA_SIM_NAME="sim_cam"
```

## test_apps/pipeline_test/sim_device_test/sdkconfig.defaults.esp32s3
```kconfig
CONFIG_SPIRAM=n

CONFIG_SIMULATED_INTF=y

CONFIG_CAMERA_SIM=y
CONFIG_CAMERA_SIM_AUTO_DETECT=y
CONFIG_CAMERA_SIM_NAME="sim_cam"
```

## test_apps/posix_test/sdkconfig.defaults
```kconfig
# For IDF 5.x
CONFIG_ESP_TASK_WDT_EN=n

# For IDF4.x
CONFIG_ESP_TASK_WDT=n

CONFIG_ESP_VIDEO_SW_CODEC_JPEG_DEVICE=y
```

## test_apps/posix_test/sdkconfig.defaults.esp32p4
```kconfig
CONFIG_IDF_EXPERIMENTAL_FEATURES=y

CONFIG_SPIRAM=y
CONFIG_SPIRAM_SPEED_200M=y

CONFIG_SIMULATED_INTF=y

CONFIG_CAMERA_SIM=y
CONFIG_CAMERA_SIM_AUTO_DETECT=y
CONFIG_CAMERA_SIM_NAME="sim_cam"

CONFIG_MIPI_CSI_LINESYNC_SUPPORT=y
```

## test_apps/sdkconfig.defaults.esp32p4
```kconfig
CONFIG_SPIRAM=y
CONFIG_SPIRAM_SPEED_20M=y

CONFIG_SIMULATED_INTF=y

CONFIG_CAMERA_SIM=y
CONFIG_CAMERA_SIM_AUTO_DETECT=y
CONFIG_CAMERA_SIM_NAME="sim_cam"
```

## utils/Kconfig.utils
```kconfig
menu "Utils Configuration"

    config ESP_VIDEO_SW_CODEC
        bool "Enable Software Codec"
        default y
        help
            Select this option, enable software codec such as JPEG, BMP and YUV.

    config ESP_VIDEO_SW_CODEC_JPEG_DEVICE
        bool "Enable JPEG Video Device"
        default n
        help
            Select this option, function "esp_camera_init" will create JPEG
            video device.

endmenu
```
