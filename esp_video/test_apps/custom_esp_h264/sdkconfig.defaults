## esp_video/test_apps/custom_esp_h264/sdkconfig.defaults.esp32p4
```kconfig
CONFIG_ESP_VIDEO_ENABLE_HW_H264_VIDEO_DEVICE=y
CONFIG_ESP_VIDEO_USE_CUSTOMIZED_ESP_H264_VERSION=y

CONFIG_IDF_EXPERIMENTAL_FEATURES=y

CONFIG_SPIRAM=y
CONFIG_SPIRAM_SPEED_200M=y
```
