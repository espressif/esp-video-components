## drivers/cameras/ov5640/Kconfig
```kconfig
menuconfig CAMERA_OV5640
    bool "OV5640"
    default n
    help
        Enabling this option will add the support for OV5640.

    config CAMERA_OV5640_AUTO_DETECT
        bool "Auto detect OV5640"
        default y
        depends on CAMERA_OV5640
        help
            When enabled, you don't need to call ov5640_detect manaually, OV5640 will be automatically detected
            when esp_camera_init is called.

    menu "Interface"
        depends on CAMERA_OV5640
        config CAMERA_OV5640_INTERFACE_CSI
            bool "CSI"
            default y
            help
                If enabled, the OV5640 will be connected to the CSI interface.
        config CAMERA_OV5640_INTERFACE_DVP
            bool "DVP"
            default n
            help
                If enabled, the OV5640 will be connected to the DVP interface.
    endmenu

    config CAMERA_OV5640_MAX_SUPPORT
        int "Support for a maximum number of connected OV5640"
        depends on CAMERA_OV5640
        default 1
        range 1 3 if IDF_TARGET_ESP32P4
        range 1 1 if !IDF_TARGET_ESP32P4
        help
            Set the number of connected OV5640.
```

## drivers/cameras/ov5645/Kconfig
```kconfig
menuconfig CAMERA_OV5645
    bool "OV5645"
    default n
    help
        Enabling this option will add the support for OV5645.

    config CAMERA_OV5645_AUTO_DETECT
        bool "Auto detect OV5645"
        default y
        depends on CAMERA_OV5645
        help
            When enabled, you don't need to call ov5645_detect manaually, OV5645 will be automatically detected
            when esp_camera_init is called.

    menu "Interface"
        depends on CAMERA_OV5645
        config CAMERA_OV5645_INTERFACE_CSI
            bool "CSI"
            default y
            help
                If enabled, the OV5645 will be connected to the CSI interface.
    endmenu

    config CAMERA_OV5645_MAX_SUPPORT
        int "Support for a maximum number of connected OV5645"
        depends on CAMERA_OV5645
        default 1
        range 1 1
        help
            Set the number of connected OV5645.
```

## drivers/cameras/ov5647/Kconfig
```kconfig
menuconfig CAMERA_OV5647
    bool "OV5647"
    default n
    help
        Enabling this option will add the support for OV5647.

    config CAMERA_OV5647_AUTO_DETECT
        bool "Auto detect OV5647"
        default y
        depends on CAMERA_OV5647
        help
            When enabled, you don't need to call ov5647_detect manaually, OV5647 will be automatically detected
            when esp_camera_init is called.

    menu "Interface"
        depends on CAMERA_OV5647
        config CAMERA_OV5647_INTERFACE_CSI
            bool "CSI"
            default y
            help
                If enabled, the OV5647 will be connected to the CSI interface.
    endmenu

    config CAMERA_OV5647_MAX_SUPPORT
        int "Support for a maximum number of connected OV5647"
        depends on CAMERA_OV5647
        default 1
        range 1 1 if IDF_TARGET_ESP32P4
        help
            Set the number of connected OV5647.
    
    config CAMERA_OV5647_CSI_LINESYNC_ENABLE
        bool "CSI Line sync enable"
        depends on CAMERA_OV5647_INTERFACE_CSI
        default y
        help
            If enabled, send line short packet for each line.
```

## drivers/cameras/sc2336/Kconfig
```kconfig
menuconfig CAMERA_SC2336
    bool "SC2336"
    default n
    help
        Enabling this option will add the support for SC2336.

    config CAMERA_SC2336_AUTO_DETECT
        bool "Auto detect SC2336"
        default y
        depends on CAMERA_SC2336
        help
            When enabled, you don't need to call sc2336_detect manaually, SC2336 will be automatically detected
            when esp_camera_init is called.

    menu "Interface"
        depends on CAMERA_SC2336
        config CAMERA_SC2336_INTERFACE_CSI
            bool "CSI"
            default y
            help
                If enabled, the SC2336 will be connected to the CSI interface.
        config CAMERA_SC2336_INTERFACE_DVP
            bool "DVP"
            default n
            help
                If enabled, the SC2336 will be connected to the DVP interface.
    endmenu

    config CAMERA_SC2336_MAX_SUPPORT
        int "Support for a maximum number of connected SC2336"
        depends on CAMERA_SC2336
        default 1
        range 1 3 if IDF_TARGET_ESP32P4
        range 1 1 if !IDF_TARGET_ESP32P4
        help
            Set the number of connected SC2336.
```

## drivers/cameras/sim/Kconfig
```kconfig
menuconfig CAMERA_SIM
    bool "SIM"
    default y
    help
        Enabling this option will add the support for a simulator camera.

    config CAMERA_SIM_AUTO_DETECT
        bool "Auto detect SIM"
        default y
        depends on CAMERA_SIM
        help
            When enabled, you don't need to call sim_detect manaually, SIM will be automatically detected
            when esp_camera_init is called.

    config CAMERA_SIM_NAME
        string "Name for this simulated camera"
        default "sim_cam"
        depends on CAMERA_SIM

    menu "Interface"
        depends on CAMERA_SIM
        config CAMERA_SIM_INTERFACE_SIM
            bool "SIM"
            default y
            select SIMULATED_INTF
            help
                If enabled, the SIM camera will be connected to the SIM interface.
    endmenu
```

## drivers/commons/soc/esp32/include/soc/Kconfig.soc_caps.in
```kconfig
config SOC_CAM_SUPPORTED
    bool
    default y

config SOC_CAM_PERIPH_NUM
    int
    default 2

config SOC_CAM_DATA_WIDTH
    int
    default 16
```

## drivers/commons/soc/esp32p4/include/soc/Kconfig.soc_caps.in
```kconfig
# AEG:1300, disable this option to avoid ESP-IDF compiling error
config SOC_LCDCAM_SUPPORTED
    bool
    default n

config SOC_CAM_SUPPORT_RGB_YUV_CONV
    bool
    default y

config SOC_CAM_PERIPH_NUM
    int
    default 1

config SOC_CAM_DATA_WIDTH
    int
    default 16
```

## drivers/commons/soc/esp32s3/include/soc/Kconfig.soc_caps.in
```kconfig
config SOC_CAM_SUPPORT_RGB_YUV_CONV
    bool
    default y

config SOC_CAM_PERIPH_NUM
    int
    default 1

config SOC_CAM_DATA_WIDTH
    int
    default 16
```

## drivers/interfaces/Kconfig.interfaces
```kconfig
menu "Camera Interfaces Configuration"
    rsource "dvp/Kconfig.dvp"
    rsource "mipi/csi/Kconfig.csi"
    rsource "sim/Kconfig.sim"
endmenu
```

## drivers/interfaces/dvp/Kconfig.dvp
```kconfig
menu "DVP"
    depends on IDF_TARGET_ESP32

    config DVP_ENABLE
        bool "Enable DVP Driver and Video Device"
        default y
        help
            Select this option, enable DVP driver and video device.

    choice DVP_DATA_BUS_WIDTH
        bool "DVP Data Bus Width"
        default DVP_DATA_BUS_WIDTH_8BITS
        depends on DVP_ENABLE

        config DVP_DATA_BUS_WIDTH_8BITS
            bool "8 Bits"
        config DVP_DATA_BUS_WIDTH_16BITS
            bool "16 Bits"
    endchoice

    config DVP_ENABLE_OUTPUT_CLOCK
        bool "Enable DVP Output Clock"
        default n
        depends on DVP_ENABLE && IDF_TARGET_ESP32S3
        help
            Select this option, enable DVP output clock for camera sensor. 

    config DVP_ENABLE_H_SYNC
        bool "Enable DVP H-SYNC"
        default n
        depends on DVP_ENABLE && IDF_TARGET_ESP32S3
        help
            Select this option, enable DVP H-SYNC signal. 

    config DVP_TASK_STACK_SIZE
        int "DVP Task Stack Size"
        default 3072
        depends on DVP_ENABLE
        help
            DVP task stack size, if receive callback function need cost much
            stack size, please increase this value.

    config DVP_DMA_BUFFER_MAX_SIZE
        int "DVP DMA Buffer Maximum Size"
        default 32768
        range 8192 32768
        help
            DVP DMA buffer maximum size, larger values may fail to allocate due to
            insufficient contiguous memory blocks, and too smaller value may cause
            DMA interrupt triggering be too frequently.
    
    choice CAM_DVP_CLK_SRC
        prompt "LCD_CAM cam clock source"
        depends on IDF_TARGET_ESP32S3 || IDF_TARGET_ESP32P4
        default CAM_DVP_CLK_SRC_PLL240M
        help
            Choose which clock is used as LCD_CAM cam clock source.

        config CAM_DVP_CLK_SRC_PLL160M
            bool "PLL_F160M"
        config CAM_DVP_CLK_SRC_PLL240M
            bool "PLL_D2_240M"
        config CAM_DVP_CLK_SRC_XTAL
            bool "XTAL_CLK"
    endchoice
endmenu
```

## drivers/interfaces/mipi/csi/Kconfig.csi
```kconfig
menu "Camera Video Device Configuration"
    depends on SOC_MIPI_CSI_SUPPORTED

    config MIPI_CSI_VIDEO_DEVICE_ENABLE
        bool "Enable MIPI-CSI based Video Device"
        default y
        help
            Select this option, enable MIPI-CSI based video device.

endmenu
```

## drivers/isp/Kconfig
```kconfig
menu "ISP configuration"

    config CAM_ISP_GLOABL_ENABLE
    bool "ISP global enable"
    depends on IDF_TARGET_ESP32P4
    default y
    help
        It enables ISP module for MIPI&DVP camera sensor.

config CAM_SENSOR_COLOR_BAYER_MODE
    int "Sensor array region color filter layout"
    depends on CAM_ISP_GLOABL_ENABLE
    default 1
    range 0 3
    help
        Select the color filters used on the camera sensor.
        00 : BG/GR    01 : GB/RG   10 : GR/BG  11 : RG/GB.

config CAM_ISP_GLOABL_ENABLE
    bool "ISP global enable"
    depends on IDF_TARGET_ESP32P4
    default y
    help
        It enables ISP module for MIPI&DVP camera sensor.

endmenu
```

## drivers/isp/Kconfig.isp
```kconfig
menu "ISP configuration"
    depends on IDF_TARGET_ESP32P4

    config CAM_ISP_GLOABL_ENABLE
        bool "ISP global enable"
        default y
        help
            It enables ISP module for MIPI&DVP camera sensor.

    config CAM_SENSOR_COLOR_BAYER_MODE
        int "Sensor array region color filter layout"
        depends on CAM_ISP_GLOABL_ENABLE
        default 1
        range 0 3
        help
            Select the color filters used on the camera sensor.
            00 : BG/GR    01 : GB/RG   10 : GR/BG  11 : RG/GB.

    config CAM_ISP_GLOABL_ENABLE
        bool "ISP global enable"
        default y
        help
            It enables ISP module for MIPI&DVP camera sensor.

endmenu
```

## drivers/mipi/csi/Kconfig.csi
```kconfig
menu "MIPI-CSI configuration"
    depends on IDF_TARGET_ESP32P4

    choice CSI_TR_WIDTH
        bool "CSI DMA transfer width"
        default CSI_TR_WIDTH_64BIT

        config CSI_TR_WIDTH_64BIT
            bool "64bits"

        config CSI_TR_WIDTH_32BIT
            bool "32bits"
    endchoice

    menu "MIPI D-PHY Config"
        config MIPI_CSI_LINESYNC_SUPPORT
        bool "Line Sync Enabled"
        default n
        help
            Enable this option if the mipi camera sensor send line short packet for each line.

    endmenu
endmenu
```

## drivers/sccb/Kconfig.sccb
```kconfig
menu "SCCB configuration"
    config SCCB_BASED_I3C_ENABLED
        bool "Enable SCCB implemented by I3C"
        default n
        depends on IDF_TARGET_ESP32P4
        help
            When enabled, I3C can be used to implement a SCCB port.
endmenu
```

## drivers/sccb_idf_master/Kconfig
```kconfig
menu "SCCB configuration"
    choice SCCB_PERIPHERAL_DRIVER
        bool "Peripherals used to implement SCCB"
        default SCCB_IMPLEMENT_I2C
        help
            Select the peripheral driver used to implement SCCB.

        config SCCB_IMPLEMENT_I2C
            bool "I2C"
        config SCCB_IMPLEMENT_I3C
            bool "I3C"
    endchoice

    config SCCB_CLK_FREQ
    int "SCCB clk frequency"
    default 100000
    range 100000 400000
    help
        Increasing this value can reduce the initialization time of the sensor.
        Please refer to the relevant instructions of the sensor to adjust the value.
endmenu
```

## drivers/sim/Kconfig.sim
```kconfig
menu "Simulated Interface Configuration"

    config SIMULATED_INTF
        bool "Enable Simulated Interface"
        default n
        select ESP_TIMER_SUPPORTS_ISR_DISPATCH_METHOD
        help
            Selecting this option adds a software-simulated interface equivalent to MIPI-CSI.
            To work with the simulated interface, a simulated camera device should be added.
            This mode can be used as a substitute for real hardware.

    if SIMULATED_INTF
        config SIMULATED_INTF_DEVICE_BUFFER_COUNT
            int "Buffer count"
            default 4
    endif
endmenu
```
